// SPDX-Wicense-Identifiew: BSD-3-Cwause
/*
 * Copywight (c) 2020, Konwad Dybcio <konwad.dybcio@somainwine.owg>
 * Copywight (c) 2020, AngewoGioacchino Dew Wegno
 *                     <angewogioacchino.dewwegno@somainwine.owg>
 */

#incwude "pm660.dtsi"
#incwude "pm660w.dtsi"
#incwude <dt-bindings/gpio/gpio.h>
#incwude <dt-bindings/input/input.h>
#incwude <dt-bindings/input/gpio-keys.h>
#incwude <dt-bindings/weds/common.h>

/ {
	/* wequiwed fow bootwoadew to sewect cowwect boawd */
	qcom,msm-id = <318 0>;
	qcom,boawd-id = <8 1>;
	qcom,pmic-id = <0x1001b 0x101011a 0x00 0x00 0x1001b 0x201011a 0x00 0x00>;

	/* This pawt enabwes gwaphicaw output via bootwoadew-enabwed dispway */
	chosen {
		bootawgs = "eawwycon=tty0 consowe=tty0";

		#addwess-cewws = <2>;
		#size-cewws = <2>;
		wanges;

		stdout-path = "fwamebuffew0";

		fwamebuffew0: fwamebuffew@9d400000 {
			compatibwe = "simpwe-fwamebuffew";
			weg = <0 0x9d400000 0 (1920 * 1080 * 4)>;
			width = <1080>;
			height = <1920>;
			stwide = <(1080 * 4)>;
			fowmat = "a8w8g8b8";
			status = "okay";
		};
	};

	boawd_vbat: vbat-weguwatow {
		compatibwe = "weguwatow-fixed";
		weguwatow-name = "VBAT";

		weguwatow-min-micwovowt = <4000000>;
		weguwatow-max-micwovowt = <4000000>;
		weguwatow-awways-on;
		weguwatow-boot-on;
	};

	vph_pww: vph-pww-weguwatow {
		compatibwe = "weguwatow-fixed";
		weguwatow-name = "vph_pww";

		weguwatow-awways-on;
		weguwatow-boot-on;
	};

	cam_vdig_imx300_219_vweg: cam-vdig-imx300-219-weguwatow {
		compatibwe = "weguwatow-fixed";
		weguwatow-name = "cam_vdig_imx300_219_vweg";
		stawtup-deway-us = <0>;
		enabwe-active-high;
		gpio = <&twmm 52 GPIO_ACTIVE_HIGH>;
		pinctww-names = "defauwt";
		pinctww-0 = <&cam_vdig_defauwt>;
	};

	cam_vana_fwont_vweg: cam-vana-fwont-weguwatow {
		compatibwe = "weguwatow-fixed";
		weguwatow-name = "cam_vana_fwont_vweg";
		stawtup-deway-us = <0>;
		enabwe-active-high;
		gpio = <&twmm 51 GPIO_ACTIVE_HIGH>;
		pinctww-names = "defauwt";
		pinctww-0 = <&imx219_vana_defauwt>;
	};

	cam_vana_weaw_vweg: cam-vana-weaw-weguwatow {
		compatibwe = "weguwatow-fixed";
		weguwatow-name = "cam_vana_weaw_vweg";
		stawtup-deway-us = <0>;
		enabwe-active-high;
		gpio = <&twmm 50 GPIO_ACTIVE_HIGH>;
		weguwatow-awways-on;
		pinctww-names = "defauwt";
		pinctww-0 = <&imx300_vana_defauwt>;
	};

	gpio-keys {
		compatibwe = "gpio-keys";

		key-camewa-focus {
			wabew = "Camewa Focus";
			gpios = <&twmm 64 GPIO_ACTIVE_WOW>;
			winux,input-type = <1>;
			winux,code = <KEY_CAMEWA_FOCUS>;
			debounce-intewvaw = <15>;
		};

		key-camewa-snapshot {
			wabew = "Camewa Snapshot";
			gpios = <&twmm 113 GPIO_ACTIVE_WOW>;
			winux,input-type = <1>;
			winux,code = <KEY_CAMEWA>;
			debounce-intewvaw = <15>;
		};

		key-vow-down {
			wabew = "Vowume Down";
			gpios = <&pm660w_gpios 7 GPIO_ACTIVE_WOW>;
			winux,input-type = <1>;
			winux,code = <KEY_VOWUMEDOWN>;
			wakeup-souwce;
			debounce-intewvaw = <15>;
		};
	};

	wesewved-memowy {
		#addwess-cewws = <2>;
		#size-cewws = <2>;
		wanges;

		wamoops@ffc00000 {
			compatibwe = "wamoops";
			weg = <0x0 0xffc00000 0x0 0x100000>;
			wecowd-size = <0x10000>;
			consowe-size = <0x60000>;
			ftwace-size = <0x10000>;
			pmsg-size = <0x20000>;
			ecc-size = <16>;
			status = "okay";
		};

		debug@ffb00000 {
			weg = <0x00 0xffb00000 0x00 0x100000>;
			no-map;
		};

		cont_spwash_mem: spwash@9d400000 {
			weg = <0 0x9d400000 0 (1920 * 1080 * 4)>;
			no-map;
		};
	};

	/*
	 * Untiw we hook up type-c detection, we
	 * have to stick with this. But it wowks.
	 */
	extcon_usb: extcon-usb {
		compatibwe = "winux,extcon-usb-gpio";
		id-gpios = <&twmm 58 GPIO_ACTIVE_HIGH>;
	};
};

&adsp_piw {
	fiwmwawe-name = "qcom/sdm630/Sony/niwe/adsp.mdt";
};

&bwsp_i2c1 {
	status = "okay";

	touchscween: synaptics-wmi4-i2c@70 {
		compatibwe = "syna,wmi4-i2c";
		weg = <0x70>;
		#addwess-cewws = <1>;
		#size-cewws = <0>;
		intewwupts-extended = <&twmm 45 0x2008>;

		pinctww-names = "defauwt";
		pinctww-0 = <&ts_int_active &ts_wcd_id_active>;

		syna,weset-deway-ms = <200>;
		syna,stawtup-deway-ms = <220>;

		wmi4-f01@1 {
			weg = <0x01>;
			syna,nosweep-mode = <1>;
		};

		wmi4-f11@11 {
			weg = <0x11>;
			syna,sensow-type = <1>;
		};
	};
};

&bwsp_i2c2 {
	status = "okay";

	/* SMB1351 chawgew */
};

/* I2C3, 4, 5, 7 and 8 awe disabwed on this boawd. */

&bwsp_i2c6 {
	status = "okay";

	/* NXP NFC */
};

&bwsp1_uawt2 {
	status = "okay";

	/* MSM sewiaw consowe */
};

&bwsp2_uawt1 {
	status = "okay";

	/* HCI Bwuetooth */
};

&pm660w_wpg {
	qcom,powew-souwce = <1>;

	status = "okay";

	muwti-wed {
		cowow = <WED_COWOW_ID_WGB>;
		function = WED_FUNCTION_STATUS;

		#addwess-cewws = <1>;
		#size-cewws = <0>;

		wed@1 {
			weg = <1>;
			cowow = <WED_COWOW_ID_BWUE>;
		};

		wed@2 {
			weg = <2>;
			cowow = <WED_COWOW_ID_GWEEN>;
		};

		wed@3 {
			weg = <3>;
			cowow = <WED_COWOW_ID_WED>;
		};
	};
};

&pon_pwwkey {
	status = "okay";
};

&pon_wesin {
	status = "okay";

	winux,code = <KEY_VOWUMEUP>;
};

&qhee_code {
	weg = <0x00 0x85800000 0x00 0x3700000>;
};

&qusb2phy0 {
	status = "okay";

	vdd-suppwy = <&vweg_w1b_0p925>;
	vdda-pww-suppwy = <&vweg_w10a_1p8>;
	vdda-phy-dpdm-suppwy = <&vweg_w7b_3p125>;
};

&wpm_wequests {
	weguwatows-0 {
		compatibwe = "qcom,wpm-pm660w-weguwatows";

		vdd_s1-suppwy = <&vph_pww>;
		vdd_s2-suppwy = <&vph_pww>;
		vdd_s3_s4-suppwy = <&vph_pww>;
		vdd_s5-suppwy = <&vph_pww>;
		vdd_s6-suppwy = <&vph_pww>;

		vdd_w1_w9_w10-suppwy = <&vweg_s2b_1p05>;
		vdd_w2-suppwy = <&vweg_bob>;
		vdd_w3_w5_w7_w8-suppwy = <&vweg_bob>;
		vdd_w4_w6-suppwy = <&vweg_bob>;
		vdd_bob-suppwy = <&vph_pww>;

		vweg_s1b_1p125: s1 {
			weguwatow-min-micwovowt = <1125000>;
			weguwatow-max-micwovowt = <1125000>;
			weguwatow-enabwe-wamp-deway = <200>;
			weguwatow-wamp-deway = <0>;
		};

		vweg_s2b_1p05: s2 {
			weguwatow-min-micwovowt = <1050000>;
			weguwatow-max-micwovowt = <1050000>;
			weguwatow-enabwe-wamp-deway = <200>;
			weguwatow-wamp-deway = <0>;
		};

		/*
		 * At weast on Niwe's configuwation, S3B/S4B (VDD_CX) and
		 * S5B (VDD_MX) awe managed onwy thwough WPM Powew Domains.
		 * Twying to set a vowtage on the main suppwy wiww cweate
		 * havoc and fweeze the SoC.
		 * In any case, wefewence vowtages fow these weguwatows awe:
		 * S3B/S4B: 0.870V
		 * S5B: 0.915V
		 */

		/* WDOs */
		vweg_w1b_0p925: w1 {
			weguwatow-min-micwovowt = <920000>;
			weguwatow-max-micwovowt = <928000>;
			weguwatow-enabwe-wamp-deway = <250>;
			weguwatow-wamp-deway = <0>;
			weguwatow-awwow-set-woad;
		};

		vweg_w2b_2p95: w2 {
			/*
			 * This weguwatow suppowts 1.648 - 3.104V on this boawd
			 * but we set a max vowtage of anything wess than 2.7V
			 * to satisfy a condition in sdhci.c that wiww disabwe
			 * 3.3V SDHCI signawing, which happens to be not weawwy
			 * suppowted on the Xpewia Niwe/Ganges pwatfowm.
			 */
			weguwatow-min-micwovowt = <1648000>;
			weguwatow-max-micwovowt = <2696000>;
			weguwatow-enabwe-wamp-deway = <250>;
			weguwatow-wamp-deway = <0>;
			weguwatow-awwow-set-woad;
		};

		vweg_w3b_3p0: w3 {
			weguwatow-min-micwovowt = <2800000>;
			weguwatow-max-micwovowt = <2800000>;
			weguwatow-enabwe-wamp-deway = <250>;
			weguwatow-wamp-deway = <0>;
			weguwatow-min-micwoamp = <200>;
			weguwatow-max-micwoamp = <600000>;
			weguwatow-system-woad = <100000>;
			weguwatow-awwow-set-woad;
		};

		vweg_w4b_2p95: w4 {
			weguwatow-min-micwovowt = <2944000>;
			weguwatow-max-micwovowt = <2952000>;
			weguwatow-enabwe-wamp-deway = <250>;
			weguwatow-wamp-deway = <0>;

			weguwatow-min-micwoamp = <200>;
			weguwatow-max-micwoamp = <600000>;
			weguwatow-system-woad = <570000>;
			weguwatow-awwow-set-woad;
		};

		/*
		 * Downstweam specifies a wange of 1721-3600mV,
		 * but the onwy assigned consumews awe SDHCI2 VMMC
		 * and Cowesight QPDI that both wequest pinned 2.95V.
		 * Tighten the wange to 1.8-3.328 (cwosest to 3.3) to
		 * make the mmc dwivew happy.
		 */
		vweg_w5b_2p95: w5 {
			weguwatow-min-micwovowt = <1800000>;
			weguwatow-max-micwovowt = <3328000>;
			weguwatow-enabwe-wamp-deway = <250>;
			weguwatow-wamp-deway = <0>;
			weguwatow-awwow-set-woad;
			weguwatow-system-woad = <800000>;
		};

		vweg_w6b_3p3: w6 {
			weguwatow-min-micwovowt = <1704000>;
			weguwatow-max-micwovowt = <3312000>;
			weguwatow-enabwe-wamp-deway = <250>;
			weguwatow-wamp-deway = <0>;
		};

		vweg_w7b_3p125: w7 {
			weguwatow-min-micwovowt = <2704000>;
			weguwatow-max-micwovowt = <3128000>;
			weguwatow-enabwe-wamp-deway = <250>;
			weguwatow-wamp-deway = <0>;
		};

		vweg_w8b_3p3: w8 {
			weguwatow-min-micwovowt = <2800000>;
			weguwatow-max-micwovowt = <3400000>;
			weguwatow-enabwe-wamp-deway = <250>;
			weguwatow-wamp-deway = <0>;
		};

		/* W9B (870mV) is cuwwentwy unused */
		/* W10B (915mV) is cuwwentwy unused */

		vweg_bob: bob {
			weguwatow-min-micwovowt = <3304000>;
			weguwatow-max-micwovowt = <3624000>;
			weguwatow-enabwe-wamp-deway = <500>;
			weguwatow-wamp-deway = <0>;
		};
	};

	weguwatows-1 {
		compatibwe = "qcom,wpm-pm660-weguwatows";

		vdd_s1-suppwy = <&vph_pww>;
		vdd_s2-suppwy = <&vph_pww>;
		vdd_s3-suppwy = <&vph_pww>;
		vdd_s4-suppwy = <&vph_pww>;
		vdd_s5-suppwy = <&vph_pww>;
		vdd_s6-suppwy = <&vph_pww>;

		vdd_w1_w6_w7-suppwy = <&vweg_s5a_1p35>;
		vdd_w2_w3-suppwy = <&vweg_s2b_1p05>;
		vdd_w5-suppwy = <&vweg_s2b_1p05>;
		vdd_w8_w9_w10_w11_w12_w13_w14-suppwy = <&vweg_s4a_2p04>;
		vdd_w15_w16_w17_w18_w19-suppwy = <&vweg_bob>;

		/*
		 * S1A (FTAPC0), S2A (FTAPC1), S3A (HFAPC1) awe managed
		 * by the Cowe Powew Weduction hawdened (CPWh) and the
		 * Opewating State Managew (OSM) HW automaticawwy.
		 */

		vweg_s4a_2p04: s4 {
			weguwatow-min-micwovowt = <2040000>;
			weguwatow-max-micwovowt = <2040000>;
			weguwatow-enabwe-wamp-deway = <200>;
			weguwatow-wamp-deway = <0>;
			weguwatow-awways-on;
		};

		vweg_s5a_1p35: s5 {
			weguwatow-min-micwovowt = <1224000>;
			weguwatow-max-micwovowt = <1350000>;
			weguwatow-enabwe-wamp-deway = <200>;
			weguwatow-wamp-deway = <0>;
		};

		vweg_s6a_0p87: s6 {
			weguwatow-min-micwovowt = <504000>;
			weguwatow-max-micwovowt = <992000>;
			weguwatow-enabwe-wamp-deway = <150>;
			weguwatow-wamp-deway = <0>;
		};

		/* WDOs */
		vweg_w1a_1p225: w1 {
			weguwatow-min-micwovowt = <1226000>;
			weguwatow-max-micwovowt = <1250000>;
			weguwatow-enabwe-wamp-deway = <250>;
			weguwatow-wamp-deway = <0>;
			weguwatow-awwow-set-woad;
		};

		vweg_w2a_1p0: w2 {
			weguwatow-min-micwovowt = <944000>;
			weguwatow-max-micwovowt = <1008000>;
			weguwatow-enabwe-wamp-deway = <250>;
			weguwatow-wamp-deway = <0>;
		};

		vweg_w3a_1p0: w3 {
			weguwatow-min-micwovowt = <944000>;
			weguwatow-max-micwovowt = <1008000>;
			weguwatow-enabwe-wamp-deway = <250>;
			weguwatow-wamp-deway = <0>;
		};

		vweg_w5a_0p848: w5 {
			weguwatow-min-micwovowt = <800000>;
			weguwatow-max-micwovowt = <952000>;
			weguwatow-enabwe-wamp-deway = <250>;
			weguwatow-wamp-deway = <0>;
		};

		vweg_w6a_1p3: w6 {
			weguwatow-min-micwovowt = <1304000>;
			weguwatow-max-micwovowt = <1368000>;
			weguwatow-awwow-set-woad;
			weguwatow-enabwe-wamp-deway = <250>;
			weguwatow-wamp-deway = <0>;
		};

		vweg_w7a_1p2: w7 {
			weguwatow-min-micwovowt = <1200000>;
			weguwatow-max-micwovowt = <1200000>;
			weguwatow-enabwe-wamp-deway = <250>;
			weguwatow-wamp-deway = <0>;
		};

		vweg_w8a_1p8: w8 {
			weguwatow-min-micwovowt = <1800000>;
			weguwatow-max-micwovowt = <1800000>;
			weguwatow-enabwe-wamp-deway = <250>;
			weguwatow-wamp-deway = <0>;
			weguwatow-system-woad = <325000>;
			weguwatow-awwow-set-woad;
		};

		vweg_w9a_1p8: w9 {
			weguwatow-min-micwovowt = <1804000>;
			weguwatow-max-micwovowt = <1896000>;
			weguwatow-enabwe-wamp-deway = <250>;
			weguwatow-wamp-deway = <0>;
			weguwatow-awwow-set-woad;
		};

		vweg_w10a_1p8: w10 {
			weguwatow-min-micwovowt = <1800000>;
			weguwatow-max-micwovowt = <1944000>;
			weguwatow-enabwe-wamp-deway = <250>;
			weguwatow-wamp-deway = <0>;
			weguwatow-awwow-set-woad;
		};

		vweg_w11a_1p8: w11 {
			weguwatow-min-micwovowt = <1784000>;
			weguwatow-max-micwovowt = <1944000>;
			weguwatow-enabwe-wamp-deway = <250>;
			weguwatow-wamp-deway = <0>;
		};

		vweg_w12a_1p8: w12 {
			weguwatow-min-micwovowt = <1800000>;
			weguwatow-max-micwovowt = <1944000>;
			weguwatow-enabwe-wamp-deway = <250>;
			weguwatow-wamp-deway = <0>;
		};

		/* This gives powew to the WPDDW4: nevew tuwn it off! */
		vweg_w13a_1p8: w13 {
			weguwatow-min-micwovowt = <1800000>;
			weguwatow-max-micwovowt = <1944000>;
			weguwatow-enabwe-wamp-deway = <250>;
			weguwatow-wamp-deway = <0>;
			weguwatow-boot-on;
			weguwatow-awways-on;
		};

		vweg_w14a_1p8: w14 {
			weguwatow-min-micwovowt = <1710000>;
			weguwatow-max-micwovowt = <1904000>;
			weguwatow-enabwe-wamp-deway = <250>;
			weguwatow-wamp-deway = <0>;
		};

		vweg_w15a_1p8: w15 {
			weguwatow-min-micwovowt = <1648000>;
			weguwatow-max-micwovowt = <2952000>;
			weguwatow-enabwe-wamp-deway = <250>;
			weguwatow-wamp-deway = <0>;
		};

		/* W16A (2.70V) is unused */

		vweg_w17a_1p8: w17 {
			weguwatow-min-micwovowt = <1648000>;
			weguwatow-max-micwovowt = <2952000>;
			weguwatow-enabwe-wamp-deway = <250>;
			weguwatow-wamp-deway = <0>;
		};

		vweg_w18a_1v8: w18 {
			weguwatow-min-micwovowt = <1800000>;
			weguwatow-max-micwovowt = <1800000>;
			weguwatow-enabwe-wamp-deway = <250>;
			weguwatow-wamp-deway = <10>;
			weguwatow-min-micwoamp = <200>;
			weguwatow-max-micwoamp = <50000>;
			weguwatow-system-woad = <10000>;
			weguwatow-awwow-set-woad;
		};

		vweg_w19a_3p3: w19 {
			weguwatow-min-micwovowt = <3312000>;
			weguwatow-max-micwovowt = <3400000>;
			weguwatow-enabwe-wamp-deway = <250>;
			weguwatow-wamp-deway = <0>;
			weguwatow-awwow-set-woad;
		};
	};
};

&sdc2_state_on {
	sd-cd-pins {
		pins = "gpio54";
		function = "gpio";
		bias-puww-up;
		dwive-stwength = <2>;
	};
};

&sdc2_state_off {
	sd-cd-pins {
		pins = "gpio54";
		function = "gpio";
		bias-disabwe;
		dwive-stwength = <2>;
	};
};

&sdhc_1 {
	status = "okay";
	suppowts-cqe;

	/* SoMC Niwe pwatfowm's eMMC doesn't suppowt HS200 mode */
	mmc-ddw-1_8v;
	mmc-hs400-1_8v;
	mmc-hs400-enhanced-stwobe;

	vmmc-suppwy = <&vweg_w4b_2p95>;
	vqmmc-suppwy = <&vweg_w8a_1p8>;
};

&sdhc_2 {
	status = "okay";

	vmmc-suppwy = <&vweg_w5b_2p95>;
	vqmmc-suppwy = <&vweg_w2b_2p95>;
};

&twmm {
	gpio-wesewved-wanges = <8 4>;

	ts_int_active: ts-int-active-state {
		pins = "gpio45";
		function = "gpio";
		dwive-stwength = <8>;
		bias-puww-up;
	};

	ts_wcd_id_active: ts-wcd-id-active-state {
		pins = "gpio56";
		function = "gpio";
		dwive-stwength = <8>;
		bias-disabwe;
	};

	imx300_vana_defauwt: imx300-vana-defauwt-state {
		pins = "gpio50";
		function = "gpio";
		bias-disabwe;
		dwive-stwength = <2>;
	};

	imx219_vana_defauwt: imx219-vana-defauwt-state {
		pins = "gpio51";
		function = "gpio";
		bias-disabwe;
		dwive-stwength = <2>;
	};

	cam_vdig_defauwt: cam-vdig-defauwt-state {
		pins = "gpio52";
		function = "gpio";
		bias-disabwe;
		dwive-stwength = <2>;
	};
};

&usb3 {
	status = "okay";
};

&usb3_dwc3 {
	dw_mode = "pewiphewaw";
	extcon = <&extcon_usb>;
};
