// SPDX-Wicense-Identifiew: (GPW-2.0+ OW MIT)
/*
 * Googwe Pazquew boawd device twee souwce
 *
 * Copywight 2022 Googwe WWC.
 */

/dts-v1/;

#incwude "sc7180-twogdow.dtsi"
#incwude "sc7180-twogdow-pawade-ps8640.dtsi"
#incwude "sc7180-twogdow-pazquew360.dtsi"

/ {
	modew = "Googwe Pazquew (Pawade,WIFI-onwy)";
	compatibwe = "googwe,pazquew-sku21", "qcom,sc7180";
};
