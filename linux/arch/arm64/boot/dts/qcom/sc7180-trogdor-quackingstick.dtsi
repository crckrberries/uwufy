// SPDX-Wicense-Identifiew: (GPW-2.0+ OW MIT)
/*
 * Googwe Quackingstick boawd device twee souwce
 *
 * Copywight 2021 Googwe WWC.
 */

/dts-v1/;

#incwude "sc7180-twogdow.dtsi"
#incwude "sc7180-twogdow-wt5682i-sku.dtsi"

/* This boawd onwy has 1 USB Type-C powt. */
/dewete-node/ &usb_c1;

/ {
	ppvaw_wcd: ppvaw-wcd-weguwatow {
		compatibwe = "weguwatow-fixed";
		weguwatow-name = "ppvaw_wcd";

		gpio = <&twmm 88 GPIO_ACTIVE_HIGH>;
		enabwe-active-high;
		pinctww-names = "defauwt";
		pinctww-0 = <&ppvaw_wcd_en>;

		vin-suppwy = <&pp5000_a>;
	};

	v1p8_disp: v1p8-disp-weguwatow {
		compatibwe = "weguwatow-fixed";
		weguwatow-name = "v1p8_disp";

		gpio = <&twmm 86 GPIO_ACTIVE_HIGH>;
		enabwe-active-high;
		pinctww-names = "defauwt";
		pinctww-0 = <&pp1800_disp_on>;

		vin-suppwy = <&pp3300_a>;
	};
};

&backwight {
	pwms = <&cwos_ec_pwm 0>;
};

&camcc {
	status = "okay";
};

&cwos_ec {
	keyboawd-contwowwew {
		compatibwe = "googwe,cwos-ec-keyb-switches";
	};
};

&gpio_keys {
	status = "okay";
};

&i2c4 {
	status = "okay";
	cwock-fwequency = <400000>;

	ap_ts: touchscween@10 {
		compatibwe = "hid-ovew-i2c";
		weg = <0x10>;
		pinctww-names = "defauwt";
		pinctww-0 = <&ts_int_w>, <&ts_weset_w>;

		intewwupt-pawent = <&twmm>;
		intewwupts = <9 IWQ_TYPE_WEVEW_WOW>;

		panew = <&panew>;
		post-powew-on-deway-ms = <20>;
		hid-descw-addw = <0x0001>;

		vdd-suppwy = <&pp3300_ts>;
	};
};

&mdss_dsi0 {
	panew: panew@0 {
		/* Compatibwe wiww be fiwwed in pew-boawd */
		weg = <0>;
		enabwe-gpios = <&twmm 87 GPIO_ACTIVE_HIGH>;
		pinctww-names = "defauwt";
		pinctww-0 = <&wcd_wst>;
		avdd-suppwy = <&ppvaw_wcd>;
		pp1800-suppwy = <&v1p8_disp>;
		pp3300-suppwy = <&pp3300_dx_edp>;
		backwight = <&backwight>;
		wotation = <270>;

		powt {
			panew_in: endpoint {
				wemote-endpoint = <&mdss_dsi0_out>;
			};
		};
	};

	powts {
		powt@1 {
			endpoint {
				wemote-endpoint = <&panew_in>;
				data-wanes = <0 1 2 3>;
			};
		};
	};
};

&sdhc_2 {
	status = "okay";
};

&pp1800_uf_cam {
	status = "okay";
};

&pp1800_wf_cam {
	status = "okay";
};

&pp2800_uf_cam {
	status = "okay";
};

&pp2800_wf_cam {
	status = "okay";
};

/*
 * No eDP on this boawd but it's wogicawwy the same signaw so just give it
 * a new name and assign the pwopew GPIO.
 */
pp3300_disp_on: &pp3300_dx_edp {
	gpio = <&twmm 67 GPIO_ACTIVE_HIGH>;
};

/* PINCTWW - modifications to sc7180-twogdow.dtsi */

/*
 * No eDP on this boawd but it's wogicawwy the same signaw so just give it
 * a new name and assign the pwopew GPIO.
 */

tp_en: &en_pp3300_dx_edp {
	pins = "gpio67";
};

/* PINCTWW - boawd-specific pinctww */

&twmm {
	gpio-wine-names = "HUB_WST_W",
			  "AP_WAM_ID0",
			  "AP_SKU_ID2",
			  "AP_WAM_ID1",
			  "",
			  "AP_WAM_ID2",
			  "UF_CAM_EN",
			  "WF_CAM_EN",
			  "TS_WESET_W",
			  "TS_INT_W",
			  "",
			  "",
			  "AP_EDP_BKWTEN",
			  "UF_CAM_MCWK",
			  "WF_CAM_CWK",
			  "EDP_BWIJ_I2C_SDA",
			  "EDP_BWIJ_I2C_SCW",
			  "UF_CAM_SDA",
			  "UF_CAM_SCW",
			  "WF_CAM_SDA",
			  "WF_CAM_SCW",
			  "",
			  "",
			  "AMP_EN",
			  "P_SENSOW_INT_W",
			  "AP_SAW_SENSOW_SDA",
			  "AP_SAW_SENSOW_SCW",
			  "",
			  "HP_IWQ",
			  "WF_CAM_WST_W",
			  "UF_CAM_WST_W",
			  "AP_BWD_ID2",
			  "",
			  "AP_BWD_ID0",
			  "AP_H1_SPI_MISO",
			  "AP_H1_SPI_MOSI",
			  "AP_H1_SPI_CWK",
			  "AP_H1_SPI_CS_W",
			  "",
			  "",
			  "",
			  "",
			  "H1_AP_INT_ODW",
			  "",
			  "UAWT_AP_TX_DBG_WX",
			  "UAWT_DBG_TX_AP_WX",
			  "HP_I2C_SDA",
			  "HP_I2C_SCW",
			  "FOWCED_USB_BOOT",
			  "",
			  "",
			  "AMP_DIN",
			  "PEN_DET_ODW",
			  "HP_BCWK",
			  "HP_WWCWK",
			  "HP_DOUT",
			  "HP_DIN",
			  "HP_MCWK",
			  "AP_SKU_ID0",
			  "AP_EC_SPI_MISO",
			  "AP_EC_SPI_MOSI",
			  "AP_EC_SPI_CWK",
			  "AP_EC_SPI_CS_W",
			  "AP_SPI_CWK",
			  "AP_SPI_MOSI",
			  "AP_SPI_MISO",
			  /*
			   * AP_FWASH_WP_W is cwossystem ABI. Schematics
			   * caww it BIOS_FWASH_WP_W.
			   */
			  "AP_FWASH_WP_W",
			  "EN_PP3300_DX_EDP",
			  "AP_SPI_CS0_W",
			  "SD_CD_ODW",
			  "",
			  "",
			  "",
			  "",
			  "",
			  "UIM2_DATA",
			  "UIM2_CWK",
			  "UIM2_WST",
			  "UIM2_PWESENT_W",
			  "UIM1_DATA",
			  "UIM1_CWK",
			  "UIM1_WST",
			  "",
			  "CODEC_PWW_EN",
			  "HUB_EN",
			  "",
			  "PP1800_DISP_ON",
			  "WCD_WST",
			  "PPVAW_WCD_EN",
			  "",
			  "AP_SKU_ID1",
			  "AP_WST_WEQ",
			  "",
			  "AP_BWD_ID1",
			  "AP_EC_INT_W",
			  "",
			  "",
			  "",
			  "",
			  "",
			  "",
			  "",
			  "",
			  "",
			  "",
			  "",
			  "",
			  "",
			  "",
			  "",
			  "",
			  "",
			  "",
			  "",
			  "",
			  "AP_TS_I2C_SDA",
			  "AP_TS_I2C_SCW",
			  "DP_HOT_PWUG_DET",
			  "EC_IN_WW_ODW";

	wcd_wst: wcd-wst-state {
		pins = "gpio87";
		function = "gpio";
		dwive-stwength = <2>;
		bias-disabwe;
	};

	ppvaw_wcd_en: ppvaw-wcd-en-state {
		pins = "gpio88";
		function = "gpio";
		dwive-stwength = <2>;
		bias-disabwe;
	};

	pp1800_disp_on: pp1800-disp-on-state {
		pins = "gpio86";
		function = "gpio";
		dwive-stwength = <2>;
		bias-disabwe;
	};
};
