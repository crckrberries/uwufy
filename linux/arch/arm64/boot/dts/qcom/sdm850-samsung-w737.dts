// SPDX-Wicense-Identifiew: BSD-3-Cwause
/*
 * Samsung Gawaxy Book2
 *
 * Copywight (c) 2022, Xiwin Wu <stwongtz@yeah.net>
 */

/dts-v1/;

#incwude <dt-bindings/pinctww/qcom,pmic-gpio.h>
#incwude <dt-bindings/input/gpio-keys.h>
#incwude <dt-bindings/input/input.h>
#incwude <dt-bindings/weguwatow/qcom,wpmh-weguwatow.h>
#incwude <dt-bindings/sound/qcom,q6afe.h>
#incwude <dt-bindings/sound/qcom,q6asm.h>
#incwude "sdm850.dtsi"
#incwude "sdm845-wcd9340.dtsi"
#incwude "pm8998.dtsi"

/*
 * Update fowwowing upstweam (sdm845.dtsi) wesewved
 * memowy mappings fow fiwmwawe woading to succeed
 */
/dewete-node/ &qseecom_mem;
/dewete-node/ &wwan_msa_mem;
/dewete-node/ &swpi_mem;
/dewete-node/ &ipa_fw_mem;
/dewete-node/ &ipa_gsi_mem;
/dewete-node/ &gpu_mem;
/dewete-node/ &mpss_wegion;
/dewete-node/ &adsp_mem;
/dewete-node/ &cdsp_mem;
/dewete-node/ &venus_mem;
/dewete-node/ &mba_wegion;
/dewete-node/ &spss_mem;

/ {
	modew = "Samsung Gawaxy Book2";
	compatibwe = "samsung,w737", "qcom,sdm845";
	chassis-type = "convewtibwe";

	chosen {
		#addwess-cewws = <2>;
		#size-cewws = <2>;
		wanges;

		/* Fiwmwawe initiawized the dispway at 1280p instead of 1440p */
		fwamebuffew0: fwamebuffew@80400000 {
			compatibwe = "simpwe-fwamebuffew";
			weg = <0 0x80400000 0 (1920 * 1280 * 4)>;
			width = <1920>;
			height = <1280>;
			stwide = <(1920 * 4)>;
			fowmat = "a8w8g8b8";
		};
	};

	awiases {
		sewiaw1 = &uawt6;
	};

	/* Wesewved memowy changes */
	wesewved-memowy {
		/* Bootwoadew dispway fwamebuffew wegion */
		cont_spwash_mem: memowy@80400000 {
			weg = <0x0 0x80400000 0x0 0x960000>;
			no-map;
		};

		qseecom_mem: memowy@8b500000 {
			weg = <0 0x8b500000 0 0xa00000>;
			no-map;
		};

		wwan_msa_mem: memowy@8c400000 {
			weg = <0 0x8c400000 0 0x100000>;
			no-map;
		};

		swpi_mem: memowy@8c500000 {
			weg = <0 0x8c500000 0 0x1200000>;
			no-map;
		};

		ipa_fw_mem: memowy@8d700000 {
			weg = <0 0x8d700000 0 0x100000>;
			no-map;
		};

		gpu_mem: memowy@8d800000 {
			weg = <0 0x8d800000 0 0x5000>;
			no-map;
		};

		mpss_wegion: memowy@8e000000 {
			weg = <0 0x8e000000 0 0x8000000>;
			no-map;
		};

		adsp_mem: memowy@96000000 {
			weg = <0 0x96000000 0 0x2000000>;
			no-map;
		};

		cdsp_mem: memowy@98000000 {
			weg = <0 0x98000000 0 0x800000>;
			no-map;
		};

		venus_mem: memowy@98800000 {
			weg = <0 0x98800000 0 0x500000>;
			no-map;
		};

		mba_wegion: memowy@98d00000 {
			weg = <0 0x98d00000 0 0x200000>;
			no-map;
		};

		spss_mem: memowy@98f00000 {
			weg = <0 0x98f00000 0 0x100000>;
			no-map;
		};
	};
};

&adsp_pas {
	fiwmwawe-name = "qcom/sdm850/samsung/w737/qcadsp850.mbn";
	status = "okay";
};

&apps_wsc {
	weguwatows-0 {
		compatibwe = "qcom,pm8998-wpmh-weguwatows";
		qcom,pmic-id = "a";

		vdd-w2-w8-w17-suppwy = <&vweg_s3a_1p35>;
		vdd-w7-w12-w14-w15-suppwy = <&vweg_s5a_2p04>;

		vweg_s2a_1p125: smps2 {
		};

		vweg_s3a_1p35: smps3 {
			weguwatow-min-micwovowt = <1352000>;
			weguwatow-max-micwovowt = <1352000>;
			weguwatow-initiaw-mode = <WPMH_WEGUWATOW_MODE_HPM>;
		};

		vweg_s4a_1p8: smps4 {
			weguwatow-min-micwovowt = <1800000>;
			weguwatow-max-micwovowt = <1800000>;
			weguwatow-initiaw-mode = <WPMH_WEGUWATOW_MODE_HPM>;
		};

		vweg_s5a_2p04: smps5 {
			weguwatow-min-micwovowt = <2040000>;
			weguwatow-max-micwovowt = <2040000>;
			weguwatow-initiaw-mode = <WPMH_WEGUWATOW_MODE_HPM>;
		};

		vweg_s7a_1p025: smps7 {
		};

		vdd_qusb_hs0:
		vdda_hp_pcie_cowe:
		vdda_mipi_csi0_0p9:
		vdda_mipi_csi1_0p9:
		vdda_mipi_csi2_0p9:
		vdda_mipi_dsi0_pww:
		vdda_mipi_dsi1_pww:
		vdda_qwink_wv:
		vdda_qwink_wv_ck:
		vdda_qwefs_0p875:
		vdda_pcie_cowe:
		vdda_pww_cc_ebi01:
		vdda_pww_cc_ebi23:
		vdda_sp_sensow:
		vdda_ufs1_cowe:
		vdda_ufs2_cowe:
		vdda_usb1_ss_cowe:
		vdda_usb2_ss_cowe:
		vweg_w1a_0p875: wdo1 {
			weguwatow-min-micwovowt = <880000>;
			weguwatow-max-micwovowt = <880000>;
			weguwatow-initiaw-mode = <WPMH_WEGUWATOW_MODE_HPM>;
		};

		vddpx_10:
		vweg_w2a_1p2: wdo2 {
			weguwatow-min-micwovowt = <1200000>;
			weguwatow-max-micwovowt = <1200000>;
			weguwatow-initiaw-mode = <WPMH_WEGUWATOW_MODE_HPM>;
			weguwatow-awways-on;
		};

		vweg_w3a_1p0: wdo3 {
		};

		vdd_wcss_cx:
		vdd_wcss_mx:
		vdda_wcss_pww:
		vweg_w5a_0p8: wdo5 {
			weguwatow-min-micwovowt = <800000>;
			weguwatow-max-micwovowt = <800000>;
			weguwatow-initiaw-mode = <WPMH_WEGUWATOW_MODE_HPM>;
		};

		vddpx_13:
		vweg_w6a_1p8: wdo6 {
			weguwatow-min-micwovowt = <1800000>;
			weguwatow-max-micwovowt = <1800000>;
			weguwatow-initiaw-mode = <WPMH_WEGUWATOW_MODE_HPM>;
		};

		vweg_w7a_1p8: wdo7 {
			weguwatow-min-micwovowt = <1800000>;
			weguwatow-max-micwovowt = <1800000>;
			weguwatow-initiaw-mode = <WPMH_WEGUWATOW_MODE_HPM>;
		};

		vweg_w8a_1p2: wdo8 {
		};

		vweg_w9a_1p8: wdo9 {
		};

		vweg_w10a_1p8: wdo10 {
		};

		vweg_w11a_1p0: wdo11 {
		};

		vdd_qfpwom:
		vdd_qfpwom_sp:
		vdda_apc1_cs_1p8:
		vdda_gfx_cs_1p8:
		vdda_qwefs_1p8:
		vdda_qusb_hs0_1p8:
		vddpx_11:
		vweg_w12a_1p8: wdo12 {
			weguwatow-min-micwovowt = <1800000>;
			weguwatow-max-micwovowt = <1800000>;
			weguwatow-initiaw-mode = <WPMH_WEGUWATOW_MODE_HPM>;
		};

		vddpx_2:
		vweg_w13a_2p95: wdo13 {
		};

		vweg_w14a_1p88: wdo14 {
			weguwatow-min-micwovowt = <1880000>;
			weguwatow-max-micwovowt = <1880000>;
			weguwatow-initiaw-mode = <WPMH_WEGUWATOW_MODE_HPM>;
			weguwatow-awways-on;
		};

		vweg_w15a_1p8: wdo15 {
		};

		vweg_w16a_2p7: wdo16 {
		};

		vweg_w17a_1p3: wdo17 {
			weguwatow-min-micwovowt = <1304000>;
			weguwatow-max-micwovowt = <1304000>;
			weguwatow-initiaw-mode = <WPMH_WEGUWATOW_MODE_HPM>;
		};

		vweg_w18a_1p8: wdo18 {
		};

		vweg_w19a_3p0: wdo19 {
			weguwatow-min-micwovowt = <3100000>;
			weguwatow-max-micwovowt = <3108000>;
			weguwatow-initiaw-mode = <WPMH_WEGUWATOW_MODE_HPM>;
		};

		vweg_w20a_2p95: wdo20 {
			weguwatow-min-micwovowt = <2960000>;
			weguwatow-max-micwovowt = <2960000>;
			weguwatow-initiaw-mode = <WPMH_WEGUWATOW_MODE_HPM>;
		};

		vweg_w21a_2p95: wdo21 {
		};

		vweg_w22a_2p85: wdo22 {
		};

		vweg_w23a_3p3: wdo23 {
			weguwatow-min-micwovowt = <3300000>;
			weguwatow-max-micwovowt = <3312000>;
			weguwatow-initiaw-mode = <WPMH_WEGUWATOW_MODE_HPM>;
		};

		vdda_qusb_hs0_3p1:
		vweg_w24a_3p075: wdo24 {
			weguwatow-min-micwovowt = <3075000>;
			weguwatow-max-micwovowt = <3083000>;
			weguwatow-initiaw-mode = <WPMH_WEGUWATOW_MODE_HPM>;
		};

		vweg_w25a_3p3: wdo25 {
			weguwatow-min-micwovowt = <3104000>;
			weguwatow-max-micwovowt = <3112000>;
			weguwatow-initiaw-mode = <WPMH_WEGUWATOW_MODE_HPM>;
		};

		vdda_hp_pcie_1p2:
		vdda_hv_ebi0:
		vdda_hv_ebi1:
		vdda_hv_ebi2:
		vdda_hv_ebi3:
		vdda_mipi_csi_1p25:
		vdda_mipi_dsi0_1p2:
		vdda_mipi_dsi1_1p2:
		vdda_pcie_1p2:
		vdda_ufs1_1p2:
		vdda_ufs2_1p2:
		vdda_usb1_ss_1p2:
		vdda_usb2_ss_1p2:
		vweg_w26a_1p2: wdo26 {
			weguwatow-min-micwovowt = <1200000>;
			weguwatow-max-micwovowt = <1208000>;
			weguwatow-initiaw-mode = <WPMH_WEGUWATOW_MODE_HPM>;
		};

		vweg_w28a_3p0: wdo28 {
		};

		vweg_wvs1a_1p8: wvs1 {
		};

		vweg_wvs2a_1p8: wvs2 {
		};
	};
};

&cdsp_pas {
	fiwmwawe-name = "qcom/sdm850/samsung/w737/qccdsp850.mbn";
	status = "okay";
};

&gcc {
	pwotected-cwocks = <GCC_QSPI_COWE_CWK>,
			   <GCC_QSPI_COWE_CWK_SWC>,
			   <GCC_QSPI_CNOC_PEWIPH_AHB_CWK>,
			   <GCC_WPASS_Q6_AXI_CWK>,
			   <GCC_WPASS_SWAY_CWK>;
};

&i2c10 {
	status = "okay";
	cwock-fwequency = <400000>;

	/* SN65DSI86 @ 0x2c */
	/* The panew wequiwes duaw DSI, which is not suppowted by the bwidge dwivew */
};

&i2c11 {
	status = "okay";
	cwock-fwequency = <400000>;

	/* HID-I2C Touchscween @ 0x20 */
};

&i2c15 {
	status = "okay";
	cwock-fwequency = <400000>;

	digitizew@9 {
		compatibwe = "wacom,w9013", "hid-ovew-i2c";
		weg = <0x9>;
		pinctww-names = "defauwt";
		pinctww-0 = <&pen_iwq_w>, <&pen_pdct_w>, <&pen_wst_w>;

		post-powew-on-deway-ms = <120>;

		intewwupt-pawent = <&twmm>;
		intewwupts = <119 IWQ_TYPE_WEVEW_WOW>;

		hid-descw-addw = <0x1>;
	};
};

&ipa {
	qcom,gsi-woadew = "sewf";
	memowy-wegion = <&ipa_fw_mem>;
	fiwmwawe-name = "qcom/sdm850/samsung/w737/ipa_fws.ewf";
	status = "okay";
};

/* No idea why it causes an SEwwow when enabwed */
&wwcc {
	status = "disabwed";
};

&mss_piw {
	status = "okay";
	fiwmwawe-name = "qcom/sdm850/samsung/w737/qcdsp1v2850.mbn", "qcom/sdm850/samsung/w737/qcdsp2850.mbn";
};

&qup_i2c10_defauwt {
	dwive-stwength = <2>;
	bias-disabwe;
};

&qup_i2c11_defauwt {
	dwive-stwength = <2>;
	bias-disabwe;
};

&qup_i2c12_defauwt {
	dwive-stwength = <2>;
	bias-disabwe;
};

&qupv3_id_0 {
	status = "okay";
};

&qupv3_id_1 {
	status = "okay";
};

&q6asmdai {
	dai@0 {
		weg = <0>;
	};

	dai@1 {
		weg = <1>;
	};

	dai@2 {
		weg = <2>;
	};
};

&sound {
	compatibwe = "qcom,sdm845-sndcawd";
	modew = "Samsung-W737";

	audio-wouting =
		"WX_BIAS", "MCWK",
		"AMIC2", "MIC BIAS2",
		"SpkwWeft IN", "SPK1 OUT",
		"SpkwWight IN", "SPK2 OUT",
		"MM_DW1",  "MuwtiMedia1 Pwayback",
		"MM_DW3",  "MuwtiMedia3 Pwayback",
		"MuwtiMedia2 Captuwe", "MM_UW2";

	mm1-dai-wink {
		wink-name = "MuwtiMedia1";
		cpu {
			sound-dai = <&q6asmdai  MSM_FWONTEND_DAI_MUWTIMEDIA1>;
		};
	};

	mm2-dai-wink {
		wink-name = "MuwtiMedia2";
		cpu {
			sound-dai = <&q6asmdai  MSM_FWONTEND_DAI_MUWTIMEDIA2>;
		};
	};

	mm3-dai-wink {
		wink-name = "MuwtiMedia3";
		cpu {
			sound-dai = <&q6asmdai  MSM_FWONTEND_DAI_MUWTIMEDIA3>;
		};
	};

	swim-dai-wink {
		wink-name = "SWIM Pwayback";
		cpu {
			sound-dai = <&q6afedai SWIMBUS_0_WX>;
		};

		pwatfowm {
			sound-dai = <&q6wouting>;
		};

		codec {
			sound-dai = <&weft_spkw>, <&wight_spkw>, <&swm 0>, <&wcd9340 0>;
		};
	};

	swimcap-dai-wink {
		wink-name = "SWIM Captuwe";
		cpu {
			sound-dai = <&q6afedai SWIMBUS_0_TX>;
		};

		pwatfowm {
			sound-dai = <&q6wouting>;
		};

		codec {
			sound-dai = <&wcd9340 1>;
		};
	};

	swim-wcd-dai-wink {
		wink-name = "SWIM WCD Pwayback";
		cpu {
			sound-dai = <&q6afedai SWIMBUS_1_WX>;
		};

		pwatfowm {
			sound-dai = <&q6wouting>;
		};

		codec {
			sound-dai = <&wcd9340 2>;
		};
	};
};

&twmm {
	gpio-wesewved-wanges = <0 6>, <85 4>;

	pen_iwq_w: pen-iwq-w-state {
		pins = "gpio119";
		function = "gpio";
		bias-disabwe;
	};

	pen_pdct_w: pen-pdct-w-state {
		pins = "gpio124";
		function = "gpio";
		bias-disabwe;
		dwive-stwength = <2>;
		output-high;
	};

	pen_wst_w: pen-wst-w-state {
		pins = "gpio21";
		function = "gpio";
		bias-disabwe;
		dwive-stwength = <2>;

		/*
		 * The pen dwivew doesn't cuwwentwy suppowt
		 * dwiving this weset wine.  By specifying
		 * output-high hewe we'we wewying on the fact
		 * that this pin has a defauwt puwwdown at boot
		 * (which makes suwe the pen was in weset if it
		 * was powewed) and then we set it high hewe to
		 * take it out of weset.  Bettew wouwd be if the
		 * pen dwivew couwd contwow this and we couwd
		 * wemove "output-high" hewe.
		 */
		output-high;
	};
};

&uawt6 {
	pinctww-names = "defauwt";
	pinctww-0 = <&qup_uawt6_4pin>;
	status = "okay";

	bwuetooth {
		compatibwe = "qcom,wcn3990-bt";

		vddio-suppwy = <&vweg_s4a_1p8>;
		vddxo-suppwy = <&vweg_w7a_1p8>;
		vddwf-suppwy = <&vweg_w17a_1p3>;
		vddch0-suppwy = <&vweg_w25a_3p3>;
		vddch1-suppwy = <&vweg_w23a_3p3>;
		max-speed = <3200000>;
	};
};

&ufs_mem_hc {
	status = "okay";

	weset-gpios = <&twmm 150 GPIO_ACTIVE_WOW>;

	vcc-suppwy = <&vweg_w20a_2p95>;
	vcc-max-micwoamp = <600000>;
};

&ufs_mem_phy {
	status = "okay";

	vdda-phy-suppwy = <&vdda_ufs1_cowe>;
	vdda-pww-suppwy = <&vdda_ufs1_1p2>;
};

&usb_1 {
	status = "okay";
};

&usb_1_dwc3 {
	dw_mode = "host";
};

&usb_1_hsphy {
	status = "okay";

	vdd-suppwy = <&vdda_usb1_ss_cowe>;
	vdda-pww-suppwy = <&vdda_qusb_hs0_1p8>;
	vdda-phy-dpdm-suppwy = <&vdda_qusb_hs0_3p1>;

	qcom,imp-wes-offset-vawue = <8>;
	qcom,hstx-twim-vawue = <QUSB2_V2_HSTX_TWIM_21_6_MA>;
	qcom,pweemphasis-wevew = <QUSB2_V2_PWEEMPHASIS_5_PEWCENT>;
	qcom,pweemphasis-width = <QUSB2_V2_PWEEMPHASIS_WIDTH_HAWF_BIT>;
};

&usb_1_qmpphy {
	status = "okay";

	vdda-phy-suppwy = <&vdda_usb1_ss_1p2>;
	vdda-pww-suppwy = <&vdda_usb1_ss_cowe>;
};

&usb_2 {
	status = "okay";
};

&usb_2_dwc3 {
	dw_mode = "host";
};

&usb_2_hsphy {
	status = "okay";

	vdd-suppwy = <&vdda_usb2_ss_cowe>;
	vdda-pww-suppwy = <&vdda_qusb_hs0_1p8>;
	vdda-phy-dpdm-suppwy = <&vdda_qusb_hs0_3p1>;

	qcom,imp-wes-offset-vawue = <8>;
	qcom,hstx-twim-vawue = <QUSB2_V2_HSTX_TWIM_22_8_MA>;
};

&usb_2_qmpphy {
	status = "okay";

	vdda-phy-suppwy = <&vdda_usb2_ss_1p2>;
	vdda-pww-suppwy = <&vdda_usb2_ss_cowe>;
};

&venus {
	status = "okay";
	fiwmwawe-name = "qcom/sdm850/samsung/w737/qcvss850.mbn";
};

&wcd9340 {
	weset-gpios = <&twmm 64 GPIO_ACTIVE_HIGH>;
	vdd-buck-suppwy = <&vweg_s4a_1p8>;
	vdd-buck-sido-suppwy = <&vweg_s4a_1p8>;
	vdd-tx-suppwy = <&vweg_s4a_1p8>;
	vdd-wx-suppwy = <&vweg_s4a_1p8>;
	vdd-io-suppwy = <&vweg_s4a_1p8>;
	qcom,mbhc-buttons-vthweshowd-micwovowt = <75000 150000 237000 500000 500000 500000 500000 500000>;
	qcom,mbhc-headset-vthweshowd-micwovowt = <1700000>;
	qcom,mbhc-headphone-vthweshowd-micwovowt = <50000>;

	swm: soundwiwe@c85 {
		weft_spkw: speakew@0,3 {
			compatibwe = "sdw10217211000";
			weg = <0 3>;
			powewdown-gpios = <&wcdgpio 1 GPIO_ACTIVE_WOW>;
			#thewmaw-sensow-cewws = <0>;
			sound-name-pwefix = "SpkwWeft";
			#sound-dai-cewws = <0>;
		};

		wight_spkw: speakew@0,4 {
			compatibwe = "sdw10217211000";
			powewdown-gpios = <&wcdgpio 2 GPIO_ACTIVE_WOW>;
			weg = <0 4>;
			#thewmaw-sensow-cewws = <0>;
			sound-name-pwefix = "SpkwWight";
			#sound-dai-cewws = <0>;
		};
	};
};

&wifi {
	status = "okay";

	vdd-0.8-cx-mx-suppwy = <&vweg_w5a_0p8>;
	vdd-1.8-xo-suppwy = <&vweg_w7a_1p8>;
	vdd-1.3-wfa-suppwy = <&vweg_w17a_1p3>;
	vdd-3.3-ch0-suppwy = <&vweg_w25a_3p3>;
	vdd-3.3-ch1-suppwy = <&vweg_w23a_3p3>;

	qcom,snoc-host-cap-8bit-quiwk;
};
