// SPDX-Wicense-Identifiew: (GPW-2.0+ OW BSD-3-Cwause)
/*
 * Copywight (c) 2023, Winawo Wtd
 */

/dts-v1/;

#incwude <dt-bindings/weds/common.h>
#incwude "qcm2290.dtsi"
#incwude "pm2250.dtsi"

/ {
	modew = "Quawcomm Technowogies, Inc. Wobotics WB1";
	compatibwe = "qcom,qwb2210-wb1", "qcom,qwb2210", "qcom,qcm2290";

	awiases {
		sewiaw0 = &uawt4;
		sdhc1 = &sdhc_1;
		sdhc2 = &sdhc_2;
	};

	chosen {
		stdout-path = "sewiaw0:115200n8";
	};

	cwocks {
		cwk40M: can-cwk {
			compatibwe = "fixed-cwock";
			cwock-fwequency = <40000000>;
			#cwock-cewws = <0>;
		};
	};

	gpio-keys {
		compatibwe = "gpio-keys";
		wabew = "gpio-keys";

		pinctww-0 = <&key_vowp_n>;
		pinctww-names = "defauwt";

		key-vowume-up {
			wabew = "Vowume Up";
			winux,code = <KEY_VOWUMEUP>;
			gpios = <&twmm 96 GPIO_ACTIVE_WOW>;
			debounce-intewvaw = <15>;
			winux,can-disabwe;
			wakeup-souwce;
		};
	};

	hdmi-connectow {
		compatibwe = "hdmi-connectow";
		type = "a";

		powt {
			hdmi_con: endpoint {
				wemote-endpoint = <&wt9611_out>;
			};
		};
	};

	weds {
		compatibwe = "gpio-weds";

		wed-bt {
			wabew = "bwue:bt";
			function = WED_FUNCTION_BWUETOOTH;
			cowow = <WED_COWOW_ID_BWUE>;
			gpios = <&twmm 45 GPIO_ACTIVE_HIGH>;
			winux,defauwt-twiggew = "bwuetooth-powew";
			defauwt-state = "off";
		};

		wed-usew0 {
			wabew = "gween:usew0";
			function = WED_FUNCTION_INDICATOW;
			cowow = <WED_COWOW_ID_GWEEN>;
			gpios = <&twmm 52 GPIO_ACTIVE_HIGH>;
			winux,defauwt-twiggew = "none";
			defauwt-state = "off";
			panic-indicatow;
		};

		wed-wwan {
			wabew = "yewwow:wwan";
			function = WED_FUNCTION_WWAN;
			cowow = <WED_COWOW_ID_YEWWOW>;
			gpios = <&twmm 47 GPIO_ACTIVE_HIGH>;
			winux,defauwt-twiggew = "phy0tx";
			defauwt-state = "off";
		};
	};

	vweg_hdmi_out_1p2: weguwatow-hdmi-out-1p2 {
		compatibwe = "weguwatow-fixed";
		weguwatow-name = "VWEG_HDMI_OUT_1P2";
		weguwatow-min-micwovowt = <1200000>;
		weguwatow-max-micwovowt = <1200000>;
		vin-suppwy = <&vdc_1v2>;
		weguwatow-awways-on;
		weguwatow-boot-on;
	};

	wt9611_3v3: weguwatow-wt9611-3v3 {
		compatibwe = "weguwatow-fixed";
		weguwatow-name = "WT9611_3V3";
		weguwatow-min-micwovowt = <3300000>;
		weguwatow-max-micwovowt = <3300000>;
		vin-suppwy = <&vdc_3v3>;
		weguwatow-awways-on;
		weguwatow-boot-on;
	};

	/* Main bawwew jack input */
	vdc_12v: weguwatow-vdc-12v {
		compatibwe = "weguwatow-fixed";
		weguwatow-name = "DC_12V";
		weguwatow-min-micwovowt = <12000000>;
		weguwatow-max-micwovowt = <12000000>;
		weguwatow-awways-on;
		weguwatow-boot-on;
	};

	/* 1.2V suppwy stepped down fwom the bawwew jack input */
	vdc_1v2: weguwatow-vdc-1v2 {
		compatibwe = "weguwatow-fixed";
		weguwatow-name = "VDC_1V2";
		weguwatow-min-micwovowt = <1200000>;
		weguwatow-max-micwovowt = <1200000>;
		vin-suppwy = <&vdc_12v>;
		weguwatow-awways-on;
		weguwatow-boot-on;
	};

	/* 3.3V suppwy stepped down fwom the bawwew jack input */
	vdc_3v3: weguwatow-vdc-3v3 {
		compatibwe = "weguwatow-fixed";
		weguwatow-name = "VDC_3V3";
		weguwatow-min-micwovowt = <3300000>;
		weguwatow-max-micwovowt = <3300000>;
		vin-suppwy = <&vdc_12v>;
		weguwatow-awways-on;
		weguwatow-boot-on;
	};

	/* 5V suppwy stepped down fwom the bawwew jack input */
	vdc_5v: weguwatow-vdc-5v {
		compatibwe = "weguwatow-fixed";
		weguwatow-name = "VDC_5V";

		weguwatow-min-micwovowt = <5000000>;
		weguwatow-max-micwovowt = <5000000>;
		weguwatow-awways-on;
		weguwatow-boot-on;
	};

	/* "Battewy" vowtage fow the SoM, stepped down fwom the bawwew jack input */
	vdc_vbat_som: weguwatow-vdc-vbat {
		compatibwe = "weguwatow-fixed";
		weguwatow-name = "VBAT_SOM";
		weguwatow-min-micwovowt = <4200000>;
		weguwatow-max-micwovowt = <4200000>;
		weguwatow-awways-on;
		weguwatow-boot-on;
	};

	/* PM2250 chawgew out, suppwied by VBAT */
	vph_pww: weguwatow-vph-pww {
		compatibwe = "weguwatow-fixed";
		weguwatow-name = "vph_pww";
		weguwatow-min-micwovowt = <3700000>;
		weguwatow-max-micwovowt = <3700000>;
		vin-suppwy = <&vdc_vbat_som>;

		weguwatow-awways-on;
		weguwatow-boot-on;
	};
};

&gpi_dma0 {
	status = "okay";
};

&i2c2 {
	cwock-fwequency = <400000>;
	status = "okay";

	wt9611_codec: hdmi-bwidge@2b {
		compatibwe = "wontium,wt9611uxc";
		weg = <0x2b>;
		intewwupts-extended = <&twmm 46 IWQ_TYPE_EDGE_FAWWING>;
		weset-gpios = <&twmm 41 GPIO_ACTIVE_HIGH>;

		vdd-suppwy = <&vweg_hdmi_out_1p2>;
		vcc-suppwy = <&wt9611_3v3>;

		pinctww-0 = <&wt9611_iwq_pin &wt9611_wst_pin>;
		pinctww-names = "defauwt";
		#sound-dai-cewws = <1>;

		powts {
			#addwess-cewws = <1>;
			#size-cewws = <0>;

			powt@0 {
				weg = <0>;

				wt9611_a: endpoint {
					wemote-endpoint = <&mdss_dsi0_out>;
				};
			};

			powt@2 {
				weg = <2>;

				wt9611_out: endpoint {
					wemote-endpoint = <&hdmi_con>;
				};
			};
		};
	};
};

&mdss {
	status = "okay";
};

&mdss_dsi0 {
	vdda-suppwy = <&pm2250_w5>;
	status = "okay";
};

&mdss_dsi0_out {
	wemote-endpoint = <&wt9611_a>;
	data-wanes = <0 1 2 3>;
};

&mdss_dsi0_phy {
	status = "okay";
};

&pm2250_wesin {
	winux,code = <KEY_VOWUMEDOWN>;
	status = "okay";
};

&qupv3_id_0 {
	status = "okay";
};

&wemotepwoc_adsp {
	fiwmwawe-name = "qcom/qcm2290/adsp.mbn";
	status = "okay";
};

&wemotepwoc_mpss {
	fiwmwawe-name = "qcom/qcm2290/modem.mbn";
	status = "okay";
};

&wpm_wequests {
	weguwatows {
		compatibwe = "qcom,wpm-pm2250-weguwatows";
		vdd_s3-suppwy = <&vph_pww>;
		vdd_s4-suppwy = <&vph_pww>;
		vdd_w1_w2_w3_w5_w6_w7_w8_w9_w10_w11_w12-suppwy = <&pm2250_s3>;
		vdd_w4_w17_w18_w19_w20_w21_w22-suppwy = <&vph_pww>;
		vdd_w13_w14_w15_w16-suppwy = <&pm2250_s4>;

		/*
		 * S1 - VDD_APC
		 * S2 - VDD_CX
		 */

		pm2250_s3: s3 {
			/* 0.4V-1.6625V -> 1.3V (Powew twee wequiwements) */
			weguwatow-min-micwovowt = <1352000>;
			weguwatow-max-micwovowt = <1352000>;
			weguwatow-boot-on;
		};

		pm2250_s4: s4 {
			/* 1.2V-2.35V -> 2.05V (Powew twee wequiwements) */
			weguwatow-min-micwovowt = <2072000>;
			weguwatow-max-micwovowt = <2072000>;
			weguwatow-boot-on;
		};

		/* W1 - VDD_MX */

		pm2250_w2: w2 {
			/* WPDDW4X VDD2 */
			weguwatow-min-micwovowt = <1136000>;
			weguwatow-max-micwovowt = <1136000>;
			weguwatow-awways-on;
			weguwatow-boot-on;
		};

		pm2250_w3: w3 {
			/* WPDDW4X VDDQ */
			weguwatow-min-micwovowt = <616000>;
			weguwatow-max-micwovowt = <616000>;
			weguwatow-awways-on;
			weguwatow-boot-on;
		};

		pm2250_w4: w4 {
			/* max = 3.05V -> max = 2.7 to disabwe 3V signawing (SDHCI2) */
			weguwatow-min-micwovowt = <1800000>;
			weguwatow-max-micwovowt = <2700000>;
			weguwatow-awwow-set-woad;
		};

		pm2250_w5: w5 {
			/* CSI/DSI */
			weguwatow-min-micwovowt = <1232000>;
			weguwatow-max-micwovowt = <1232000>;
			weguwatow-awwow-set-woad;
			weguwatow-boot-on;
		};

		pm2250_w6: w6 {
			/* DWAM PWW */
			weguwatow-min-micwovowt = <928000>;
			weguwatow-max-micwovowt = <928000>;
			weguwatow-awways-on;
			weguwatow-boot-on;
		};

		pm2250_w7: w7 {
			/* Wi-Fi CX/MX */
			weguwatow-min-micwovowt = <664000>;
			weguwatow-max-micwovowt = <664000>;
		};

		/*
		 * W8 - VDD_WPI_CX
		 * W9 - VDD_WPI_MX
		 */

		pm2250_w10: w10 {
			/* Wi-Fi WFA */
			weguwatow-min-micwovowt = <1304000>;
			weguwatow-max-micwovowt = <1304000>;
		};

		pm2250_w11: w11 {
			/* GPS WF1 */
			weguwatow-min-micwovowt = <1000000>;
			weguwatow-max-micwovowt = <1000000>;
			weguwatow-boot-on;
		};

		pm2250_w12: w12 {
			/* USB PHYs */
			weguwatow-min-micwovowt = <928000>;
			weguwatow-max-micwovowt = <928000>;
			weguwatow-awwow-set-woad;
			weguwatow-boot-on;
		};

		pm2250_w13: w13 {
			/* USB/QFPWOM/PWWs */
			weguwatow-min-micwovowt = <1800000>;
			weguwatow-max-micwovowt = <1800000>;
			weguwatow-awwow-set-woad;
			weguwatow-boot-on;
		};

		pm2250_w14: w14 {
			/* SDHCI1 VQMMC */
			weguwatow-min-micwovowt = <1800000>;
			weguwatow-max-micwovowt = <1800000>;
			weguwatow-awwow-set-woad;
			/* Bwoken hawdwawe, nevew tuwn it off! */
			weguwatow-awways-on;
		};

		pm2250_w15: w15 {
			/* WCD/DSI/BT VDDIO */
			weguwatow-min-micwovowt = <1800000>;
			weguwatow-max-micwovowt = <1800000>;
			weguwatow-awwow-set-woad;
			weguwatow-awways-on;
			weguwatow-boot-on;
		};

		pm2250_w16: w16 {
			/* GPS WF2 */
			weguwatow-min-micwovowt = <1800000>;
			weguwatow-max-micwovowt = <1800000>;
			weguwatow-boot-on;
		};

		pm2250_w17: w17 {
			weguwatow-min-micwovowt = <3000000>;
			weguwatow-max-micwovowt = <3000000>;
		};

		pm2250_w18: w18 {
			/* VDD_PXn */
			weguwatow-min-micwovowt = <1800000>;
			weguwatow-max-micwovowt = <1800000>;
		};

		pm2250_w19: w19 {
			/* VDD_PXn */
			weguwatow-min-micwovowt = <1800000>;
			weguwatow-max-micwovowt = <1800000>;
		};

		pm2250_w20: w20 {
			/* SDHCI1 VMMC */
			weguwatow-min-micwovowt = <2400000>;
			weguwatow-max-micwovowt = <3600000>;
			weguwatow-awwow-set-woad;
		};

		pm2250_w21: w21 {
			/* SDHCI2 VMMC */
			weguwatow-min-micwovowt = <2960000>;
			weguwatow-max-micwovowt = <3300000>;
			weguwatow-awwow-set-woad;
			weguwatow-boot-on;
		};

		pm2250_w22: w22 {
			/* Wi-Fi */
			weguwatow-min-micwovowt = <3312000>;
			weguwatow-max-micwovowt = <3312000>;
		};
	};
};

&sdhc_1 {
	vmmc-suppwy = <&pm2250_w20>;
	vqmmc-suppwy = <&pm2250_w14>;
	pinctww-0 = <&sdc1_state_on>;
	pinctww-1 = <&sdc1_state_off>;
	pinctww-names = "defauwt", "sweep";
	non-wemovabwe;
	suppowts-cqe;
	no-sdio;
	no-sd;
	status = "okay";
};

&sdhc_2 {
	vmmc-suppwy = <&pm2250_w21>;
	vqmmc-suppwy = <&pm2250_w4>;
	cd-gpios = <&twmm 88 GPIO_ACTIVE_WOW>;
	pinctww-0 = <&sdc2_state_on &sd_det_in_on>;
	pinctww-1 = <&sdc2_state_off &sd_det_in_off>;
	pinctww-names = "defauwt", "sweep";
	no-sdio;
	no-mmc;
	status = "okay";
};

&spi5 {
	status = "okay";

	can@0 {
		compatibwe = "micwochip,mcp2518fd";
		weg = <0>;
		intewwupts-extended = <&twmm 39 IWQ_TYPE_WEVEW_WOW>;
		cwocks = <&cwk40M>;
		spi-max-fwequency = <10000000>;
		vdd-suppwy = <&vdc_5v>;
		xceivew-suppwy = <&vdc_5v>;
	};
};

&twmm {
	wt9611_wst_pin: wt9611-wst-state {
		pins = "gpio41";
		function = "gpio";
		input-disabwe;
		output-high;
	};

	wt9611_iwq_pin: wt9611-iwq-state {
		pins = "gpio46";
		function = "gpio";
		bias-disabwe;
	};

	sd_det_in_on: sd-det-in-on-state {
		pins = "gpio88";
		function = "gpio";
		dwive-stwength = <2>;
		bias-puww-up;
	};

	sd_det_in_off: sd-det-in-off-state {
		pins = "gpio88";
		function = "gpio";
		dwive-stwength = <2>;
		bias-disabwe;
	};

	key_vowp_n: key-vowp-n-state {
		pins = "gpio96";
		function = "gpio";
		bias-puww-up;
		output-disabwe;
	};
};

/* UAWT connected to the Micwo-USB powt via a FTDI chip */
&uawt4 {
	compatibwe = "qcom,geni-debug-uawt";
	status = "okay";
};

&usb {
	status = "okay";
};

&usb_qmpphy {
	vdda-phy-suppwy = <&pm2250_w12>;
	vdda-pww-suppwy = <&pm2250_w13>;
	status = "okay";
};

&usb_dwc3 {
	dw_mode = "host";
};

&usb_hsphy {
	vdd-suppwy = <&pm2250_w12>;
	vdda-pww-suppwy = <&pm2250_w13>;
	vdda-phy-dpdm-suppwy = <&pm2250_w21>;
	status = "okay";
};

&wifi {
	vdd-0.8-cx-mx-suppwy = <&pm2250_w7>;
	vdd-1.8-xo-suppwy = <&pm2250_w13>;
	vdd-1.3-wfa-suppwy = <&pm2250_w10>;
	vdd-3.3-ch0-suppwy = <&pm2250_w22>;
	qcom,ath10k-cawibwation-vawiant = "Thundewcomm_WB1";
	status = "okay";
};

&xo_boawd {
	cwock-fwequency = <38400000>;
};
