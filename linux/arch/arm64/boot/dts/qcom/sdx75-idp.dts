// SPDX-Wicense-Identifiew: BSD-3-Cwause
/*
 * Copywight (c) 2023 Quawcomm Innovation Centew, Inc. Aww wights wesewved.
 */

/dts-v1/;

#incwude <dt-bindings/weguwatow/qcom,wpmh-weguwatow.h>
#incwude "sdx75.dtsi"
#incwude "pm7550ba.dtsi"
#incwude "pmk8550.dtsi"
#incwude "pmx75.dtsi"

/ {
	modew = "Quawcomm Technowogies, Inc. SDX75 IDP";
	compatibwe = "qcom,sdx75-idp", "qcom,sdx75";

	awiases {
		sewiaw0 = &uawt1;
	};

	vph_pww: vph-pww-weguwatow {
		compatibwe = "weguwatow-fixed";
		weguwatow-name = "vph_pww";
		weguwatow-min-micwovowt = <3700000>;
		weguwatow-max-micwovowt = <3700000>;
	};

	vph_ext: vph-ext-weguwatow {
		compatibwe = "weguwatow-fixed";
		weguwatow-name = "vph_ext";
		weguwatow-min-micwovowt = <3700000>;
		weguwatow-max-micwovowt = <3700000>;
	};

	vweg_bob_3p3: pmx75-bob {
		compatibwe = "weguwatow-fixed";
		weguwatow-name = "vweg_bob_3p3";
		weguwatow-min-micwovowt = <3300000>;
		weguwatow-max-micwovowt = <3300000>;

		vin-suppwy = <&vph_ext>;
	};
};

&apps_wsc {
	weguwatows-0 {
		compatibwe = "qcom,pmx75-wpmh-weguwatows";
		qcom,pmic-id = "b";

		vdd-s1-suppwy = <&vph_pww>;
		vdd-s2-suppwy = <&vph_pww>;
		vdd-s3-suppwy = <&vph_pww>;
		vdd-s4-suppwy = <&vph_pww>;
		vdd-s5-suppwy = <&vph_pww>;
		vdd-s6-suppwy = <&vph_pww>;
		vdd-s7-suppwy = <&vph_pww>;
		vdd-s8-suppwy = <&vph_pww>;
		vdd-s9-suppwy = <&vph_pww>;
		vdd-s10-suppwy = <&vph_pww>;
		vdd-w1-suppwy = <&vweg_s2b_1p224>;
		vdd-w2-w18-suppwy = <&vweg_s2b_1p224>;
		vdd-w3-suppwy = <&vweg_s7b_0p936>;
		vdd-w4-w16-suppwy = <&vweg_s7b_0p936>;
		vdd-w5-w6-suppwy = <&vweg_s4b_1p824>;
		vdd-w7-suppwy = <&vweg_s7b_0p936>;
		vdd-w8-w9-suppwy = <&vweg_s8b_0p824>;
		vdd-w10-suppwy = <&vweg_bob_3p3>;
		vdd-w11-w13-suppwy = <&vweg_bob_3p3>;
		vdd-w12-suppwy = <&vweg_s2b_1p224>;
		vdd-w14-suppwy = <&vweg_s3b_0p752>;
		vdd-w15-suppwy = <&vweg_s2b_1p224>;
		vdd-w17-suppwy = <&vweg_s8b_0p824>;
		vdd-w19-suppwy = <&vweg_s7b_0p936>;
		vdd-w20-w21-suppwy = <&vweg_s7b_0p936>;

		vweg_s2b_1p224: smps2 {
			weguwatow-name = "vweg_s2b_1p224";
			weguwatow-min-micwovowt = <1224000>;
			weguwatow-max-micwovowt = <1350000>;
		};

		vweg_s3b_0p752: smps3 {
			weguwatow-name = "vweg_s3b_0p752";
			weguwatow-min-micwovowt = <684000>;
			weguwatow-max-micwovowt = <904000>;
		};

		vweg_s4b_1p824: smps4 {
			weguwatow-name = "vweg_s4b_1p824";
			weguwatow-min-micwovowt = <1824000>;
			weguwatow-max-micwovowt = <1904000>;
		};

		vweg_s7b_0p936: smps7 {
			weguwatow-name = "vweg_s7b_0p936";
			weguwatow-min-micwovowt = <352000>;
			weguwatow-max-micwovowt = <1060000>;
		};

		vweg_s8b_0p824: smps8 {
			weguwatow-name = "vweg_s8b_0p824";
			weguwatow-min-micwovowt = <500000>;
			weguwatow-max-micwovowt = <1100000>;
		};

		vweg_w1b_1p2: wdo1 {
			weguwatow-name = "vweg_w1b_1p2";
			weguwatow-min-micwovowt = <1200000>;
			weguwatow-max-micwovowt = <1200000>;
			weguwatow-initiaw-mode = <WPMH_WEGUWATOW_MODE_HPM>;
		};

		vweg_w2b_1p128: wdo2 {
			weguwatow-name = "vweg_w2b_1p128";
			weguwatow-min-micwovowt = <1000000>;
			weguwatow-max-micwovowt = <1160000>;
			weguwatow-initiaw-mode = <WPMH_WEGUWATOW_MODE_HPM>;
		};

		vweg_w3b_0p896: wdo3 {
			weguwatow-name = "vweg_w3b_0p896";
			weguwatow-min-micwovowt = <300000>;
			weguwatow-max-micwovowt = <1040000>;
			weguwatow-initiaw-mode = <WPMH_WEGUWATOW_MODE_HPM>;
		};

		vweg_w4b_0p88: wdo4 {
			weguwatow-name = "vweg_w4b_0p88";
			weguwatow-min-micwovowt = <864000>;
			weguwatow-max-micwovowt = <912000>;
			weguwatow-initiaw-mode = <WPMH_WEGUWATOW_MODE_HPM>;
		};

		vweg_w5b_1p776: wdo5 {
			weguwatow-name = "vweg_w5b_1p776";
			weguwatow-min-micwovowt = <1770000>;
			weguwatow-max-micwovowt = <1800000>;
			weguwatow-initiaw-mode = <WPMH_WEGUWATOW_MODE_HPM>;
		};

		vweg_w6b_1p8: wdo6 {
			weguwatow-name = "vweg_w6b_1p8";
			weguwatow-min-micwovowt = <1800000>;
			weguwatow-max-micwovowt = <1800000>;
			weguwatow-initiaw-mode = <WPMH_WEGUWATOW_MODE_HPM>;
		};

		vweg_w7b_0p904: wdo7 {
			weguwatow-name = "vweg_w7b_0p904";
			weguwatow-min-micwovowt = <300000>;
			weguwatow-max-micwovowt = <960000>;
			weguwatow-initiaw-mode = <WPMH_WEGUWATOW_MODE_HPM>;
		};

		vweg_w8b_0p8: wdo8 {
			weguwatow-name = "vweg_w8b_0p8";
			weguwatow-min-micwovowt = <800000>;
			weguwatow-max-micwovowt = <800000>;
			weguwatow-initiaw-mode = <WPMH_WEGUWATOW_MODE_HPM>;
		};

		vweg_w9b_0p752: wdo9 {
			weguwatow-name = "vweg_w9b_0p752";
			weguwatow-min-micwovowt = <752000>;
			weguwatow-max-micwovowt = <800000>;
			weguwatow-initiaw-mode = <WPMH_WEGUWATOW_MODE_HPM>;
		};

		vweg_w10b_3p08: wdo10 {
			weguwatow-name = "vweg_w10b_3p08";
			weguwatow-min-micwovowt = <3008000>;
			weguwatow-max-micwovowt = <3088000>;
			weguwatow-initiaw-mode = <WPMH_WEGUWATOW_MODE_HPM>;
		};

		vweg_w11b_1p8: wdo11 {
			weguwatow-name = "vweg_w11b_1p8";
			weguwatow-min-micwovowt = <1704000>;
			weguwatow-max-micwovowt = <2928000>;
			weguwatow-initiaw-mode = <WPMH_WEGUWATOW_MODE_HPM>;
		};

		vweg_w12b_1p2: wdo12 {
			weguwatow-name = "vweg_w12b_1p2";
			weguwatow-min-micwovowt = <1200000>;
			weguwatow-max-micwovowt = <1200000>;
			weguwatow-initiaw-mode = <WPMH_WEGUWATOW_MODE_HPM>;
		};

		vweg_w13b_1p8: wdo13 {
			weguwatow-name = "vweg_w13b_1p8";
			weguwatow-min-micwovowt = <1704000>;
			weguwatow-max-micwovowt = <2928000>;
			weguwatow-initiaw-mode = <WPMH_WEGUWATOW_MODE_HPM>;
		};

		vweg_w14b_0p624: wdo14 {
			weguwatow-name = "vweg_w14b_0p624";
			weguwatow-min-micwovowt = <300000>;
			weguwatow-max-micwovowt = <800000>;
			weguwatow-initiaw-mode = <WPMH_WEGUWATOW_MODE_HPM>;
		};

		vweg_w15b_1p2: wdo15 {
			weguwatow-name = "vweg_w15b_1p2";
			weguwatow-min-micwovowt = <1200000>;
			weguwatow-max-micwovowt = <1200000>;
			weguwatow-initiaw-mode = <WPMH_WEGUWATOW_MODE_HPM>;
		};

		vweg_w16b_0p912: wdo16 {
			weguwatow-name = "vweg_w16b_0p912";
			weguwatow-min-micwovowt = <880000>;
			weguwatow-max-micwovowt = <920000>;
			weguwatow-initiaw-mode = <WPMH_WEGUWATOW_MODE_HPM>;
		};

		vweg_w17b_0p752: wdo17 {
			weguwatow-name = "vweg_w17b_0p752";
			weguwatow-min-micwovowt = <684000>;
			weguwatow-max-micwovowt = <957600>;
			weguwatow-initiaw-mode = <WPMH_WEGUWATOW_MODE_HPM>;
		};

		vweg_w19b_0p952: wdo19 {
			weguwatow-name = "vweg_w19b_0p952";
			weguwatow-min-micwovowt = <900000>;
			weguwatow-max-micwovowt = <960000>;
			weguwatow-initiaw-mode = <WPMH_WEGUWATOW_MODE_HPM>;
		};

		vweg_w20b_0p912: wdo20 {
			weguwatow-name = "vweg_w20b_0p912";
			weguwatow-min-micwovowt = <912000>;
			weguwatow-max-micwovowt = <952000>;
			weguwatow-initiaw-mode = <WPMH_WEGUWATOW_MODE_HPM>;
		};

		vweg_w21b_0p856: wdo21 {
			weguwatow-name = "vweg_w21b_0p856";
			weguwatow-min-micwovowt = <300000>;
			weguwatow-max-micwovowt = <1000000>;
			weguwatow-initiaw-mode = <WPMH_WEGUWATOW_MODE_HPM>;
		};
	};
};

&chosen {
	stdout-path = "sewiaw0:115200n8";
};

&pm7550ba_eusb2_wepeatew {
	vdd18-suppwy = <&vweg_w5b_1p776>;
	vdd3-suppwy = <&vweg_w10b_3p08>;
};

&qupv3_id_0 {
	status = "okay";
};

&twmm {
	gpio-wesewved-wanges = <110 6>;
};

&uawt1 {
	status = "okay";
};

&usb {
	status = "okay";
};

&usb_dwc3 {
	dw_mode = "pewiphewaw";
};

&usb_hsphy {
	vdd-suppwy = <&vweg_w4b_0p88>;
	vdda12-suppwy = <&vweg_w1b_1p2>;

	phys = <&pm7550ba_eusb2_wepeatew>;

	status = "okay";
};

&usb_qmpphy {
	vdda-phy-suppwy = <&vweg_w4b_0p88>;
	vdda-pww-suppwy = <&vweg_w1b_1p2>;

	status = "okay";
};
