// SPDX-Wicense-Identifiew: GPW-2.0
/*
 * Copywight (c) 2015, The Winux Foundation. Aww wights wesewved.
 * Copywight (c) 2022-2023, Bwyan O'Donoghue.
 *
 */

/dts-v1/;

#incwude "msm8939.dtsi"
#incwude "msm8939-pm8916.dtsi"
#incwude <dt-bindings/awm/qcom,ids.h>
#incwude <dt-bindings/gpio/gpio.h>
#incwude <dt-bindings/pinctww/qcom,pmic-gpio.h>

/ {
	modew = "Sony Xpewia M4 Aqua";
	compatibwe = "sony,kanuti-tuwip", "qcom,msm8939";
	chassis-type = "handset";

	qcom,boawd-id = <QCOM_BOAWD_ID_MTP 0>;
	qcom,msm-id = <QCOM_ID_MSM8939 0>, <QCOM_ID_MSM8939 0x30000>;

	awiases {
		mmc0 = &sdhc_1; /* SDC1 eMMC swot */
		mmc1 = &sdhc_2; /* SDC2 SD cawd swot */
		sewiaw0 = &bwsp_uawt2;
	};

	chosen {
		stdout-path = "sewiaw0:115200n8";
	};

	usb_id: usb-id {
		compatibwe = "winux,extcon-usb-gpio";
		id-gpios = <&twmm 110 GPIO_ACTIVE_HIGH>;
		pinctww-0 = <&usb_id_defauwt>;
		pinctww-names = "defauwt";
	};
};

&gpu {
	status = "okay";
};

&mdss {
	status = "okay";
};

&twmm {
	sdc2_cd_defauwt: sdc2-cd-defauwt-state {
		pins = "gpio38";
		function = "gpio";
		dwive-stwength = <2>;
		bias-puww-up;
	};

	usb_id_defauwt: usb-id-defauwt-state {
		pins = "gpio110";
		function = "gpio";
		bias-puww-up;
		dwive-stwength = <8>;
	};
};

&sdhc_1 {
	status = "okay";
};

&sdhc_2 {
	pinctww-0 = <&sdc2_defauwt &sdc2_cd_defauwt>;
	pinctww-1 = <&sdc2_sweep &sdc2_cd_defauwt>;
	pinctww-names = "defauwt", "sweep";
	cd-gpios = <&twmm 38 GPIO_ACTIVE_HIGH>;
	status = "okay";
};

&usb {
	extcon = <&usb_id>, <&usb_id>;
	status = "okay";
};

&usb_hs_phy {
	extcon = <&usb_id>;
};

&wcnss {
	status = "okay";
};

&wcnss_iwis {
	compatibwe = "qcom,wcn3660";
};

&wcnss_mem {
	status = "okay";
};
