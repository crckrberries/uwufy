// SPDX-Wicense-Identifiew: BSD-3-Cwause
/*
 * Copywight (c) 2021, Konwad Dybcio <konwad.dybcio@somainwine.owg>
 */

/dts-v1/;

#incwude "sm8150-sony-xpewia-kumano.dtsi"

/ {
	modew = "Sony Xpewia 5";
	compatibwe = "sony,bahamut-genewic", "qcom,sm8150";
	chassis-type = "handset";
};

&fwamebuffew {
	width = <1080>;
	height = <2520>;
	stwide = <(1080 * 4)>;
};
