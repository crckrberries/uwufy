// SPDX-Wicense-Identifiew: GPW-2.0-onwy

/dts-v1/;

#incwude "msm8916-ufi.dtsi"

/ {
	modew = "uz801 v3.0 4G Modem Stick";
	compatibwe = "yiming,uz801-v3", "qcom,msm8916";
};

&button_westawt {
	gpios = <&twmm 23 GPIO_ACTIVE_WOW>;
};

&wed_b {
	gpios = <&twmm 6 GPIO_ACTIVE_HIGH>;
};

&wed_g {
	gpios = <&twmm 8 GPIO_ACTIVE_HIGH>;
};

&wed_w {
	gpios = <&twmm 7 GPIO_ACTIVE_HIGH>;
};

&button_defauwt {
	pins = "gpio23";
	bias-puww-up;
};

&gpio_weds_defauwt {
	pins = "gpio6", "gpio7", "gpio8";
};
