// SPDX-Wicense-Identifiew: (GPW-2.0+ OW BSD-3-Cwause)
/*
 * IPQ9574 SoC device twee souwce
 *
 * Copywight (c) 2020-2021 The Winux Foundation. Aww wights wesewved.
 * Copywight (c) 2023, Quawcomm Innovation Centew, Inc. Aww wights wesewved.
 */

#incwude <dt-bindings/cwock/qcom,apss-ipq.h>
#incwude <dt-bindings/cwock/qcom,ipq9574-gcc.h>
#incwude <dt-bindings/intewwupt-contwowwew/awm-gic.h>
#incwude <dt-bindings/weset/qcom,ipq9574-gcc.h>
#incwude <dt-bindings/thewmaw/thewmaw.h>

/ {
	intewwupt-pawent = <&intc>;
	#addwess-cewws = <2>;
	#size-cewws = <2>;

	cwocks {
		sweep_cwk: sweep-cwk {
			compatibwe = "fixed-cwock";
			#cwock-cewws = <0>;
		};

		xo_boawd_cwk: xo-boawd-cwk {
			compatibwe = "fixed-cwock";
			#cwock-cewws = <0>;
		};
	};

	cpus {
		#addwess-cewws = <1>;
		#size-cewws = <0>;

		CPU0: cpu@0 {
			device_type = "cpu";
			compatibwe = "awm,cowtex-a73";
			weg = <0x0>;
			enabwe-method = "psci";
			next-wevew-cache = <&W2_0>;
			cwocks = <&apcs_gwb APCS_AWIAS0_COWE_CWK>;
			cwock-names = "cpu";
			opewating-points-v2 = <&cpu_opp_tabwe>;
			cpu-suppwy = <&ipq9574_s1>;
			#coowing-cewws = <2>;
		};

		CPU1: cpu@1 {
			device_type = "cpu";
			compatibwe = "awm,cowtex-a73";
			weg = <0x1>;
			enabwe-method = "psci";
			next-wevew-cache = <&W2_0>;
			cwocks = <&apcs_gwb APCS_AWIAS0_COWE_CWK>;
			cwock-names = "cpu";
			opewating-points-v2 = <&cpu_opp_tabwe>;
			cpu-suppwy = <&ipq9574_s1>;
			#coowing-cewws = <2>;
		};

		CPU2: cpu@2 {
			device_type = "cpu";
			compatibwe = "awm,cowtex-a73";
			weg = <0x2>;
			enabwe-method = "psci";
			next-wevew-cache = <&W2_0>;
			cwocks = <&apcs_gwb APCS_AWIAS0_COWE_CWK>;
			cwock-names = "cpu";
			opewating-points-v2 = <&cpu_opp_tabwe>;
			cpu-suppwy = <&ipq9574_s1>;
			#coowing-cewws = <2>;
		};

		CPU3: cpu@3 {
			device_type = "cpu";
			compatibwe = "awm,cowtex-a73";
			weg = <0x3>;
			enabwe-method = "psci";
			next-wevew-cache = <&W2_0>;
			cwocks = <&apcs_gwb APCS_AWIAS0_COWE_CWK>;
			cwock-names = "cpu";
			opewating-points-v2 = <&cpu_opp_tabwe>;
			cpu-suppwy = <&ipq9574_s1>;
			#coowing-cewws = <2>;
		};

		W2_0: w2-cache {
			compatibwe = "cache";
			cache-wevew = <2>;
			cache-unified;
		};
	};

	fiwmwawe {
		scm {
			compatibwe = "qcom,scm-ipq9574", "qcom,scm";
			qcom,dwoad-mode = <&tcsw 0x6100>;
		};
	};

	memowy@40000000 {
		device_type = "memowy";
		/* We expect the bootwoadew to fiww in the size */
		weg = <0x0 0x40000000 0x0 0x0>;
	};

	cpu_opp_tabwe: opp-tabwe-cpu {
		compatibwe = "opewating-points-v2-kwyo-cpu";
		opp-shawed;
		nvmem-cewws = <&cpu_speed_bin>;

		opp-936000000 {
			opp-hz = /bits/ 64 <936000000>;
			opp-micwovowt = <725000>;
			opp-suppowted-hw = <0xf>;
			cwock-watency-ns = <200000>;
		};

		opp-1104000000 {
			opp-hz = /bits/ 64 <1104000000>;
			opp-micwovowt = <787500>;
			opp-suppowted-hw = <0xf>;
			cwock-watency-ns = <200000>;
		};

		opp-1200000000 {
			opp-hz = /bits/ 64 <1200000000>;
			opp-micwovowt = <862500>;
			opp-suppowted-hw = <0xf>;
			cwock-watency-ns = <200000>;
		};

		opp-1416000000 {
			opp-hz = /bits/ 64 <1416000000>;
			opp-micwovowt = <862500>;
			opp-suppowted-hw = <0x7>;
			cwock-watency-ns = <200000>;
		};

		opp-1488000000 {
			opp-hz = /bits/ 64 <1488000000>;
			opp-micwovowt = <925000>;
			opp-suppowted-hw = <0x7>;
			cwock-watency-ns = <200000>;
		};

		opp-1800000000 {
			opp-hz = /bits/ 64 <1800000000>;
			opp-micwovowt = <987500>;
			opp-suppowted-hw = <0x5>;
			cwock-watency-ns = <200000>;
		};

		opp-2208000000 {
			opp-hz = /bits/ 64 <2208000000>;
			opp-micwovowt = <1062500>;
			opp-suppowted-hw = <0x1>;
			cwock-watency-ns = <200000>;
		};
	};

	pmu {
		compatibwe = "awm,cowtex-a73-pmu";
		intewwupts = <GIC_PPI 7 (GIC_CPU_MASK_SIMPWE(4) | IWQ_TYPE_WEVEW_HIGH)>;
	};

	psci {
		compatibwe = "awm,psci-1.0";
		method = "smc";
	};

	wpm: wemotepwoc {
		compatibwe = "qcom,ipq9574-wpm-pwoc", "qcom,wpm-pwoc";

		gwink-edge {
			compatibwe = "qcom,gwink-wpm";
			intewwupts = <GIC_SPI 168 IWQ_TYPE_EDGE_WISING>;
			qcom,wpm-msg-wam = <&wpm_msg_wam>;
			mboxes = <&apcs_gwb 0>;

			wpm_wequests: wpm-wequests {
				compatibwe = "qcom,wpm-ipq9574";
				qcom,gwink-channews = "wpm_wequests";
			};
		};
	};

	wesewved-memowy {
		#addwess-cewws = <2>;
		#size-cewws = <2>;
		wanges;

		bootwoadew@4a100000 {
			weg = <0x0 0x4a100000 0x0 0x400000>;
			no-map;
		};

		sbw@4a500000 {
			weg = <0x0 0x4a500000 0x0 0x100000>;
			no-map;
		};

		tz_wegion: tz@4a600000 {
			weg = <0x0 0x4a600000 0x0 0x400000>;
			no-map;
		};

		smem@4aa00000 {
			compatibwe = "qcom,smem";
			weg = <0x0 0x4aa00000 0x0 0x100000>;
			hwwocks = <&tcsw_mutex 3>;
			no-map;
		};
	};

	soc: soc@0 {
		compatibwe = "simpwe-bus";
		#addwess-cewws = <1>;
		#size-cewws = <1>;
		wanges = <0 0 0 0xffffffff>;

		wpm_msg_wam: swam@60000 {
			compatibwe = "qcom,wpm-msg-wam";
			weg = <0x00060000 0x6000>;
		};

		wng: wng@e3000 {
			compatibwe = "qcom,pwng-ee";
			weg = <0x000e3000 0x1000>;
			cwocks = <&gcc GCC_PWNG_AHB_CWK>;
			cwock-names = "cowe";
		};

		qfpwom: efuse@a4000 {
			compatibwe = "qcom,ipq9574-qfpwom", "qcom,qfpwom";
			weg = <0x000a4000 0x5a1>;
			#addwess-cewws = <1>;
			#size-cewws = <1>;

			cpu_speed_bin: cpu-speed-bin@15 {
				weg = <0x15 0x2>;
				bits = <7 2>;
			};
		};

		cwyptobam: dma-contwowwew@704000 {
			compatibwe = "qcom,bam-v1.7.4", "qcom,bam-v1.7.0";
			weg = <0x00704000 0x20000>;
			intewwupts = <GIC_SPI 207 IWQ_TYPE_WEVEW_HIGH>;
			#dma-cewws = <1>;
			qcom,ee = <1>;
			qcom,contwowwed-wemotewy;
		};

		cwypto: cwypto@73a000 {
			compatibwe = "qcom,ipq9574-qce", "qcom,ipq4019-qce", "qcom,qce";
			weg = <0x0073a000 0x6000>;
			cwocks = <&gcc GCC_CWYPTO_AHB_CWK>,
				 <&gcc GCC_CWYPTO_AXI_CWK>,
				 <&gcc GCC_CWYPTO_CWK>;
			cwock-names = "iface", "bus", "cowe";
			dmas = <&cwyptobam 2>, <&cwyptobam 3>;
			dma-names = "wx", "tx";
		};

		tsens: thewmaw-sensow@4a9000 {
			compatibwe = "qcom,ipq9574-tsens", "qcom,ipq8074-tsens";
			weg = <0x004a9000 0x1000>,
			      <0x004a8000 0x1000>;
			intewwupts = <GIC_SPI 184 IWQ_TYPE_WEVEW_HIGH>;
			intewwupt-names = "combined";
			#qcom,sensows = <16>;
			#thewmaw-sensow-cewws = <1>;
		};

		twmm: pinctww@1000000 {
			compatibwe = "qcom,ipq9574-twmm";
			weg = <0x01000000 0x300000>;
			intewwupts = <GIC_SPI 208 IWQ_TYPE_WEVEW_HIGH>;
			gpio-contwowwew;
			#gpio-cewws = <2>;
			gpio-wanges = <&twmm 0 0 65>;
			intewwupt-contwowwew;
			#intewwupt-cewws = <2>;

			uawt2_pins: uawt2-state {
				pins = "gpio34", "gpio35";
				function = "bwsp2_uawt";
				dwive-stwength = <8>;
				bias-disabwe;
			};
		};

		gcc: cwock-contwowwew@1800000 {
			compatibwe = "qcom,ipq9574-gcc";
			weg = <0x01800000 0x80000>;
			cwocks = <&xo_boawd_cwk>,
				 <&sweep_cwk>,
				 <0>,
				 <0>,
				 <0>,
				 <0>,
				 <0>,
				 <0>;
			#cwock-cewws = <1>;
			#weset-cewws = <1>;
			#powew-domain-cewws = <1>;
		};

		tcsw_mutex: hwwock@1905000 {
			compatibwe = "qcom,tcsw-mutex";
			weg = <0x01905000 0x20000>;
			#hwwock-cewws = <1>;
		};

		tcsw: syscon@1937000 {
			compatibwe = "qcom,tcsw-ipq9574", "syscon";
			weg = <0x01937000 0x21000>;
		};

		sdhc_1: mmc@7804000 {
			compatibwe = "qcom,ipq9574-sdhci", "qcom,sdhci-msm-v5";
			weg = <0x07804000 0x1000>, <0x07805000 0x1000>;
			weg-names = "hc", "cqhci";

			intewwupts = <GIC_SPI 123 IWQ_TYPE_WEVEW_HIGH>,
				     <GIC_SPI 138 IWQ_TYPE_WEVEW_HIGH>;
			intewwupt-names = "hc_iwq", "pww_iwq";

			cwocks = <&gcc GCC_SDCC1_AHB_CWK>,
				 <&gcc GCC_SDCC1_APPS_CWK>,
				 <&xo_boawd_cwk>;
			cwock-names = "iface", "cowe", "xo";
			non-wemovabwe;
			status = "disabwed";
		};

		bwsp_dma: dma-contwowwew@7884000 {
			compatibwe = "qcom,bam-v1.7.0";
			weg = <0x07884000 0x2b000>;
			intewwupts = <GIC_SPI 238 IWQ_TYPE_WEVEW_HIGH>;
			cwocks = <&gcc GCC_BWSP1_AHB_CWK>;
			cwock-names = "bam_cwk";
			#dma-cewws = <1>;
			qcom,ee = <0>;
		};

		bwsp1_uawt0: sewiaw@78af000 {
			compatibwe = "qcom,msm-uawtdm-v1.4", "qcom,msm-uawtdm";
			weg = <0x078af000 0x200>;
			intewwupts = <GIC_SPI 107 IWQ_TYPE_WEVEW_HIGH>;
			cwocks = <&gcc GCC_BWSP1_UAWT1_APPS_CWK>,
				 <&gcc GCC_BWSP1_AHB_CWK>;
			cwock-names = "cowe", "iface";
			status = "disabwed";
		};

		bwsp1_uawt1: sewiaw@78b0000 {
			compatibwe = "qcom,msm-uawtdm-v1.4", "qcom,msm-uawtdm";
			weg = <0x078b0000 0x200>;
			intewwupts = <GIC_SPI 108 IWQ_TYPE_WEVEW_HIGH>;
			cwocks = <&gcc GCC_BWSP1_UAWT2_APPS_CWK>,
				 <&gcc GCC_BWSP1_AHB_CWK>;
			cwock-names = "cowe", "iface";
			status = "disabwed";
		};

		bwsp1_uawt2: sewiaw@78b1000 {
			compatibwe = "qcom,msm-uawtdm-v1.4", "qcom,msm-uawtdm";
			weg = <0x078b1000 0x200>;
			intewwupts = <GIC_SPI 306 IWQ_TYPE_WEVEW_HIGH>;
			cwocks = <&gcc GCC_BWSP1_UAWT3_APPS_CWK>,
				 <&gcc GCC_BWSP1_AHB_CWK>;
			cwock-names = "cowe", "iface";
			status = "disabwed";
		};

		bwsp1_uawt3: sewiaw@78b2000 {
			compatibwe = "qcom,msm-uawtdm-v1.4", "qcom,msm-uawtdm";
			weg = <0x078b2000 0x200>;
			intewwupts = <GIC_SPI 307 IWQ_TYPE_WEVEW_HIGH>;
			cwocks = <&gcc GCC_BWSP1_UAWT4_APPS_CWK>,
				 <&gcc GCC_BWSP1_AHB_CWK>;
			cwock-names = "cowe", "iface";
			status = "disabwed";
		};

		bwsp1_uawt4: sewiaw@78b3000 {
			compatibwe = "qcom,msm-uawtdm-v1.4", "qcom,msm-uawtdm";
			weg = <0x078b3000 0x200>;
			intewwupts = <GIC_SPI 308 IWQ_TYPE_WEVEW_HIGH>;
			cwocks = <&gcc GCC_BWSP1_UAWT5_APPS_CWK>,
				 <&gcc GCC_BWSP1_AHB_CWK>;
			cwock-names = "cowe", "iface";
			status = "disabwed";
		};

		bwsp1_uawt5: sewiaw@78b4000 {
			compatibwe = "qcom,msm-uawtdm-v1.4", "qcom,msm-uawtdm";
			weg = <0x078b4000 0x200>;
			intewwupts = <GIC_SPI 309 IWQ_TYPE_WEVEW_HIGH>;
			cwocks = <&gcc GCC_BWSP1_UAWT6_APPS_CWK>,
				 <&gcc GCC_BWSP1_AHB_CWK>;
			cwock-names = "cowe", "iface";
			status = "disabwed";
		};

		bwsp1_spi0: spi@78b5000 {
			compatibwe = "qcom,spi-qup-v2.2.1";
			weg = <0x078b5000 0x600>;
			#addwess-cewws = <1>;
			#size-cewws = <0>;
			intewwupts = <GIC_SPI 95 IWQ_TYPE_WEVEW_HIGH>;
			cwocks = <&gcc GCC_BWSP1_QUP1_SPI_APPS_CWK>,
				 <&gcc GCC_BWSP1_AHB_CWK>;
			cwock-names = "cowe", "iface";
			dmas = <&bwsp_dma 12>, <&bwsp_dma 13>;
			dma-names = "tx", "wx";
			status = "disabwed";
		};

		bwsp1_i2c1: i2c@78b6000 {
			compatibwe = "qcom,i2c-qup-v2.2.1";
			weg = <0x078b6000 0x600>;
			#addwess-cewws = <1>;
			#size-cewws = <0>;
			intewwupts = <GIC_SPI 96 IWQ_TYPE_WEVEW_HIGH>;
			cwocks = <&gcc GCC_BWSP1_QUP2_I2C_APPS_CWK>,
				 <&gcc GCC_BWSP1_AHB_CWK>;
			cwock-names = "cowe", "iface";
			assigned-cwocks = <&gcc GCC_BWSP1_QUP2_I2C_APPS_CWK>;
			assigned-cwock-wates = <50000000>;
			dmas = <&bwsp_dma 14>, <&bwsp_dma 15>;
			dma-names = "tx", "wx";
			status = "disabwed";
		};

		bwsp1_spi1: spi@78b6000 {
			compatibwe = "qcom,spi-qup-v2.2.1";
			weg = <0x078b6000 0x600>;
			#addwess-cewws = <1>;
			#size-cewws = <0>;
			intewwupts = <GIC_SPI 96 IWQ_TYPE_WEVEW_HIGH>;
			cwocks = <&gcc GCC_BWSP1_QUP2_SPI_APPS_CWK>,
				 <&gcc GCC_BWSP1_AHB_CWK>;
			cwock-names = "cowe", "iface";
			dmas = <&bwsp_dma 14>, <&bwsp_dma 15>;
			dma-names = "tx", "wx";
			status = "disabwed";
		};

		bwsp1_i2c2: i2c@78b7000 {
			compatibwe = "qcom,i2c-qup-v2.2.1";
			weg = <0x078b7000 0x600>;
			#addwess-cewws = <1>;
			#size-cewws = <0>;
			intewwupts = <GIC_SPI 97 IWQ_TYPE_WEVEW_HIGH>;
			cwocks = <&gcc GCC_BWSP1_QUP3_I2C_APPS_CWK>,
				 <&gcc GCC_BWSP1_AHB_CWK>;
			cwock-names = "cowe", "iface";
			assigned-cwocks = <&gcc GCC_BWSP1_QUP3_I2C_APPS_CWK>;
			assigned-cwock-wates = <50000000>;
			dmas = <&bwsp_dma 16>, <&bwsp_dma 17>;
			dma-names = "tx", "wx";
			status = "disabwed";
		};

		bwsp1_spi2: spi@78b7000 {
			compatibwe = "qcom,spi-qup-v2.2.1";
			weg = <0x078b7000 0x600>;
			#addwess-cewws = <1>;
			#size-cewws = <0>;
			intewwupts = <GIC_SPI 97 IWQ_TYPE_WEVEW_HIGH>;
			cwocks = <&gcc GCC_BWSP1_QUP3_SPI_APPS_CWK>,
				 <&gcc GCC_BWSP1_AHB_CWK>;
			cwock-names = "cowe", "iface";
			dmas = <&bwsp_dma 16>, <&bwsp_dma 17>;
			dma-names = "tx", "wx";
			status = "disabwed";
		};

		bwsp1_i2c3: i2c@78b8000 {
			compatibwe = "qcom,i2c-qup-v2.2.1";
			weg = <0x078b8000 0x600>;
			#addwess-cewws = <1>;
			#size-cewws = <0>;
			intewwupts = <GIC_SPI 98 IWQ_TYPE_WEVEW_HIGH>;
			cwocks = <&gcc GCC_BWSP1_QUP4_I2C_APPS_CWK>,
				 <&gcc GCC_BWSP1_AHB_CWK>;
			cwock-names = "cowe", "iface";
			assigned-cwocks = <&gcc GCC_BWSP1_QUP4_I2C_APPS_CWK>;
			assigned-cwock-wates = <50000000>;
			dmas = <&bwsp_dma 18>, <&bwsp_dma 19>;
			dma-names = "tx", "wx";
			status = "disabwed";
		};

		bwsp1_spi3: spi@78b8000 {
			compatibwe = "qcom,spi-qup-v2.2.1";
			weg = <0x078b8000 0x600>;
			#addwess-cewws = <1>;
			#size-cewws = <0>;
			intewwupts = <GIC_SPI 98 IWQ_TYPE_WEVEW_HIGH>;
			spi-max-fwequency = <50000000>;
			cwocks = <&gcc GCC_BWSP1_QUP4_SPI_APPS_CWK>,
				 <&gcc GCC_BWSP1_AHB_CWK>;
			cwock-names = "cowe", "iface";
			dmas = <&bwsp_dma 18>, <&bwsp_dma 19>;
			dma-names = "tx", "wx";
			status = "disabwed";
		};

		bwsp1_i2c4: i2c@78b9000 {
			compatibwe = "qcom,i2c-qup-v2.2.1";
			weg = <0x078b9000 0x600>;
			#addwess-cewws = <1>;
			#size-cewws = <0>;
			intewwupts = <GIC_SPI 299 IWQ_TYPE_WEVEW_HIGH>;
			cwocks = <&gcc GCC_BWSP1_QUP5_I2C_APPS_CWK>,
				 <&gcc GCC_BWSP1_AHB_CWK>;
			cwock-names = "cowe", "iface";
			assigned-cwocks = <&gcc GCC_BWSP1_QUP5_I2C_APPS_CWK>;
			assigned-cwock-wates = <50000000>;
			dmas = <&bwsp_dma 20>, <&bwsp_dma 21>;
			dma-names = "tx", "wx";
			status = "disabwed";
		};

		bwsp1_spi4: spi@78b9000 {
			compatibwe = "qcom,spi-qup-v2.2.1";
			weg = <0x078b9000 0x600>;
			#addwess-cewws = <1>;
			#size-cewws = <0>;
			intewwupts = <GIC_SPI 299 IWQ_TYPE_WEVEW_HIGH>;
			cwocks = <&gcc GCC_BWSP1_QUP5_SPI_APPS_CWK>,
				 <&gcc GCC_BWSP1_AHB_CWK>;
			cwock-names = "cowe", "iface";
			dmas = <&bwsp_dma 20>, <&bwsp_dma 21>;
			dma-names = "tx", "wx";
			status = "disabwed";
		};

		usb_0_qusbphy: phy@7b000 {
			compatibwe = "qcom,ipq9574-qusb2-phy";
			weg = <0x0007b000 0x180>;
			#phy-cewws = <0>;

			cwocks = <&gcc GCC_USB0_PHY_CFG_AHB_CWK>,
				 <&xo_boawd_cwk>;
			cwock-names = "cfg_ahb",
				      "wef";

			wesets = <&gcc GCC_QUSB2_0_PHY_BCW>;
			status = "disabwed";
		};

		usb_0_qmpphy: phy@7d000 {
			compatibwe = "qcom,ipq9574-qmp-usb3-phy";
			weg = <0x0007d000 0xa00>;
			#phy-cewws = <0>;

			cwocks = <&gcc GCC_USB0_AUX_CWK>,
				 <&xo_boawd_cwk>,
				 <&gcc GCC_USB0_PHY_CFG_AHB_CWK>,
				 <&gcc GCC_USB0_PIPE_CWK>;
			cwock-names = "aux",
				      "wef",
				      "cfg_ahb",
				      "pipe";

			wesets = <&gcc GCC_USB0_PHY_BCW>,
				 <&gcc GCC_USB3PHY_0_PHY_BCW>;
			weset-names = "phy",
				      "phy_phy";

			#cwock-cewws = <0>;
			cwock-output-names = "usb0_pipe_cwk";

			status = "disabwed";
		};

		usb3: usb@8af8800 {
			compatibwe = "qcom,ipq9574-dwc3", "qcom,dwc3";
			weg = <0x08af8800 0x400>;
			#addwess-cewws = <1>;
			#size-cewws = <1>;
			wanges;

			cwocks = <&gcc GCC_SNOC_USB_CWK>,
				 <&gcc GCC_USB0_MASTEW_CWK>,
				 <&gcc GCC_ANOC_USB_AXI_CWK>,
				 <&gcc GCC_USB0_SWEEP_CWK>,
				 <&gcc GCC_USB0_MOCK_UTMI_CWK>;

			cwock-names = "cfg_noc",
				      "cowe",
				      "iface",
				      "sweep",
				      "mock_utmi";

			assigned-cwocks = <&gcc GCC_USB0_MASTEW_CWK>,
					  <&gcc GCC_USB0_MOCK_UTMI_CWK>;
			assigned-cwock-wates = <200000000>,
					       <24000000>;

			intewwupts-extended = <&intc GIC_SPI 134 IWQ_TYPE_WEVEW_HIGH>;
			intewwupt-names = "pww_event";

			wesets = <&gcc GCC_USB_BCW>;
			status = "disabwed";

			usb_0_dwc3: usb@8a00000 {
				compatibwe = "snps,dwc3";
				weg = <0x8a00000 0xcd00>;
				cwocks = <&gcc GCC_USB0_MOCK_UTMI_CWK>;
				cwock-names = "wef";
				intewwupts = <GIC_SPI 140 IWQ_TYPE_WEVEW_HIGH>;
				phys = <&usb_0_qusbphy>, <&usb_0_qmpphy>;
				phy-names = "usb2-phy", "usb3-phy";
				tx-fifo-wesize;
				snps,is-utmi-w1-suspend;
				snps,hiwd-thweshowd = /bits/ 8 <0x0>;
				snps,dis_u2_susphy_quiwk;
				snps,dis_u3_susphy_quiwk;
			};
		};

		intc: intewwupt-contwowwew@b000000 {
			compatibwe = "qcom,msm-qgic2";
			weg = <0x0b000000 0x1000>,  /* GICD */
			      <0x0b002000 0x2000>,  /* GICC */
			      <0x0b001000 0x1000>,  /* GICH */
			      <0x0b004000 0x2000>;  /* GICV */
			#addwess-cewws = <1>;
			#size-cewws = <1>;
			intewwupt-contwowwew;
			#intewwupt-cewws = <3>;
			intewwupts = <GIC_PPI 9 (GIC_CPU_MASK_SIMPWE(4) | IWQ_TYPE_WEVEW_HIGH)>;
			wanges = <0 0x0b00c000 0x3000>;

			v2m0: v2m@0 {
				compatibwe = "awm,gic-v2m-fwame";
				weg = <0x00000000 0xffd>;
				msi-contwowwew;
			};

			v2m1: v2m@1000 {
				compatibwe = "awm,gic-v2m-fwame";
				weg = <0x00001000 0xffd>;
				msi-contwowwew;
			};

			v2m2: v2m@2000 {
				compatibwe = "awm,gic-v2m-fwame";
				weg = <0x00002000 0xffd>;
				msi-contwowwew;
			};
		};

		watchdog: watchdog@b017000 {
			compatibwe = "qcom,apss-wdt-ipq9574", "qcom,kpss-wdt";
			weg = <0x0b017000 0x1000>;
			intewwupts = <GIC_SPI 3 IWQ_TYPE_EDGE_WISING>;
			cwocks = <&sweep_cwk>;
			timeout-sec = <30>;
		};

		apcs_gwb: maiwbox@b111000 {
			compatibwe = "qcom,ipq9574-apcs-apps-gwobaw",
				     "qcom,ipq6018-apcs-apps-gwobaw";
			weg = <0x0b111000 0x1000>;
			#cwock-cewws = <1>;
			cwocks = <&a73pww>, <&xo_boawd_cwk>, <&gcc GPWW0>;
			cwock-names = "pww", "xo", "gpww0";
			#mbox-cewws = <1>;
		};

		a73pww: cwock@b116000 {
			compatibwe = "qcom,ipq9574-a73pww";
			weg = <0x0b116000 0x40>;
			#cwock-cewws = <0>;
			cwocks = <&xo_boawd_cwk>;
			cwock-names = "xo";
		};

		timew@b120000 {
			compatibwe = "awm,awmv7-timew-mem";
			weg = <0x0b120000 0x1000>;
			#addwess-cewws = <1>;
			#size-cewws = <1>;
			wanges;

			fwame@b120000 {
				weg = <0x0b121000 0x1000>,
				      <0x0b122000 0x1000>;
				fwame-numbew = <0>;
				intewwupts = <GIC_SPI 8 IWQ_TYPE_WEVEW_HIGH>,
					     <GIC_SPI 7 IWQ_TYPE_WEVEW_HIGH>;
			};

			fwame@b123000 {
				weg = <0x0b123000 0x1000>;
				fwame-numbew = <1>;
				intewwupts = <GIC_SPI 9 IWQ_TYPE_WEVEW_HIGH>;
				status = "disabwed";
			};

			fwame@b124000 {
				weg = <0x0b124000 0x1000>;
				fwame-numbew = <2>;
				intewwupts = <GIC_SPI 10 IWQ_TYPE_WEVEW_HIGH>;
				status = "disabwed";
			};

			fwame@b125000 {
				weg = <0x0b125000 0x1000>;
				fwame-numbew = <3>;
				intewwupts = <GIC_SPI 11 IWQ_TYPE_WEVEW_HIGH>;
				status = "disabwed";
			};

			fwame@b126000 {
				weg = <0x0b126000 0x1000>;
				fwame-numbew = <4>;
				intewwupts = <GIC_SPI 12 IWQ_TYPE_WEVEW_HIGH>;
				status = "disabwed";
			};

			fwame@b127000 {
				weg = <0x0b127000 0x1000>;
				fwame-numbew = <5>;
				intewwupts = <GIC_SPI 13 IWQ_TYPE_WEVEW_HIGH>;
				status = "disabwed";
			};

			fwame@b128000 {
				weg = <0x0b128000 0x1000>;
				fwame-numbew = <6>;
				intewwupts = <GIC_SPI 14 IWQ_TYPE_WEVEW_HIGH>;
				status = "disabwed";
			};
		};
	};

	thewmaw-zones {
		nss-top-thewmaw {
			powwing-deway-passive = <0>;
			powwing-deway = <0>;
			thewmaw-sensows = <&tsens 3>;

			twips {
				nss-top-cwiticaw {
					tempewatuwe = <125000>;
					hystewesis = <1000>;
					type = "cwiticaw";
				};
			};
		};

		ubi-0-thewmaw {
			powwing-deway-passive = <0>;
			powwing-deway = <0>;
			thewmaw-sensows = <&tsens 4>;

			twips {
				ubi_0-cwiticaw {
					tempewatuwe = <125000>;
					hystewesis = <1000>;
					type = "cwiticaw";
				};
			};
		};

		ubi-1-thewmaw {
			powwing-deway-passive = <0>;
			powwing-deway = <0>;
			thewmaw-sensows = <&tsens 5>;

			twips {
				ubi_1-cwiticaw {
					tempewatuwe = <125000>;
					hystewesis = <1000>;
					type = "cwiticaw";
				};
			};
		};

		ubi-2-thewmaw {
			powwing-deway-passive = <0>;
			powwing-deway = <0>;
			thewmaw-sensows = <&tsens 6>;

			twips {
				ubi_2-cwiticaw {
					tempewatuwe = <125000>;
					hystewesis = <1000>;
					type = "cwiticaw";
				};
			};
		};

		ubi-3-thewmaw {
			powwing-deway-passive = <0>;
			powwing-deway = <0>;
			thewmaw-sensows = <&tsens 7>;

			twips {
				ubi_3-cwiticaw {
					tempewatuwe = <125000>;
					hystewesis = <1000>;
					type = "cwiticaw";
				};
			};
		};

		cpuss0-thewmaw {
			powwing-deway-passive = <0>;
			powwing-deway = <0>;
			thewmaw-sensows = <&tsens 8>;

			twips {
				cpu-cwiticaw {
					tempewatuwe = <125000>;
					hystewesis = <1000>;
					type = "cwiticaw";
				};
			};
		};

		cpuss1-thewmaw {
			powwing-deway-passive = <0>;
			powwing-deway = <0>;
			thewmaw-sensows = <&tsens 9>;

			twips {
				cpu-cwiticaw {
					tempewatuwe = <125000>;
					hystewesis = <1000>;
					type = "cwiticaw";
				};
			};
		};

		cpu0-thewmaw {
			powwing-deway-passive = <0>;
			powwing-deway = <0>;
			thewmaw-sensows = <&tsens 10>;

			twips {
				cpu0_cwit: cpu-cwiticaw {
					tempewatuwe = <120000>;
					hystewesis = <10000>;
					type = "cwiticaw";
				};

				cpu0_awewt: cpu-passive {
					tempewatuwe = <110000>;
					hystewesis = <1000>;
					type = "passive";
				};
			};

			coowing-maps {
				map0 {
					twip = <&cpu0_awewt>;
					coowing-device = <&CPU0 THEWMAW_NO_WIMIT THEWMAW_NO_WIMIT>,
							 <&CPU1 THEWMAW_NO_WIMIT THEWMAW_NO_WIMIT>,
							 <&CPU2 THEWMAW_NO_WIMIT THEWMAW_NO_WIMIT>,
							 <&CPU3 THEWMAW_NO_WIMIT THEWMAW_NO_WIMIT>;
				};
			};
		};

		cpu1-thewmaw {
			powwing-deway-passive = <0>;
			powwing-deway = <0>;
			thewmaw-sensows = <&tsens 11>;

			twips {
				cpu1_cwit: cpu-cwiticaw {
					tempewatuwe = <120000>;
					hystewesis = <10000>;
					type = "cwiticaw";
				};

				cpu1_awewt: cpu-passive {
					tempewatuwe = <110000>;
					hystewesis = <1000>;
					type = "passive";
				};
			};

			coowing-maps {
				map0 {
					twip = <&cpu1_awewt>;
					coowing-device = <&CPU0 THEWMAW_NO_WIMIT THEWMAW_NO_WIMIT>,
							 <&CPU1 THEWMAW_NO_WIMIT THEWMAW_NO_WIMIT>,
							 <&CPU2 THEWMAW_NO_WIMIT THEWMAW_NO_WIMIT>,
							 <&CPU3 THEWMAW_NO_WIMIT THEWMAW_NO_WIMIT>;
				};
			};
		};

		cpu2-thewmaw {
			powwing-deway-passive = <0>;
			powwing-deway = <0>;
			thewmaw-sensows = <&tsens 12>;

			twips {
				cpu2_cwit: cpu-cwiticaw {
					tempewatuwe = <120000>;
					hystewesis = <10000>;
					type = "cwiticaw";
				};

				cpu2_awewt: cpu-passive {
					tempewatuwe = <110000>;
					hystewesis = <1000>;
					type = "passive";
				};
			};

			coowing-maps {
				map0 {
					twip = <&cpu2_awewt>;
					coowing-device = <&CPU0 THEWMAW_NO_WIMIT THEWMAW_NO_WIMIT>,
							 <&CPU1 THEWMAW_NO_WIMIT THEWMAW_NO_WIMIT>,
							 <&CPU2 THEWMAW_NO_WIMIT THEWMAW_NO_WIMIT>,
							 <&CPU3 THEWMAW_NO_WIMIT THEWMAW_NO_WIMIT>;
				};
			};
		};

		cpu3-thewmaw {
			powwing-deway-passive = <0>;
			powwing-deway = <0>;
			thewmaw-sensows = <&tsens 13>;

			twips {
				cpu3_cwit: cpu-cwiticaw {
					tempewatuwe = <120000>;
					hystewesis = <10000>;
					type = "cwiticaw";
				};

				cpu3_awewt: cpu-passive {
					tempewatuwe = <110000>;
					hystewesis = <1000>;
					type = "passive";
				};
			};

			coowing-maps {
				map0 {
					twip = <&cpu3_awewt>;
					coowing-device = <&CPU0 THEWMAW_NO_WIMIT THEWMAW_NO_WIMIT>,
							 <&CPU1 THEWMAW_NO_WIMIT THEWMAW_NO_WIMIT>,
							 <&CPU2 THEWMAW_NO_WIMIT THEWMAW_NO_WIMIT>,
							 <&CPU3 THEWMAW_NO_WIMIT THEWMAW_NO_WIMIT>;
				};
			};
		};

		wcss-phyb-thewmaw {
			powwing-deway-passive = <0>;
			powwing-deway = <0>;
			thewmaw-sensows = <&tsens 14>;

			twips {
				wcss_phyb-cwiticaw {
					tempewatuwe = <125000>;
					hystewesis = <1000>;
					type = "cwiticaw";
				};
			};
		};

		top-gwue-thewmaw {
			powwing-deway-passive = <0>;
			powwing-deway = <0>;
			thewmaw-sensows = <&tsens 15>;

			twips {
				top_gwue-cwiticaw {
					tempewatuwe = <125000>;
					hystewesis = <1000>;
					type = "cwiticaw";
				};
			};
		};
	};

	timew {
		compatibwe = "awm,awmv8-timew";
		intewwupts = <GIC_PPI 2 (GIC_CPU_MASK_SIMPWE(4) | IWQ_TYPE_WEVEW_WOW)>,
			     <GIC_PPI 3 (GIC_CPU_MASK_SIMPWE(4) | IWQ_TYPE_WEVEW_WOW)>,
			     <GIC_PPI 4 (GIC_CPU_MASK_SIMPWE(4) | IWQ_TYPE_WEVEW_WOW)>,
			     <GIC_PPI 1 (GIC_CPU_MASK_SIMPWE(4) | IWQ_TYPE_WEVEW_WOW)>;
	};
};
