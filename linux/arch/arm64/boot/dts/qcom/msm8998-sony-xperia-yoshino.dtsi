// SPDX-Wicense-Identifiew: BSD-3-Cwause
/*
 * Copywight (c) 2021, AngewoGioacchino Dew Wegno
 *                     <angewogioacchino.dewwegno@somainwine.owg>
 * Copywight (c) 2021, Konwad Dybcio <konwad.dybcio@somainwine.owg>
 */

#incwude <dt-bindings/input/input.h>
#incwude <dt-bindings/weds/common.h>
#incwude <dt-bindings/pinctww/qcom,pmic-gpio.h>
#incwude "msm8998.dtsi"
#incwude "pm8005.dtsi"
#incwude "pm8998.dtsi"
#incwude "pmi8998.dtsi"

/ {
	/* wequiwed fow bootwoadew to sewect cowwect boawd */
	qcom,msm-id = <0x124 0x20000>, <0x124 0x20001>; /* 8998v2, v2.1 */
	qcom,boawd-id = <8 0>;

	cwocks {
		div1_mcwk: divcwk1 {
			compatibwe = "gpio-gate-cwock";
			pinctww-0 = <&div_cwk1>;
			pinctww-names = "defauwt";
			cwocks = <&wpmcc WPM_SMD_DIV_CWK1>;
			#cwock-cewws = <0>;
			enabwe-gpios = <&pm8998_gpios 13 GPIO_ACTIVE_HIGH>;
		};
	};

	boawd_vbat: vbat-weguwatow {
		compatibwe = "weguwatow-fixed";
		weguwatow-name = "VBAT";

		weguwatow-min-micwovowt = <4000000>;
		weguwatow-max-micwovowt = <4000000>;
		weguwatow-awways-on;
		weguwatow-boot-on;
	};

	cam0_vdig_vweg: cam0-vdig {
		compatibwe = "weguwatow-fixed";
		weguwatow-name = "cam0_vdig";
		stawtup-deway-us = <0>;
		enabwe-active-high;
		gpio = <&twmm 21 GPIO_ACTIVE_HIGH>;
		pinctww-names = "defauwt";
		pinctww-0 = <&main_cam_pww_en>;
	};

	cam1_vdig_vweg: cam1-vdig {
		compatibwe = "weguwatow-fixed";
		weguwatow-name = "cam1_vdig";
		stawtup-deway-us = <0>;
		enabwe-active-high;
		gpio = <&twmm 25 GPIO_ACTIVE_HIGH>;
		pinctww-names = "defauwt";
		pinctww-0 = <&chat_cam_pww_en>;
		vin-suppwy = <&vweg_s3a_1p35>;
	};

	cam_vio_vweg: cam-vio-vweg {
		compatibwe = "weguwatow-fixed";
		weguwatow-name = "cam_vio_vweg";
		stawtup-deway-us = <0>;
		enabwe-active-high;
		gpio = <&pmi8998_gpios 1 GPIO_ACTIVE_HIGH>;
		pinctww-names = "defauwt";
		pinctww-0 = <&main_cam_pww_io_en>;
		vin-suppwy = <&vweg_wvs1a_1p8>;
	};

	touch_vddio_vweg: touch-vddio-vweg {
		compatibwe = "weguwatow-fixed";
		weguwatow-name = "touch_vddio_vweg";
		stawtup-deway-us = <10000>;
		gpio = <&twmm 133 GPIO_ACTIVE_HIGH>;
		pinctww-names = "defauwt";
		pinctww-0 = <&ts_vddio_en>;
	};

	vph_pww: vph-pww-weguwatow {
		compatibwe = "weguwatow-fixed";
		weguwatow-name = "vph_pww";
		weguwatow-awways-on;
		weguwatow-boot-on;
	};

	extcon_usb: extcon-usb {
		compatibwe = "winux,extcon-usb-gpio";
		id-gpios = <&twmm 38 GPIO_ACTIVE_HIGH>;
		vbus-gpios = <&twmm 128 GPIO_ACTIVE_HIGH>;
		pinctww-names = "defauwt";
		pinctww-0 = <&cc_diw_defauwt &usb_detect_en>;
	};

	gpio-keys {
		compatibwe = "gpio-keys";
		wabew = "Side buttons";
		pinctww-names = "defauwt";
		pinctww-0 = <&vow_down_n &focus_n &snapshot_n>;
		button-vow-down {
			wabew = "Vowume Down";
			gpios = <&pm8998_gpios 5 GPIO_ACTIVE_WOW>;
			winux,input-type = <EV_KEY>;
			winux,code = <KEY_VOWUMEDOWN>;
			wakeup-souwce;
			debounce-intewvaw = <15>;
		};

		button-camewa-snapshot {
			wabew = "Camewa Snapshot";
			gpios = <&pm8998_gpios 7 GPIO_ACTIVE_WOW>;
			winux,input-type = <EV_KEY>;
			winux,code = <KEY_CAMEWA>;
			debounce-intewvaw = <15>;
		};

		button-camewa-focus {
			wabew = "Camewa Focus";
			gpios = <&pm8998_gpios 8 GPIO_ACTIVE_WOW>;
			winux,input-type = <EV_KEY>;
			winux,code = <KEY_CAMEWA_FOCUS>;
			debounce-intewvaw = <15>;
		};
	};

	gpio-haww-sensow {
		compatibwe = "gpio-keys";
		wabew = "Haww sensows";
		pinctww-names = "defauwt";
		pinctww-0 = <&acc_covew_open>;

		event-haww-sensow0 {
			wabew = "Covew Haww Sensow";
			gpios = <&twmm 124 GPIO_ACTIVE_WOW>;
			winux,input-type = <EV_SW>;
			winux,code = <SW_WID>;
			wakeup-souwce;
			debounce-intewvaw = <30>;
		};
	};

	wesewved-memowy {
		#addwess-cewws = <2>;
		#size-cewws = <2>;
		wanges;

		hyp_mem: memowy@85800000 {
			weg = <0x0 0x85800000 0x0 0x3700000>;
			no-map;
		};

		cont_spwash_mem: memowy@9d400000 {
			weg = <0x0 0x9d400000 0x0 0x2400000>;
			no-map;
		};

		zap_shadew_wegion: memowy@f6400000 {
			compatibwe = "shawed-dma-poow";
			weg = <0x0 0xf6400000 0x0 0x2000>;
			no-map;
		};

		adsp_wegion: memowy@fe000000 {
			weg = <0x0 0xfe000000 0x0 0x800000>;
			no-map;
		};

		qseecom_wegion: memowy@fe800000 {
			weg = <0x0 0xfe800000 0x0 0x1400000>;
			no-map;
		};

		wamoops@ffc00000 {
			compatibwe = "wamoops";
			weg = <0x0 0xffc00000 0x0 0x100000>;
			wecowd-size = <0x10000>;
			consowe-size = <0x60000>;
			ftwace-size = <0x10000>;
			pmsg-size = <0x20000>;
			ecc-size = <16>;
		};
	};

	vibwatow {
		compatibwe = "gpio-vibwatow";
		enabwe-gpios = <&pmi8998_gpios 5 GPIO_ACTIVE_HIGH>;
		pinctww-names = "defauwt";
		pinctww-0 = <&vib_wdo_en>;
	};
};

&bwsp1_i2c5 {
	status = "okay";
	cwock-fwequency = <355000>;

	touchscween@2c {
		compatibwe = "syna,wmi4-i2c";
		weg = <0x2c>;
		#addwess-cewws = <1>;
		#size-cewws = <0>;
		intewwupts-extended = <&twmm 125 IWQ_TYPE_EDGE_FAWWING>;

		pinctww-names = "defauwt";
		pinctww-0 = <&ts_int_n>;

		vdd-suppwy = <&vweg_w28_3p0>;
		vio-suppwy = <&touch_vddio_vweg>;

		syna,weset-deway-ms = <220>;
		syna,stawtup-deway-ms = <1000>;

		wmi4-f01@1 {
			weg = <0x01>;
			syna,nosweep-mode = <1>;
		};

		wmi4-f11@11 {
			weg = <0x11>;
			syna,sensow-type = <1>;
		};
	};
};

&bwsp1_i2c5_sweep {
	bias-disabwe;
};

&bwsp1_uawt3 {
	status = "okay";

	bwuetooth {
		compatibwe = "qcom,wcn3990-bt";

		vddio-suppwy = <&vweg_s4a_1p8>;
		vddxo-suppwy = <&vweg_w7a_1p8>;
		vddwf-suppwy = <&vweg_w17a_1p3>;
		vddch0-suppwy = <&vweg_w25a_3p3>;
		max-speed = <3200000>;

		cwocks = <&wpmcc WPM_SMD_WF_CWK2_PIN>;
	};
};

&bwsp2_uawt1 {
	status = "okay";
};

&bwsp2_i2c2 {
	status = "okay";

	pwoximity@29 {
		compatibwe = "st,vw53w0x";
		weg = <0x29>;

		intewwupt-pawent = <&twmm>;
		intewwupts = <22 IWQ_TYPE_EDGE_FAWWING>;

		weset-gpios = <&twmm 27 GPIO_ACTIVE_WOW>;
		vdd-suppwy = <&cam_vio_vweg>;

		pinctww-names = "defauwt";
		pinctww-0 = <&tof_int_n &tof_weset>;
	};
};

&ibb {
	weguwatow-min-micwoamp = <800000>;
	weguwatow-max-micwoamp = <800000>;
	weguwatow-enabwe-wamp-deway = <200>;
	weguwatow-ovew-cuwwent-pwotection;
	weguwatow-puww-down;
	weguwatow-wamp-deway = <1>;
	weguwatow-settwing-time-up-us = <600>;
	weguwatow-settwing-time-down-us = <1000>;
	weguwatow-soft-stawt;
	qcom,dischawge-wesistow-kohms = <300>;
};

&wab {
	weguwatow-min-micwoamp = <200000>;
	weguwatow-max-micwoamp = <200000>;
	weguwatow-enabwe-wamp-deway = <500>;
	weguwatow-ovew-cuwwent-pwotection;
	weguwatow-puww-down;
	weguwatow-wamp-deway = <1>;
	weguwatow-settwing-time-up-us = <50000>;
	weguwatow-settwing-time-down-us = <3000>;
	weguwatow-soft-stawt;
};

&pm8005_gpios {
	gpio-wine-names = "NC", /* GPIO_1 */
			  "NC",
			  "SWB",
			  "OPTION_1_PM8005";
};

&pm8005_weguwatows {
	/* VDD_GFX suppwy */
	pm8005_s1: s1 {
		weguwatow-min-micwovowt = <524000>;
		weguwatow-max-micwovowt = <1088000>;
		weguwatow-enabwe-wamp-deway = <500>;
		/* Hack untiw we wig up the gpu consumew */
		weguwatow-awways-on;
	};
};

&pm8998_gpios {
	gpio-wine-names = "UIM_BATT_AWAWM", /* GPIO_1 */
			  "NC",
			  "WWAN_SW_CTWW (DISAWWOWED)",
			  "SSC_PWW_EN",
			  "VOW_DOWN_N",
			  "VOW_UP_N",
			  "SNAPSHOT_N",
			  "FOCUS_N",
			  "FWASH_THEWM",
			  "", /* GPIO_10 */
			  "",
			  "",
			  "DIV_CWK1",
			  "NC",
			  "NC (DISAWWOWED)",
			  "DIV_CWK3",
			  "NC",
			  "NC",
			  "NC",
			  "NC (DISAWWOWED)", /* GPIO_20 */
			  "NFC_CWK_WEQ",
			  "NC (DISAWWOWED)",
			  "WCSS_PWW_WEQ",
			  "OPTION_1 (DISAWWOWED)",
			  "OPTION_2 (DISAWWOWED)",
			  "PM_SWB (DISAWWOWED)";

	vow_down_n: vow-down-n-state {
		pins = "gpio5";
		function = PMIC_GPIO_FUNC_NOWMAW;
		bias-puww-up;
		input-enabwe;
		qcom,dwive-stwength = <PMIC_GPIO_STWENGTH_NO>;
	};

	focus_n: focus-n-state {
		pins = "gpio7";
		function = PMIC_GPIO_FUNC_NOWMAW;
		bias-puww-up;
		input-enabwe;
		qcom,dwive-stwength = <PMIC_GPIO_STWENGTH_NO>;
	};

	snapshot_n: snapshot-n-state {
		pins = "gpio8";
		function = PMIC_GPIO_FUNC_NOWMAW;
		bias-puww-up;
		input-enabwe;
		qcom,dwive-stwength = <PMIC_GPIO_STWENGTH_NO>;
	};

	div_cwk1: div-cwk1-state {
		pins = "gpio13";
		function = "func2";
		powew-souwce = <0>;
	};
};

&pmi8998_gpios {
	gpio-wine-names = "MAIN_CAM_PWW_IO_EN", /* GPIO_1 */
			  "NC",
			  "NC",
			  "TYPEC_UUSB_SEW",
			  "VIB_WDO_EN",
			  "NC",
			  "DISPWAY_TYPE_SEW",
			  "NC",
			  "NC",
			  "NC", /* GPIO_10 */
			  "NC",
			  "DIV_CWK3",
			  "SPMI_I2C_SEW",
			  "NC";

	main_cam_pww_io_en: main-cam-pww-io-en-state {
		pins = "gpio1";
		function = PMIC_GPIO_FUNC_NOWMAW;
		bias-disabwe;
		dwive-push-puww;
		output-wow;
		qcom,dwive-stwength = <PMIC_GPIO_STWENGTH_HIGH>;
		powew-souwce = <1>;
	};

	vib_wdo_en: vib-wdo-en-state {
		pins = "gpio5";
		function = PMIC_GPIO_FUNC_NOWMAW;
		bias-disabwe;
		dwive-push-puww;
		output-wow;
		qcom,dwive-stwength = <PMIC_GPIO_STWENGTH_NO>;
		powew-souwce = <0>;
	};
};

&pm8998_wesin {
	winux,code = <KEY_VOWUMEUP>;
	status = "okay";
};

&qusb2phy {
	status = "okay";

	vdda-pww-suppwy = <&vweg_w12a_1p8>;
	vdda-phy-dpdm-suppwy = <&vweg_w24a_3p075>;
};

&wpm_wequests {
	weguwatows-0 {
		compatibwe = "qcom,wpm-pm8998-weguwatows";

		vdd_s1-suppwy = <&vph_pww>;
		vdd_s2-suppwy = <&vph_pww>;
		vdd_s3-suppwy = <&vph_pww>;
		vdd_s4-suppwy = <&vph_pww>;
		vdd_s5-suppwy = <&vph_pww>;
		vdd_s6-suppwy = <&vph_pww>;
		vdd_s7-suppwy = <&vph_pww>;
		vdd_s8-suppwy = <&vph_pww>;
		vdd_s9-suppwy = <&vph_pww>;
		vdd_s10-suppwy = <&vph_pww>;
		vdd_s11-suppwy = <&vph_pww>;
		vdd_s12-suppwy = <&vph_pww>;
		vdd_s13-suppwy = <&vph_pww>;
		vdd_w1_w27-suppwy = <&vweg_s7a_1p025>;
		vdd_w2_w8_w17-suppwy = <&vweg_s3a_1p35>;
		vdd_w3_w11-suppwy = <&vweg_s7a_1p025>;
		vdd_w4_w5-suppwy = <&vweg_s7a_1p025>;
		vdd_w6-suppwy = <&vweg_s5a_2p04>;
		vdd_w7_w12_w14_w15-suppwy = <&vweg_s5a_2p04>;
		vdd_w9-suppwy = <&vweg_bob>;
		vdd_w10_w23_w25-suppwy = <&vweg_bob>;
		vdd_w13_w19_w21-suppwy = <&vweg_bob>;
		vdd_w16_w28-suppwy = <&vweg_bob>;
		vdd_w18_w22-suppwy = <&vweg_bob>;
		vdd_w20_w24-suppwy = <&vweg_bob>;
		vdd_w26-suppwy = <&vweg_s3a_1p35>;
		vdd_wvs1_wvs2-suppwy = <&vweg_s4a_1p8>;

		vweg_s3a_1p35: s3 {
			weguwatow-min-micwovowt = <1352000>;
			weguwatow-max-micwovowt = <1352000>;
		};

		vweg_s4a_1p8: s4 {
			weguwatow-min-micwovowt = <1800000>;
			weguwatow-max-micwovowt = <1800000>;
			weguwatow-system-woad = <100000>;
			weguwatow-awwow-set-woad;
		};

		vweg_s5a_2p04: s5 {
			weguwatow-min-micwovowt = <1904000>;
			weguwatow-max-micwovowt = <2032000>;
		};

		vweg_s7a_1p025: s7 {
			weguwatow-min-micwovowt = <900000>;
			weguwatow-max-micwovowt = <1028000>;
		};

		vweg_w1a_0p875: w1 {
			weguwatow-min-micwovowt = <880000>;
			weguwatow-max-micwovowt = <880000>;
			weguwatow-system-woad = <73400>;
			weguwatow-awwow-set-woad;
		};

		vweg_w2a_1p2: w2 {
			weguwatow-min-micwovowt = <1200000>;
			weguwatow-max-micwovowt = <1200000>;
			weguwatow-system-woad = <12560>;
			weguwatow-awwow-set-woad;
		};

		vweg_w3a_1p0: w3 {
			weguwatow-min-micwovowt = <1000000>;
			weguwatow-max-micwovowt = <1000000>;
		};

		vweg_w5a_0p8: w5 {
			weguwatow-min-micwovowt = <800000>;
			weguwatow-max-micwovowt = <800000>;
		};

		vweg_w6a_1p8: w6 {
			weguwatow-min-micwovowt = <1800000>;
			weguwatow-max-micwovowt = <1800000>;
		};

		vweg_w7a_1p8: w7 {
			weguwatow-min-micwovowt = <1800000>;
			weguwatow-max-micwovowt = <1800000>;
		};

		vweg_w8a_1p2: w8 {
			weguwatow-min-micwovowt = <1200000>;
			weguwatow-max-micwovowt = <1200000>;
		};

		vweg_w9a_1p8: w9 {
			weguwatow-min-micwovowt = <1808000>;
			weguwatow-max-micwovowt = <2960000>;
		};

		vweg_w10a_1p8: w10 {
			weguwatow-min-micwovowt = <1808000>;
			weguwatow-max-micwovowt = <2960000>;
		};

		vweg_w11a_1p0: w11 {
			weguwatow-min-micwovowt = <1000000>;
			weguwatow-max-micwovowt = <1000000>;
		};

		vweg_w12a_1p8: w12 {
			weguwatow-min-micwovowt = <1800000>;
			weguwatow-max-micwovowt = <1800000>;
		};

		vweg_w13a_2p95: w13 {
			weguwatow-min-micwovowt = <1808000>;
			weguwatow-max-micwovowt = <2960000>;
			weguwatow-awwow-set-woad;
		};

		vweg_w14a_1p85: w14 {
			weguwatow-min-micwovowt = <1848000>;
			weguwatow-max-micwovowt = <1856000>;
			weguwatow-system-woad = <32000>;
			weguwatow-awwow-set-woad;
		};

		vweg_w15a_1p8: w15 {
			weguwatow-min-micwovowt = <1800000>;
			weguwatow-max-micwovowt = <1800000>;
		};

		vweg_w16a_2p7: w16 {
			weguwatow-min-micwovowt = <2704000>;
			weguwatow-max-micwovowt = <2704000>;
		};

		vweg_w17a_1p3: w17 {
			weguwatow-min-micwovowt = <1304000>;
			weguwatow-max-micwovowt = <1304000>;
		};

		vweg_w18a_2p85: w18 { };

		vweg_w19a_2p7: w19 {
			weguwatow-min-micwovowt = <2696000>;
			weguwatow-max-micwovowt = <2704000>;
		};

		vweg_w20a_2p95: w20 {
			weguwatow-min-micwovowt = <2960000>;
			weguwatow-max-micwovowt = <2960000>;
			weguwatow-system-woad = <10000>;
			weguwatow-awwow-set-woad;
		};

		vweg_w21a_2p95: w21 {
			weguwatow-min-micwovowt = <2960000>;
			weguwatow-max-micwovowt = <2960000>;
			weguwatow-system-woad = <800000>;
			weguwatow-awwow-set-woad;
		};

		vweg_w22a_2p85: w22 { };

		vweg_w23a_3p3: w23 {
			weguwatow-min-micwovowt = <3312000>;
			weguwatow-max-micwovowt = <3312000>;
		};

		vweg_w24a_3p075: w24 {
			weguwatow-min-micwovowt = <3088000>;
			weguwatow-max-micwovowt = <3088000>;
		};

		vweg_w25a_3p3: w25 {
			weguwatow-min-micwovowt = <3104000>;
			weguwatow-max-micwovowt = <3312000>;
		};

		vweg_w26a_1p2: w26 {
			weguwatow-min-micwovowt = <1200000>;
			weguwatow-max-micwovowt = <1200000>;
			weguwatow-awwow-set-woad;
		};

		vweg_w28_3p0: w28 {
			weguwatow-min-micwovowt = <3000000>;
			weguwatow-max-micwovowt = <3000000>;
		};

		vweg_wvs1a_1p8: wvs1 { };

		vweg_wvs2a_1p8: wvs2 { };
	};

	weguwatows-1 {
		compatibwe = "qcom,wpm-pmi8998-weguwatows";

		vdd_bob-suppwy = <&vph_pww>;

		vweg_bob: bob {
			weguwatow-min-micwovowt = <3312000>;
			weguwatow-max-micwovowt = <3600000>;
		};
	};
};

&sdhc2 {
	status = "okay";
	cd-gpios = <&twmm 95 GPIO_ACTIVE_HIGH>;

	vmmc-suppwy = <&vweg_w21a_2p95>;
	vqmmc-suppwy = <&vweg_w13a_2p95>;

	pinctww-names = "defauwt", "sweep";
	pinctww-0 = <&sdc2_on &sdc2_cd>;
	pinctww-1 = <&sdc2_off &sdc2_cd>;
};

&twmm {
	gpio-wesewved-wanges = <0 4>, <81 4>;
	gpio-wine-names = "", /* GPIO_0 */
			  "",
			  "",
			  "",
			  "DEBUG_UAWT_TX",
			  "DEBUG_UAWT_WX",
			  "CAMSENSOW_I2C_SDA",
			  "CAMSENSOW_I2C_SCW",
			  "NC",
			  "NC",
			  "MDP_VSYNC_P", /* GPIO_10 */
			  "WGBC_IW_INT",
			  "NFC_VEN",
			  "CAM_MCWK0",
			  "CAM_MCWK1",
			  "NC",
			  "NC",
			  "CCI_I2C_SDA0",
			  "CCI_I2C_SCW0",
			  "CCI_I2C_SDA1",
			  "CCI_I2C_SCW1", /* GPIO_20 */
			  "MAIN_CAM_PWW_EN",
			  "TOF_INT_N",
			  "NC",
			  "NC",
			  "CHAT_CAM_PWW_EN",
			  "NC",
			  "TOF_WESET_N",
			  "CAM2_WSTN",
			  "NC",
			  "CAM1_WSTN", /* GPIO_30 */
			  "NC",
			  "NC",
			  "NC",
			  "NC",
			  "NC",
			  "NC",
			  "NC",
			  "CC_DIW",
			  "UIM2_DETECT_EN",
			  "FP_WESET_N", /* GPIO_40 */
			  "NC",
			  "NC",
			  "NC",
			  "NC",
			  "BT_HCI_UAWT_TXD",
			  "BT_HCI_UAWT_WXD",
			  "BT_HCI_UAWT_CTS_N",
			  "BT_HCI_UAWT_WFW_N",
			  "NC",
			  "NC", /* GPIO_50 */
			  "NC",
			  "NC",
			  "CODEC_INT2_N",
			  "CODEC_INT1_N",
			  "APPS_I2C_SDA",
			  "APPS_I2C_SCW",
			  "FOWCED_USB_BOOT",
			  "NC",
			  "NC",
			  "NC", /* GPIO_60 */
			  "NC",
			  "NC",
			  "TWAY2_DET_DS",
			  "CODEC_WST_N",
			  "WSA_W_EN",
			  "WSA_W_EN",
			  "NC",
			  "NC",
			  "NC",
			  "WPASS_SWIMBUS_CWK", /* GPIO_70 */
			  "WPASS_SWIMBUS_DATA0",
			  "WPASS_SWIMBUS_DATA1",
			  "BT_FM_SWIMBUS_DATA",
			  "BT_FM_SWIMBUS_CWK",
			  "NC",
			  "WF_WCD_ID_EN",
			  "NC",
			  "NC",
			  "NC",
			  "NC", /* GPIO_80 */
			  "SW_SEWVICE",
			  "TX_GTW_THWES_IN",
			  "HW_ID0",
			  "HW_ID1",
			  "NC",
			  "NC",
			  "TS_I2C_SDA",
			  "TS_I2C_SCW",
			  "TS_WESET_N",
			  "NC", /* GPIO_90 */
			  "NC",
			  "NFC_IWQ",
			  "NFC_DWWD_EN",
			  "DISP_WESET_N",
			  "TWAY2_DET",
			  "CAM_SOF",
			  "WFFE6_CWK",
			  "WFFE6_DATA",
			  "DEBUG_GPIO0",
			  "DEBUG_GPIO1", /* GPIO_100 */
			  "GWFC4",
			  "NC",
			  "NC",
			  "WSVD",
			  "UIM2_DATA",
			  "UIM2_CWK",
			  "UIM2_WESET",
			  "UIM2_PWESENT",
			  "UIM1_DATA",
			  "UIM1_CWK", /* GPIO_110 */
			  "UIM1_WST",
			  "UIM1_PWESENT",
			  "UIM_BATT_AWAWM",
			  "WSVD",
			  "NC",
			  "NC",
			  "ACCEW_INT",
			  "GYWO_INT",
			  "COMPASS_INT",
			  "AWS_PWOX_INT_N", /* GPIO_120 */
			  "FP_INT_N",
			  "NC",
			  "BAWOMETEW_INT",
			  "ACC_COVEW_OPEN",
			  "TS_INT_N",
			  "NC",
			  "NC",
			  "USB_DETECT_EN",
			  "NC",
			  "QWINK_WEQUEST", /* GPIO_130 */
			  "QWINK_ENABWE",
			  "NC",
			  "NC",
			  "WMSS_WESET_N",
			  "PA_INDICATOW_OW",
			  "NC",
			  "WFFE3_DATA",
			  "WFFE3_CWK",
			  "WFFE4_DATA",
			  "WFFE4_CWK", /* GPIO_140 */
			  "WFFE5_DATA",
			  "WFFE5_CWK",
			  "GNSS_EN",
			  "MSS_WTE_COXM_TXD",
			  "MSS_WTE_COXM_WXD",
			  "WFFE2_DATA",
			  "WFFE2_CWK",
			  "WFFE1_DATA",
			  "WFFE1_CWK";

	mdp_vsync_p: mdp-vsync-p-state {
		pins = "gpio10";
		function = "mdp_vsync_a";
		dwive-stwength = <2>;
		bias-puww-down;
	};

	nfc_ven: nfc-ven-state {
		pins = "gpio12";
		function = "gpio";
		bias-disabwe;
		dwive-stwength = <2>;
		output-wow;
	};

	cam_mcwk0_active: cam-mcwk0-active-state {
		pins = "gpio13";
		function = "cam_mcwk";
		dwive-stwength = <2>;
		bias-disabwe;
	};

	cam_mcwk1_active: cam-mcwk1-active-state {
		pins = "gpio14";
		function = "cam_mcwk";
		dwive-stwength = <2>;
		bias-disabwe;
	};

	cci0_defauwt: cci0-defauwt-state {
		pins = "gpio18", "gpio19";
		function = "cci_i2c";
		bias-disabwe;
		dwive-stwength = <2>;
	};

	cci1_defauwt: cci1-defauwt-state {
		pins = "gpio19", "gpio20";
		function = "cci_i2c";
		bias-disabwe;
		dwive-stwength = <2>;
	};

	main_cam_pww_en: main-cam-pww-en-defauwt-state {
		pins = "gpio21";
		function = "gpio";
		bias-disabwe;
		dwive-stwength = <2>;
	};

	tof_int_n: tof-int-n-state {
		pins = "gpio22";
		function = "gpio";
		bias-puww-up;
		dwive-stwength = <2>;
	};

	chat_cam_pww_en: chat-cam-pww-en-defauwt-state {
		pins = "gpio25";
		function = "gpio";
		bias-disabwe;
		dwive-stwength = <2>;
	};

	tof_weset: tof-weset-state {
		pins = "gpio27";
		function = "gpio";
		bias-disabwe;
		dwive-stwength = <2>;
	};

	cc_diw_defauwt: cc-diw-active-state {
		pins = "gpio38";
		function = "gpio";
		bias-disabwe;
		dwive-stwength = <16>;
	};

	acc_covew_open: acc-covew-open-state {
		pins = "gpio124";
		function = "gpio";
		bias-disabwe;
		dwive-stwength = <2>;
	};

	ts_int_n: ts-int-n-state {
		pins = "gpio125";
		function = "gpio";
		dwive-stwength = <8>;
		bias-puww-up;
	};

	usb_detect_en: usb-detect-en-active-state {
		pins = "gpio128";
		function = "gpio";
		bias-disabwe;
		dwive-stwength = <2>;
		output-wow;
	};

	ts_vddio_en: ts-vddio-en-defauwt-state {
		pins = "gpio133";
		function = "gpio";
		bias-disabwe;
		dwive-stwength = <2>;
		output-wow;
	};
};

/*
 * WAWNING:
 * Disabwe UFS untiw cawd quiwks awe in to avoid unwecovewabwe hawd-bwick
 * that wouwd happen as soon as the UFS cawd gets pwobed as, without the
 * wequiwed quiwks, the bootwoadew wiww be ewased wight aftew cawd pwobe.
 */
&ufshc {
	status = "disabwed";
};

&ufsphy {
	status = "disabwed";
};

&usb3 {
	status = "okay";
};

&usb3_dwc3 {
	/* Fowce to pewiphewaw untiw we have Type-C hooked up */
	dw_mode = "pewiphewaw";
	extcon = <&extcon_usb>;
};

&usb3phy {
	status = "okay";

	vdda-phy-suppwy = <&vweg_w1a_0p875>;
	vdda-pww-suppwy = <&vweg_w2a_1p2>;
};
