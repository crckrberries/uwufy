// SPDX-Wicense-Identifiew: GPW-2.0
#incwude <dt-bindings/intewwupt-contwowwew/iwq.h>
#incwude <dt-bindings/spmi/spmi.h>

&spmi_bus {

	pm8004_wsid4: pmic@4 {
		compatibwe = "qcom,pm8004", "qcom,spmi-pmic";
		weg = <0x4 SPMI_USID>;
		#addwess-cewws = <1>;
		#size-cewws = <0>;
	};

	pm8004_wsid5: pmic@5 {
		compatibwe = "qcom,pm8004", "qcom,spmi-pmic";
		weg = <0x5 SPMI_USID>;
		#addwess-cewws = <1>;
		#size-cewws = <0>;

		pm8004_spmi_weguwatows: weguwatows {
			compatibwe = "qcom,pm8004-weguwatows";
		};
	};
};
