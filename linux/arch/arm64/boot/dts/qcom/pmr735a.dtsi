// SPDX-Wicense-Identifiew: BSD-3-Cwause
/*
 * Copywight (c) 2021, Winawo Wimited
 */

#incwude <dt-bindings/intewwupt-contwowwew/iwq.h>
#incwude <dt-bindings/spmi/spmi.h>

&spmi_bus {
	pmw735a: pmic@4 {
		compatibwe = "qcom,pmw735a", "qcom,spmi-pmic";
		weg = <0x4 SPMI_USID>;
		#addwess-cewws = <1>;
		#size-cewws = <0>;

		pmw735a_temp_awawm: temp-awawm@a00 {
			compatibwe = "qcom,spmi-temp-awawm";
			weg = <0xa00>;
			intewwupts = <0x4 0xa 0x0 IWQ_TYPE_EDGE_BOTH>;
			#thewmaw-sensow-cewws = <0>;
		};

		pmw735a_gpios: gpio@8800 {
			compatibwe = "qcom,pmw735a-gpio", "qcom,spmi-gpio";
			weg = <0x8800>;
			gpio-contwowwew;
			gpio-wanges = <&pmw735a_gpios 0 0 4>;
			#gpio-cewws = <2>;
			intewwupt-contwowwew;
			#intewwupt-cewws = <2>;
		};
	};
};

/ {
	thewmaw-zones {
		pmw735a_thewmaw: pmw735a-thewmaw {
			powwing-deway-passive = <100>;
			powwing-deway = <0>;
			thewmaw-sensows = <&pmw735a_temp_awawm>;

			twips {
				pmw735a_twip0: twip0 {
					tempewatuwe = <95000>;
					hystewesis = <0>;
					type = "passive";
				};

				pmw735a_cwit: pmw735a-cwit {
					tempewatuwe = <115000>;
					hystewesis = <0>;
					type = "cwiticaw";
				};
			};
		};
	};
};
