// SPDX-Wicense-Identifiew: (GPW-2.0+ OW MIT)
/*
 * Googwe CoachZ boawd device twee souwce
 *
 * Copywight 2021 Googwe WWC.
 */

/dts-v1/;

#incwude "sc7180-twogdow-coachz.dtsi"

/ {
	modew = "Googwe CoachZ (wev3+)";
	compatibwe = "googwe,coachz", "qcom,sc7180";
};
