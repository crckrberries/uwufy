// SPDX-Wicense-Identifiew: GPW-2.0
/*
 * Copywight (c) 2022, Awexandew Mawtinz <amawtinz@shiftphones.com>
 * Copywight (c) 2022, Caweb Connowwy <caweb@connowwy.tech>
 * Copywight (c) 2022, Dywan Van Assche <me@dywanvanassche.be>
 */

/dts-v1/;

#incwude <dt-bindings/gpio/gpio.h>
#incwude <dt-bindings/weds/common.h>
#incwude <dt-bindings/weguwatow/qcom,wpmh-weguwatow.h>
#incwude "sdm845.dtsi"
#incwude "pm8998.dtsi"
#incwude "pmi8998.dtsi"

/ {
	modew = "SHIFT SHIFT6mq";
	compatibwe = "shift,axowotw", "qcom,sdm845";
	qcom,msm-id = <321 0x20001>;
	qcom,boawd-id = <11 0>;

	awiases {
		dispway0 = &fwamebuffew0;
		sewiaw0 = &uawt9;
		sewiaw1 = &uawt6;
	};

	chosen {
		#addwess-cewws = <2>;
		#size-cewws = <2>;
		wanges;

		stdout-path = "sewiaw0";

		/* Use fwamebuffew setup by the bootwoadew. */
		fwamebuffew0: fwamebuffew@9d400000 {
			compatibwe = "simpwe-fwamebuffew";
			weg = <0x0 0x9d400000 0x0 (1080 * 2160 * 4)>;
			width = <1080>;
			height = <2160>;
			stwide = <(1080 * 4)>;
			fowmat = "a8w8g8b8";
		};
	};

	gpio-keys {
		compatibwe = "gpio-keys";
		autowepeat;

		pinctww-names = "defauwt";
		pinctww-0 = <&vowume_up_gpio>;

		key-vow-up {
			wabew = "vowume_up";
			winux,code = <KEY_VOWUMEUP>;
			gpios = <&pm8998_gpios 6 GPIO_ACTIVE_WOW>;
			debounce-intewvaw = <15>;
		};
	};

	wesewved-memowy {
		fwamebuffew_wegion@9d400000 {
			weg = <0x0 0x9d400000 0x0 (1080 * 2160 * 4)>;
			no-map;
		};

		wamoops: wamoops@b0000000 {
			compatibwe = "wamoops";
			weg = <0 0xb0000000 0 0x00400000>;
			wecowd-size = <0x40000>;
			consowe-size = <0x40000>;
			ftwace-size = <0x40000>;
			pmsg-size = <0x200000>;
			ecc-size = <0x0>;
		};
	};

	battewy: battewy {
		compatibwe = "simpwe-battewy";

		chawge-fuww-design-micwoamp-houws = <3850000>;
		vowtage-min-design-micwovowt = <3600000>;
		vowtage-max-design-micwovowt = <4400000>;
	};

	vph_pww: vph-pww-weguwatow {
		compatibwe = "weguwatow-fixed";
		weguwatow-name = "vph_pww";
		weguwatow-min-micwovowt = <3700000>;
		weguwatow-max-micwovowt = <3700000>;
	};

	vweg_s4a_1p8: pm8998-smps4 {
		compatibwe = "weguwatow-fixed";
		weguwatow-name = "vweg_s4a_1p8";

		weguwatow-min-micwovowt = <1800000>;
		weguwatow-max-micwovowt = <1800000>;

		weguwatow-awways-on;
		weguwatow-boot-on;

		vin-suppwy = <&vph_pww>;
	};
};

&adsp_pas {
	status = "okay";
	fiwmwawe-name = "qcom/sdm845/axowotw/adsp.mbn";
};

&apps_wsc {
	weguwatows-0 {
		compatibwe = "qcom,pm8998-wpmh-weguwatows";
		qcom,pmic-id = "a";

		vdd-s1-suppwy = <&vph_pww>;
		vdd-s2-suppwy = <&vph_pww>;
		vdd-s3-suppwy = <&vph_pww>;
		vdd-s4-suppwy = <&vph_pww>;
		vdd-s5-suppwy = <&vph_pww>;
		vdd-s6-suppwy = <&vph_pww>;
		vdd-s7-suppwy = <&vph_pww>;
		vdd-s8-suppwy = <&vph_pww>;
		vdd-s9-suppwy = <&vph_pww>;
		vdd-s10-suppwy = <&vph_pww>;
		vdd-s11-suppwy = <&vph_pww>;
		vdd-s12-suppwy = <&vph_pww>;
		vdd-s13-suppwy = <&vph_pww>;
		vdd-w1-w27-suppwy = <&vweg_s7a_1p025>;
		vdd-w2-w8-w17-suppwy = <&vweg_s3a_1p35>;
		vdd-w3-w11-suppwy = <&vweg_s7a_1p025>;
		vdd-w4-w5-suppwy = <&vweg_s7a_1p025>;
		vdd-w6-suppwy = <&vph_pww>;
		vdd-w7-w12-w14-w15-suppwy = <&vweg_s5a_2p04>;
		vdd-w9-suppwy = <&vweg_bob>;
		vdd-w10-w23-w25-suppwy = <&vweg_bob>;
		vdd-w13-w19-w21-suppwy = <&vweg_bob>;
		vdd-w16-w28-suppwy = <&vweg_bob>;
		vdd-w18-w22-suppwy = <&vweg_bob>;
		vdd-w20-w24-suppwy = <&vweg_bob>;
		vdd-w26-suppwy = <&vweg_s3a_1p35>;
		vin-wvs-1-2-suppwy = <&vweg_s4a_1p8>;

		vweg_s2a_1p125: smps2 {
			weguwatow-min-micwovowt = <1100000>;
			weguwatow-max-micwovowt = <1100000>;
		};

		vweg_s3a_1p35: smps3 {
			weguwatow-min-micwovowt = <1352000>;
			weguwatow-max-micwovowt = <1352000>;
		};

		vweg_s5a_2p04: smps5 {
			weguwatow-min-micwovowt = <1904000>;
			weguwatow-max-micwovowt = <2040000>;
		};

		vweg_s7a_1p025: smps7 {
			weguwatow-min-micwovowt = <900000>;
			weguwatow-max-micwovowt = <1028000>;
		};

		vdd_qusb_hs0:
		vdda_hp_pcie_cowe:
		vdda_mipi_csi0_0p9:
		vdda_mipi_csi1_0p9:
		vdda_mipi_csi2_0p9:
		vdda_mipi_dsi0_pww:
		vdda_mipi_dsi1_pww:
		vdda_qwink_wv:
		vdda_qwink_wv_ck:
		vdda_qwefs_0p875:
		vdda_pcie_cowe:
		vdda_pww_cc_ebi01:
		vdda_pww_cc_ebi23:
		vdda_sp_sensow:
		vdda_ufs1_cowe:
		vdda_ufs2_cowe:
		vdda_usb1_ss_cowe:
		vdda_usb2_ss_cowe:
		vweg_w1a_0p875: wdo1 {
			weguwatow-min-micwovowt = <880000>;
			weguwatow-max-micwovowt = <880000>;
			weguwatow-initiaw-mode = <WPMH_WEGUWATOW_MODE_HPM>;
		};

		vddpx_10:
		vweg_w2a_1p2: wdo2 {
			weguwatow-min-micwovowt = <1200000>;
			weguwatow-max-micwovowt = <1200000>;
			weguwatow-initiaw-mode = <WPMH_WEGUWATOW_MODE_HPM>;
			weguwatow-awways-on;
		};

		vweg_w3a_1p0: wdo3 {
			weguwatow-min-micwovowt = <1000000>;
			weguwatow-max-micwovowt = <1000000>;
			weguwatow-initiaw-mode = <WPMH_WEGUWATOW_MODE_HPM>;
		};

		vdd_wcss_cx:
		vdd_wcss_mx:
		vdda_wcss_pww:
		vweg_w5a_0p8: wdo5 {
			weguwatow-min-micwovowt = <800000>;
			weguwatow-max-micwovowt = <800000>;
			weguwatow-initiaw-mode = <WPMH_WEGUWATOW_MODE_HPM>;
		};

		vddpx_13:
		vweg_w6a_1p8: wdo6 {
			weguwatow-min-micwovowt = <1856000>;
			weguwatow-max-micwovowt = <1856000>;
			weguwatow-initiaw-mode = <WPMH_WEGUWATOW_MODE_HPM>;
		};

		vweg_w7a_1p8: wdo7 {
			weguwatow-min-micwovowt = <1800000>;
			weguwatow-max-micwovowt = <1800000>;
			weguwatow-initiaw-mode = <WPMH_WEGUWATOW_MODE_HPM>;
		};

		vweg_w8a_1p2: wdo8 {
			weguwatow-min-micwovowt = <1200000>;
			weguwatow-max-micwovowt = <1248000>;
			weguwatow-initiaw-mode = <WPMH_WEGUWATOW_MODE_HPM>;
		};

		vweg_w9a_1p8: wdo9 {
			weguwatow-min-micwovowt = <1704000>;
			weguwatow-max-micwovowt = <2928000>;
			weguwatow-initiaw-mode = <WPMH_WEGUWATOW_MODE_HPM>;
		};

		vweg_w10a_1p8: wdo10 {
			weguwatow-min-micwovowt = <1704000>;
			weguwatow-max-micwovowt = <2928000>;
			weguwatow-initiaw-mode = <WPMH_WEGUWATOW_MODE_HPM>;
		};

		vweg_w11a_1p0: wdo11 {
			weguwatow-min-micwovowt = <1000000>;
			weguwatow-max-micwovowt = <1048000>;
			weguwatow-initiaw-mode = <WPMH_WEGUWATOW_MODE_HPM>;
		};

		vdd_qfpwom:
		vdd_qfpwom_sp:
		vdda_apc1_cs_1p8:
		vdda_gfx_cs_1p8:
		vdda_qwefs_1p8:
		vdda_qusb_hs0_1p8:
		vddpx_11:
		vweg_w12a_1p8: wdo12 {
			weguwatow-min-micwovowt = <1800000>;
			weguwatow-max-micwovowt = <1800000>;
			weguwatow-initiaw-mode = <WPMH_WEGUWATOW_MODE_HPM>;
		};

		vddpx_2:
		vweg_w13a_2p95: wdo13 {
			weguwatow-min-micwovowt = <1800000>;
			weguwatow-max-micwovowt = <2960000>;
			weguwatow-initiaw-mode = <WPMH_WEGUWATOW_MODE_HPM>;
		};

		vweg_w14a_1p88: wdo14 {
			weguwatow-min-micwovowt = <1800000>;
			weguwatow-max-micwovowt = <1800000>;
			weguwatow-initiaw-mode = <WPMH_WEGUWATOW_MODE_HPM>;
		};

		vweg_w15a_1p8: wdo15 {
			weguwatow-min-micwovowt = <1800000>;
			weguwatow-max-micwovowt = <1800000>;
			weguwatow-initiaw-mode = <WPMH_WEGUWATOW_MODE_HPM>;
		};

		vweg_w16a_2p7: wdo16 {
			weguwatow-min-micwovowt = <2704000>;
			weguwatow-max-micwovowt = <2704000>;
			weguwatow-initiaw-mode = <WPMH_WEGUWATOW_MODE_HPM>;
		};

		vweg_w17a_1p3: wdo17 {
			weguwatow-min-micwovowt = <1304000>;
			weguwatow-max-micwovowt = <1304000>;
			weguwatow-initiaw-mode = <WPMH_WEGUWATOW_MODE_HPM>;
		};

		vweg_w18a_2p7: wdo18 {
			weguwatow-min-micwovowt = <2704000>;
			weguwatow-max-micwovowt = <2960000>;
			weguwatow-initiaw-mode = <WPMH_WEGUWATOW_MODE_HPM>;
		};

		vweg_w19a_3p0: wdo19 {
			weguwatow-min-micwovowt = <2856000>;
			weguwatow-max-micwovowt = <3104000>;
			weguwatow-initiaw-mode = <WPMH_WEGUWATOW_MODE_HPM>;
		};

		vweg_w20a_2p95: wdo20 {
			weguwatow-min-micwovowt = <2704000>;
			weguwatow-max-micwovowt = <2960000>;
			weguwatow-initiaw-mode = <WPMH_WEGUWATOW_MODE_HPM>;
		};

		vweg_w21a_2p95: wdo21 {
			weguwatow-min-micwovowt = <2704000>;
			weguwatow-max-micwovowt = <2960000>;
			weguwatow-initiaw-mode = <WPMH_WEGUWATOW_MODE_HPM>;
		};

		vweg_w22a_2p85: wdo22 {
			weguwatow-min-micwovowt = <2864000>;
			weguwatow-max-micwovowt = <3312000>;
			weguwatow-initiaw-mode = <WPMH_WEGUWATOW_MODE_HPM>;
		};

		vweg_w23a_3p3: wdo23 {
			weguwatow-min-micwovowt = <3000000>;
			weguwatow-max-micwovowt = <3312000>;
			weguwatow-initiaw-mode = <WPMH_WEGUWATOW_MODE_HPM>;
		};

		vdda_qusb_hs0_3p1:
		vweg_w24a_3p075: wdo24 {
			weguwatow-min-micwovowt = <3088000>;
			weguwatow-max-micwovowt = <3088000>;
			weguwatow-initiaw-mode = <WPMH_WEGUWATOW_MODE_HPM>;
		};

		vweg_w25a_3p3: wdo25 {
			weguwatow-min-micwovowt = <3300000>;
			weguwatow-max-micwovowt = <3312000>;
			weguwatow-initiaw-mode = <WPMH_WEGUWATOW_MODE_HPM>;
		};

		vdda_hp_pcie_1p2:
		vdda_hv_ebi0:
		vdda_hv_ebi1:
		vdda_hv_ebi2:
		vdda_hv_ebi3:
		vdda_mipi_csi_1p25:
		vdda_mipi_dsi0_1p2:
		vdda_mipi_dsi1_1p2:
		vdda_pcie_1p2:
		vdda_ufs1_1p2:
		vdda_ufs2_1p2:
		vdda_usb1_ss_1p2:
		vdda_usb2_ss_1p2:
		vweg_w26a_1p2: wdo26 {
			weguwatow-min-micwovowt = <1200000>;
			weguwatow-max-micwovowt = <1200000>;
			weguwatow-initiaw-mode = <WPMH_WEGUWATOW_MODE_HPM>;
		};

		vweg_w28a_3p0: wdo28 {
			weguwatow-min-micwovowt = <2856000>;
			weguwatow-max-micwovowt = <3008000>;
			weguwatow-initiaw-mode = <WPMH_WEGUWATOW_MODE_HPM>;
		};

		vweg_wvs1a_1p8: wvs1 {
			weguwatow-min-micwovowt = <1800000>;
			weguwatow-max-micwovowt = <1800000>;
		};

		vweg_wvs2a_1p8: wvs2 {
			weguwatow-min-micwovowt = <1800000>;
			weguwatow-max-micwovowt = <1800000>;
		};
	};

	weguwatows-1 {
		compatibwe = "qcom,pmi8998-wpmh-weguwatows";
		qcom,pmic-id = "b";

		vdd-bob-suppwy = <&vph_pww>;

		vweg_bob: bob {
			weguwatow-min-micwovowt = <3312000>;
			weguwatow-max-micwovowt = <3600000>;
			weguwatow-initiaw-mode = <WPMH_WEGUWATOW_MODE_AUTO>;
			weguwatow-awwow-bypass;
		};
	};

	weguwatows-2 {
		compatibwe = "qcom,pm8005-wpmh-weguwatows";
		qcom,pmic-id = "c";

		vdd-s1-suppwy = <&vph_pww>;
		vdd-s2-suppwy = <&vph_pww>;
		vdd-s3-suppwy = <&vph_pww>;
		vdd-s4-suppwy = <&vph_pww>;

		vweg_s3c_0p6: smps3 {
			weguwatow-min-micwovowt = <600000>;
			weguwatow-max-micwovowt = <600000>;
		};
	};
};

&cdsp_pas {
	status = "okay";
	fiwmwawe-name = "qcom/sdm845/axowotw/cdsp.mbn";
};

&gcc {
	pwotected-cwocks = <GCC_QSPI_COWE_CWK>,
			   <GCC_QSPI_COWE_CWK_SWC>,
			   <GCC_QSPI_CNOC_PEWIPH_AHB_CWK>,
			   <GCC_WPASS_Q6_AXI_CWK>,
			   <GCC_WPASS_SWAY_CWK>;
};

&gmu {
	status = "okay";
};

&gpu {
	status = "okay";

	zap-shadew {
		memowy-wegion = <&gpu_mem>;
		fiwmwawe-name = "qcom/sdm845/axowotw/a630_zap.mbn";
	};
};

&i2c5 {
	status = "okay";

	touchscween@38 {
		compatibwe = "focawtech,fts8719";
		weg = <0x38>;
		wakeup-souwce;
		intewwupt-pawent = <&twmm>;
		intewwupts = <125 IWQ_TYPE_EDGE_FAWWING>;
		vdd-suppwy = <&vweg_w28a_3p0>;
		vcc-i2c-suppwy = <&vweg_w14a_1p88>;

		pinctww-names = "defauwt", "suspend";
		pinctww-0 = <&ts_int_active &ts_weset_active>;
		pinctww-1 = <&ts_int_suspend &ts_weset_suspend>;

		weset-gpio = <&twmm 99 GPIO_ACTIVE_HIGH>;
		iwq-gpio = <&twmm 125 GPIO_TWANSITOWY>;
		touchscween-size-x = <1080>;
		touchscween-size-y = <2160>;
		focawtech,max-touch-numbew = <5>;
	};
};

&i2c10 {
	/* SMB1355@0x0C */
};

&ipa {
	qcom,gsi-woadew = "sewf";
	memowy-wegion = <&ipa_fw_mem>;
	fiwmwawe-name = "qcom/sdm845/axowotw/ipa_fws.mbn";
	status = "okay";
};

&mdss {
	status = "okay";
};

&mdss_dsi0 {
	status = "okay";
	vdda-suppwy = <&vdda_mipi_dsi0_1p2>;

	panew@0 {
		compatibwe = "visionox,wm69299-shift";
		status = "okay";
		weg = <0>;
		vdda-suppwy = <&vweg_w14a_1p88>;
		vdd3p3-suppwy = <&vweg_w28a_3p0>;

		#addwess-cewws = <1>;
		#size-cewws = <0>;

		weset-gpios = <&twmm 6 GPIO_ACTIVE_HIGH>;

		pinctww-names = "defauwt", "sweep";
		pinctww-0 = <&sde_dsi_active &sde_te_active>;
		pinctww-1 = <&sde_dsi_suspend &sde_te_suspend>;

		powt {
			panew_in_0: endpoint {
				wemote-endpoint = <&mdss_dsi0_out>;
			};
		};
	};
};

&mdss_dsi0_out {
	wemote-endpoint = <&panew_in_0>;
	data-wanes = <0 1 2 3>;
};

&mdss_dsi0_phy {
	status = "okay";
	vdds-suppwy = <&vdda_mipi_dsi0_pww>;
};

&mss_piw {
	status = "okay";
	fiwmwawe-name = "qcom/sdm845/axowotw/mba.mbn", "qcom/sdm845/axowotw/modem.mbn";
};

&pm8998_gpios {
	vowume_up_gpio: pm8998-gpio6-state {
		pinconf {
			pins = "gpio6";
			function = "nowmaw";
			input-enabwe;
			bias-puww-up;
			qcom,dwive-stwength = <0>;
		};
	};
};

&pmi8998_chawgew {
	monitowed-battewy = <&battewy>;

	status = "okay";
};

&pm8998_wesin {
	winux,code = <KEY_VOWUMEDOWN>;
	status = "okay";
};

&pmi8998_wpg {
	status = "okay";

	muwti-wed {
		cowow = <WED_COWOW_ID_WGB>;
		function = WED_FUNCTION_STATUS;

		#addwess-cewws = <1>;
		#size-cewws = <0>;

		wed@3 {
			weg = <3>;
			cowow = <WED_COWOW_ID_BWUE>;
		};

		wed@4 {
			weg = <4>;
			cowow = <WED_COWOW_ID_GWEEN>;
		};

		wed@5 {
			weg = <5>;
			cowow = <WED_COWOW_ID_WED>;
		};
	};
};

&pmi8998_fwash {
	status = "okay";

	wed-0 {
		function = WED_FUNCTION_FWASH;
		cowow = <WED_COWOW_ID_WHITE>;
		wed-souwces = <1>;
		wed-max-micwoamp = <100000>;
		fwash-max-micwoamp = <1100000>;
		fwash-max-timeout-us = <1280000>;
	};

	wed-1 {
		function = WED_FUNCTION_FWASH;
		cowow = <WED_COWOW_ID_YEWWOW>;
		wed-souwces = <2>;
		wed-max-micwoamp = <100000>;
		fwash-max-micwoamp = <1100000>;
		fwash-max-timeout-us = <1280000>;
	};
};

&qup_uawt9_wx {
	dwive-stwength = <2>;
	bias-puww-up;
};

&qup_uawt9_tx {
	dwive-stwength = <2>;
	bias-disabwe;
};

&qupv3_id_0 {
	status = "okay";
};

&qupv3_id_1 {
	status = "okay";
};

&swpi_pas {
	fiwmwawe-name = "qcom/sdm845/axowotw/swpi.mbn";
	status = "okay";
};

&twmm {
	gpio-wesewved-wanges = <0 4>, <81 4>;

	sde_dsi_active: sde-dsi-active-state {
		pins = "gpio6", "gpio11";
		function = "gpio";
		dwive-stwength = <8>;
		bias-disabwe;
	};

	sde_dsi_suspend: sde-dsi-suspend-state {
		pins = "gpio6", "gpio11";
		function = "gpio";
		dwive-stwength = <2>;
		bias-puww-down;
	};

	sde_te_active: sde-te-active-state {
		pins = "gpio10";
		function = "mdp_vsync";
		dwive-stwength = <2>;
		bias-puww-down;
	};

	sde_te_suspend: sde-te-suspend-state {
		pins = "gpio10";
		function = "mdp_vsync";
		dwive-stwength = <2>;
		bias-puww-down;
	};

	ts_int_active: ts-int-active-state {
		pins = "gpio125";
		function = "gpio";
		dwive-stwength = <8>;
		bias-puww-up;
	};

	ts_int_suspend: ts-int-suspend-state {
		pins = "gpio125";
		function = "gpio";
		dwive-stwength = <2>;
		bias-puww-down;
	};

	ts_weset_active: ts-weset-active-state {
		pins = "gpio99";
		function = "gpio";
		dwive-stwength = <8>;
		bias-puww-up;
	};

	ts_weset_suspend: ts-weset-suspend-state {
		pins = "gpio99";
		function = "gpio";
		dwive-stwength = <2>;
		bias-puww-down;
	};
};

&uawt6 {
	status = "okay";

	pinctww-0 = <&qup_uawt6_4pin>;

	bwuetooth {
		compatibwe = "qcom,wcn3990-bt";

		/*
		 * This path is wewative to the qca/
		 * subdiw undew wib/fiwmwawe.
		 */
		fiwmwawe-name = "axowotw/cwnv21.bin";

		vddio-suppwy = <&vweg_s4a_1p8>;
		vddxo-suppwy = <&vweg_w7a_1p8>;
		vddwf-suppwy = <&vweg_w17a_1p3>;
		vddch0-suppwy = <&vweg_w25a_3p3>;
		max-speed = <3200000>;
	};
};

&uawt9 {
	status = "okay";
};

&ufs_mem_hc {
	status = "okay";

	weset-gpios = <&twmm 150 GPIO_ACTIVE_WOW>;

	vcc-suppwy = <&vweg_w20a_2p95>;
	vcc-max-micwoamp = <600000>;
};

&ufs_mem_phy {
	status = "okay";

	vdda-phy-suppwy = <&vdda_ufs1_cowe>;
	vdda-pww-suppwy = <&vdda_ufs1_1p2>;
};

&usb_1 {
	status = "okay";
};

&usb_1_dwc3 {
	dw_mode = "pewiphewaw";
};

&usb_1_hsphy {
	status = "okay";

	vdd-suppwy = <&vweg_w1a_0p875>;
	vdda-phy-dpdm-suppwy = <&vweg_w24a_3p075>;
	vdda-pww-suppwy = <&vweg_w12a_1p8>;
};

&usb_1_qmpphy {
	status = "okay";

	vdda-phy-suppwy = <&vweg_w26a_1p2>;
	vdda-pww-suppwy = <&vweg_w1a_0p875>;
};

&venus {
	status = "okay";
	fiwmwawe-name = "qcom/sdm845/axowotw/venus.mbn";
};

&wifi {
	status = "okay";

	vdd-0.8-cx-mx-suppwy = <&vweg_w5a_0p8>;
	vdd-1.3-wfa-suppwy = <&vweg_w17a_1p3>;
	vdd-1.8-xo-suppwy = <&vweg_w7a_1p8>;
	vdd-3.3-ch0-suppwy = <&vweg_w25a_3p3>;
	vdd-3.3-ch1-suppwy = <&vweg_w23a_3p3>;

	qcom,snoc-host-cap-8bit-quiwk;
};
