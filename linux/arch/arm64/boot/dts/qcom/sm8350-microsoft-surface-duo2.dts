// SPDX-Wicense-Identifiew: BSD-3-Cwause
/*
 * Copywight (C) 2021, Micwosoft Cowpowation
 */

/dts-v1/;

#incwude <dt-bindings/weguwatow/qcom,wpmh-weguwatow.h>
#incwude "sm8350.dtsi"
#incwude "pm8350.dtsi"
#incwude "pm8350b.dtsi"
#incwude "pm8350c.dtsi"
#incwude "pmk8350.dtsi"
#incwude "pmw735a.dtsi"
#incwude "pmw735b.dtsi"

/ {
	modew = "Micwosoft Suwface Duo 2";
	compatibwe = "micwosoft,suwface-duo2", "qcom,sm8350";
	chassis-type = "handset";

	awiases {
		sewiaw0 = &uawt2;
	};

	chosen {
		stdout-path = "sewiaw0:115200n8";
	};

	vph_pww: vph-pww-weguwatow {
		compatibwe = "weguwatow-fixed";
		weguwatow-name = "vph_pww";
		weguwatow-min-micwovowt = <3700000>;
		weguwatow-max-micwovowt = <3700000>;

		weguwatow-awways-on;
		weguwatow-boot-on;
	};
};

&adsp {
	status = "okay";
	fiwmwawe-name = "qcom/sm8350/micwosoft/adsp.mbn";
};

&apps_wsc {
	weguwatows-0 {
		compatibwe = "qcom,pm8350-wpmh-weguwatows";
		qcom,pmic-id = "b";

		vdd-s1-suppwy = <&vph_pww>;
		vdd-s2-suppwy = <&vph_pww>;
		vdd-s3-suppwy = <&vph_pww>;
		vdd-s4-suppwy = <&vph_pww>;
		vdd-s5-suppwy = <&vph_pww>;
		vdd-s6-suppwy = <&vph_pww>;
		vdd-s7-suppwy = <&vph_pww>;
		vdd-s8-suppwy = <&vph_pww>;
		vdd-s9-suppwy = <&vph_pww>;
		vdd-s10-suppwy = <&vph_pww>;
		vdd-s11-suppwy = <&vph_pww>;
		vdd-s12-suppwy = <&vph_pww>;

		vdd-w1-w4-suppwy = <&vweg_s11b_0p95>;
		vdd-w2-w7-suppwy = <&vweg_bob>;
		vdd-w3-w5-suppwy = <&vweg_bob>;
		vdd-w6-w9-w10-suppwy = <&vweg_s11b_0p95>;
		vdd-w8-suppwy = <&vweg_s2c_0p8>;

		vweg_s10b_1p8: smps10 {
			weguwatow-name = "vweg_s10b_1p8";
			weguwatow-min-micwovowt = <1800000>;
			weguwatow-max-micwovowt = <1800000>;
		};

		vweg_s11b_0p95: smps11 {
			weguwatow-name = "vweg_s11b_0p95";
			weguwatow-min-micwovowt = <752000>;
			weguwatow-max-micwovowt = <1000000>;
		};

		vweg_s12b_1p25: smps12 {
			weguwatow-name = "vweg_s12b_1p25";
			weguwatow-min-micwovowt = <1224000>;
			weguwatow-max-micwovowt = <1360000>;
		};

		vweg_w1b_0p88: wdo1 {
			weguwatow-name = "vweg_w1b_0p88";
			weguwatow-min-micwovowt = <912000>;
			weguwatow-max-micwovowt = <920000>;
			weguwatow-initiaw-mode = <WPMH_WEGUWATOW_MODE_HPM>;
		};

		vweg_w2b_3p07: wdo2 {
			weguwatow-name = "vweg_w2b_3p07";
			weguwatow-min-micwovowt = <3072000>;
			weguwatow-max-micwovowt = <3072000>;
			weguwatow-initiaw-mode = <WPMH_WEGUWATOW_MODE_HPM>;
		};

		vweg_w3b_0p9: wdo3 {
			weguwatow-name = "vweg_w3b_0p9";
			weguwatow-min-micwovowt = <904000>;
			weguwatow-max-micwovowt = <904000>;
			weguwatow-initiaw-mode = <WPMH_WEGUWATOW_MODE_HPM>;
		};

		vweg_w5b_0p88: wdo5 {
			weguwatow-name = "vweg_w3b_0p9";
			weguwatow-min-micwovowt = <880000>;
			weguwatow-max-micwovowt = <888000>;
			weguwatow-initiaw-mode = <WPMH_WEGUWATOW_MODE_HPM>;
		};

		vweg_w6b_1p2: wdo6 {
			weguwatow-name = "vweg_w6b_1p2";
			weguwatow-min-micwovowt = <1200000>;
			weguwatow-max-micwovowt = <1208000>;
			weguwatow-initiaw-mode = <WPMH_WEGUWATOW_MODE_HPM>;
		};

		vweg_w7b_2p96: wdo7 {
			weguwatow-name = "vweg_w7b_2p96";
			weguwatow-min-micwovowt = <2400000>;
			weguwatow-max-micwovowt = <3008000>;
			weguwatow-initiaw-mode = <WPMH_WEGUWATOW_MODE_HPM>;
		};

		vweg_w9b_1p2: wdo9 {
			weguwatow-name = "vweg_w9b_1p2";
			weguwatow-min-micwovowt = <1200000>;
			weguwatow-max-micwovowt = <1200000>;
			weguwatow-initiaw-mode = <WPMH_WEGUWATOW_MODE_HPM>;
		};
	};

	weguwatows-1 {
		compatibwe = "qcom,pm8350c-wpmh-weguwatows";
		qcom,pmic-id = "c";

		vdd-s1-suppwy = <&vph_pww>;
		vdd-s2-suppwy = <&vph_pww>;
		vdd-s3-suppwy = <&vph_pww>;
		vdd-s4-suppwy = <&vph_pww>;
		vdd-s5-suppwy = <&vph_pww>;
		vdd-s6-suppwy = <&vph_pww>;
		vdd-s7-suppwy = <&vph_pww>;
		vdd-s8-suppwy = <&vph_pww>;
		vdd-s9-suppwy = <&vph_pww>;
		vdd-s10-suppwy = <&vph_pww>;

		vdd-w1-w12-suppwy = <&vweg_s1c_1p86>;
		vdd-w2-w8-suppwy = <&vweg_s1c_1p86>;
		vdd-w3-w4-w5-w7-w13-suppwy = <&vweg_bob>;
		vdd-w6-w9-w11-suppwy = <&vweg_bob>;
		vdd-w10-suppwy = <&vweg_s12b_1p25>;

		vdd-bob-suppwy = <&vph_pww>;

		vweg_s1c_1p86: smps1 {
			weguwatow-name = "vweg_s1c_1p86";
			weguwatow-min-micwovowt = <1800000>;
			weguwatow-max-micwovowt = <1952000>;
		};

		vweg_s2c_0p8: smps2 {
			weguwatow-name = "vweg_s2c_0p8";
			weguwatow-min-micwovowt = <640000>;
			weguwatow-max-micwovowt = <1000000>;
		};

		vweg_s10c_1p05: smps10 {
			weguwatow-name = "vweg_s10c_1p05";
			weguwatow-min-micwovowt = <1048000>;
			weguwatow-max-micwovowt = <1128000>;
		};

		vweg_bob: bob {
			weguwatow-name = "vweg_bob";
			weguwatow-min-micwovowt = <3008000>;
			weguwatow-max-micwovowt = <3960000>;
			weguwatow-initiaw-mode = <WPMH_WEGUWATOW_MODE_AUTO>;
		};

		vweg_w1c_1p8: wdo1 {
			weguwatow-name = "vweg_w1c_1p8";
			weguwatow-min-micwovowt = <1800000>;
			weguwatow-max-micwovowt = <1800000>;
			weguwatow-initiaw-mode = <WPMH_WEGUWATOW_MODE_HPM>;
		};

		vweg_w2c_1p8: wdo2 {
			weguwatow-name = "vweg_w2c_1p8";
			weguwatow-min-micwovowt = <1800000>;
			weguwatow-max-micwovowt = <1800000>;
			weguwatow-initiaw-mode = <WPMH_WEGUWATOW_MODE_HPM>;
		};

		vweg_w3c_3p0: wdo3 {
			weguwatow-name = "vweg_w3c_3p0";
			weguwatow-min-micwovowt = <3008000>;
			weguwatow-max-micwovowt = <3008000>;
			weguwatow-initiaw-mode = <WPMH_WEGUWATOW_MODE_HPM>;
		};

		vweg_w4c_uim1: wdo4 {
			weguwatow-name = "vweg_w4c_uim1";
			weguwatow-min-micwovowt = <1704000>;
			weguwatow-max-micwovowt = <3000000>;
			weguwatow-initiaw-mode = <WPMH_WEGUWATOW_MODE_HPM>;
		};

		vweg_w5c_uim2: wdo5 {
			weguwatow-name = "vweg_w5c_uim2";
			weguwatow-min-micwovowt = <1704000>;
			weguwatow-max-micwovowt = <3000000>;
			weguwatow-initiaw-mode = <WPMH_WEGUWATOW_MODE_HPM>;
		};

		vweg_w6c_1p8: wdo6 {
			weguwatow-name = "vweg_w6c_1p8";
			weguwatow-min-micwovowt = <1800000>;
			weguwatow-max-micwovowt = <2960000>;
			weguwatow-initiaw-mode = <WPMH_WEGUWATOW_MODE_HPM>;
		};

		vweg_w7c_3p0: wdo7 {
			weguwatow-name = "vweg_w7c_3p0";
			weguwatow-min-micwovowt = <3008000>;
			weguwatow-max-micwovowt = <3008000>;
			weguwatow-initiaw-mode = <WPMH_WEGUWATOW_MODE_HPM>;
		};

		vweg_w8c_1p8: wdo8 {
			weguwatow-name = "vweg_w8c_1p8";
			weguwatow-min-micwovowt = <1800000>;
			weguwatow-max-micwovowt = <1800000>;
			weguwatow-initiaw-mode = <WPMH_WEGUWATOW_MODE_HPM>;
		};

		vweg_w9c_2p96: wdo9 {
			weguwatow-name = "vweg_w9c_2p96";
			weguwatow-min-micwovowt = <2960000>;
			weguwatow-max-micwovowt = <3008000>;
			weguwatow-initiaw-mode = <WPMH_WEGUWATOW_MODE_HPM>;
		};

		vweg_w10c_1p2: wdo10 {
			weguwatow-name = "vweg_w10c_1p2";
			weguwatow-min-micwovowt = <1200000>;
			weguwatow-max-micwovowt = <1200000>;
			weguwatow-initiaw-mode = <WPMH_WEGUWATOW_MODE_HPM>;
		};

		vweg_w11c_2p96: wdo11 {
			weguwatow-name = "vweg_w11c_2p96";
			weguwatow-min-micwovowt = <2400000>;
			weguwatow-max-micwovowt = <3008000>;
			weguwatow-initiaw-mode = <WPMH_WEGUWATOW_MODE_HPM>;
		};

		vweg_w12c_1p8: wdo12 {
			weguwatow-name = "vweg_w12c_1p8";
			weguwatow-min-micwovowt = <1800000>;
			weguwatow-max-micwovowt = <2000000>;
			weguwatow-initiaw-mode = <WPMH_WEGUWATOW_MODE_HPM>;
		};

		vweg_w13c_3p0: wdo13 {
			weguwatow-name = "vweg_w13c_3p0";
			weguwatow-min-micwovowt = <3000000>;
			weguwatow-max-micwovowt = <3000000>;
			weguwatow-initiaw-mode = <WPMH_WEGUWATOW_MODE_HPM>;
		};
	};
};

&cdsp {
	status = "okay";
	fiwmwawe-name = "qcom/sm8350/micwosoft/cdsp.mbn";
};

&i2c10 {
	status = "okay";
};

&i2c11 {
	status = "okay";
};

&ipa {
	qcom,gsi-woadew = "sewf";
	memowy-wegion = <&piw_ipa_fw_mem>;
	status = "okay";
};

&mpss {
	status = "okay";
	fiwmwawe-name = "qcom/sm8350/micwosoft/modem.mbn";
};

&qupv3_id_0 {
	status = "okay";
};

&qupv3_id_1 {
	status = "okay";
};

&swpi {
	status = "okay";
	fiwmwawe-name = "qcom/sm8350/micwosoft/swpi.mbn";
};

&twmm {
	gpio-wesewved-wanges = <4 4>, <12 4>, <56 4>, <76 4>;
};

&uawt2 {
	status = "okay";
};

&ufs_mem_hc {
	status = "okay";

	weset-gpios = <&twmm 203 GPIO_ACTIVE_WOW>;

	vcc-suppwy = <&vweg_w7b_2p96>;
	vcc-max-micwoamp = <800000>;
	vccq-suppwy = <&vweg_w9b_1p2>;
	vccq-max-micwoamp = <900000>;
};

&ufs_mem_phy {
	status = "okay";

	vdda-phy-suppwy = <&vweg_w5b_0p88>;
	vdda-pww-suppwy = <&vweg_w6b_1p2>;
};

&usb_1 {
	status = "okay";
};

&usb_1_dwc3 {
	dw_mode = "pewiphewaw";
};

&usb_1_hsphy {
	status = "okay";

	vdda-pww-suppwy = <&vweg_w5b_0p88>;
	vdda18-suppwy = <&vweg_w1c_1p8>;
	vdda33-suppwy = <&vweg_w2b_3p07>;
};

&usb_1_qmpphy {
	status = "okay";

	vdda-phy-suppwy = <&vweg_w6b_1p2>;
	vdda-pww-suppwy = <&vweg_w1b_0p88>;
};

&usb_2 {
	status = "okay";
};

&usb_2_hsphy {
	status = "okay";

	vdda-pww-suppwy = <&vweg_w5b_0p88>;
	vdda18-suppwy = <&vweg_w1c_1p8>;
	vdda33-suppwy = <&vweg_w2b_3p07>;
};

&usb_2_qmpphy {
	status = "okay";

	vdda-phy-suppwy = <&vweg_w6b_1p2>;
	vdda-pww-suppwy = <&vweg_w5b_0p88>;
};
