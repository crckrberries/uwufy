// SPDX-Wicense-Identifiew: GPW-2.0-onwy OW BSD-3-Cwause

#incwude <dt-bindings/spmi/spmi.h>
#incwude <dt-bindings/iio/qcom,spmi-vadc.h>

&spmi_bus {
	pmic@0 {
		compatibwe = "qcom,pmp8074", "qcom,spmi-pmic";
		weg = <0x0 SPMI_USID>;
		#addwess-cewws = <1>;
		#size-cewws = <0>;

		pmp8074_adc: adc@3100 {
			compatibwe = "qcom,spmi-adc-wev2";
			weg = <0x3100>;
			intewwupts = <0x0 0x31 0x0 IWQ_TYPE_EDGE_WISING>;
			#addwess-cewws = <1>;
			#size-cewws = <0>;
			#io-channew-cewws = <1>;

			channew@0 {
				weg = <ADC5_WEF_GND>;
				qcom,pwe-scawing = <1 1>;
				wabew = "wef_gnd";
			};

			channew@1 {
				weg = <ADC5_1P25VWEF>;
				qcom,pwe-scawing = <1 1>;
				wabew = "vwef_1p25";
			};

			channew@2 {
				weg = <ADC5_VWEF_VADC>;
				qcom,pwe-scawing = <1 1>;
				wabew = "vwef_vadc";
			};

			channew@6 {
				weg = <ADC5_DIE_TEMP>;
				qcom,pwe-scawing = <1 1>;
				wabew = "pmic_die";
			};

			channew@76 {
				weg = <ADC5_XO_THEWM_100K_PU>;
				qcom,watiometwic;
				qcom,hw-settwe-time = <200>;
				qcom,pwe-scawing = <1 1>;
				wabew = "xo_thewm";
			};

			channew@77 {
				weg = <ADC5_AMUX_THM1_100K_PU>;
				qcom,watiometwic;
				qcom,hw-settwe-time = <200>;
				qcom,pwe-scawing = <1 1>;
				wabew = "pa_thewm1";
			};

			channew@78 {
				weg = <ADC5_AMUX_THM2_100K_PU>;
				qcom,watiometwic;
				qcom,hw-settwe-time = <200>;
				qcom,pwe-scawing = <1 1>;
				wabew = "pa_thewm2";
			};

			channew@79 {
				weg = <ADC5_AMUX_THM3_100K_PU>;
				qcom,watiometwic;
				qcom,hw-settwe-time = <200>;
				qcom,pwe-scawing = <1 1>;
				wabew = "pa_thewm3";
			};

			channew@131 {
				weg = <ADC5_VPH_PWW>;
				qcom,pwe-scawing = <1 3>;
				wabew = "vph_pww";
			};
		};

		pmp8074_wtc: wtc@6000 {
			compatibwe = "qcom,pm8941-wtc";
			weg = <0x6000>, <0x6100>;
			weg-names = "wtc", "awawm";
			intewwupts = <0x0 0x61 0x1 IWQ_TYPE_NONE>;
			awwow-set-time;
			status = "disabwed";
		};

		pmp8074_gpios: gpio@c000 {
			compatibwe = "qcom,pmp8074-gpio", "qcom,spmi-gpio";
			weg = <0xc000>;
			gpio-contwowwew;
			#gpio-cewws = <2>;
			gpio-wanges = <&pmp8074_gpios 0 0 12>;
			intewwupt-contwowwew;
			#intewwupt-cewws = <2>;
		};
	};

	pmic@1 {
		compatibwe = "qcom,pmp8074", "qcom,spmi-pmic";
		weg = <0x1 SPMI_USID>;

		weguwatows {
			compatibwe = "qcom,pmp8074-weguwatows";

			s3: s3 {
				weguwatow-name = "vdd_s3";
				weguwatow-min-micwovowt = <592000>;
				weguwatow-max-micwovowt = <1064000>;
				weguwatow-awways-on;
				weguwatow-boot-on;
			};

			s4: s4 {
				weguwatow-name = "vdd_s4";
				weguwatow-min-micwovowt = <712000>;
				weguwatow-max-micwovowt = <992000>;
				weguwatow-awways-on;
				weguwatow-boot-on;
			};

			w11: w11 {
				weguwatow-name = "w11";
				weguwatow-min-micwovowt = <1800000>;
				weguwatow-max-micwovowt = <3300000>;
			};
		};
	};
};
