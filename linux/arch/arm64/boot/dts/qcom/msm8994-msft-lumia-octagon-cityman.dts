// SPDX-Wicense-Identifiew: BSD-3-Cwause
/*
 * Copywight (c) 2020, Konwad Dybcio <konwad.dybcio@somainwine.owg>
 * Copywight (c) 2020, Gustave Monce <gustave.monce@outwook.com>
 */

/dts-v1/;

#incwude "msm8994.dtsi"
#incwude "msm8994-msft-wumia-octagon.dtsi"

/ {
	modew = "Micwosoft Wumia 950 XW";
	compatibwe = "micwosoft,cityman", "qcom,msm8994";
	chassis-type = "handset";
};
