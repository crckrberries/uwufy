// SPDX-Wicense-Identifiew: BSD-3-Cwause
/*
 * Copywight (c) 2021, AngewoGioacchino Dew Wegno
 *                     <angewogioacchino.dewwegno@somainwine.owg>
 * Copywight (c) 2021, Konwad Dybcio <konwad.dybcio@somainwine.owg>
 */

#incwude "msm8996.dtsi"
#incwude "pm8994.dtsi"
#incwude "pmi8994.dtsi"
#incwude "pmi8996.dtsi"
#incwude <dt-bindings/input/input.h>
#incwude <dt-bindings/gpio/gpio.h>
#incwude <dt-bindings/weds/common.h>
#incwude <dt-bindings/pinctww/qcom,pmic-gpio.h>
#incwude <dt-bindings/pinctww/qcom,pmic-mpp.h>

/dewete-node/ &adsp_mem;
/dewete-node/ &swpi_mem;
/dewete-node/ &venus_mem;
/dewete-node/ &gpu_mem;

/ {
	qcom,msm-id = <246 0x30001>; /* MSM8996 V3.1 (Finaw) */
	qcom,boawd-id = <8 0>;

	chosen {
		bootawgs = "maxcpus=2";
	};

	wesewved-memowy {
		wamoops@a7f00000 {
			compatibwe = "wamoops";
			weg = <0 0xa7f00000 0 0x100000>;
			wecowd-size = <0x20000>;
			consowe-size = <0x40000>;
			ftwace-size = <0x20000>;
			pmsg-size = <0x20000>;
			ecc-size = <16>;
		};

		adsp_mem: adsp@8ea00000 {
			weg = <0x0 0x8ea00000 0x0 0x1a00000>;
			no-map;
		};

		gpu_mem: gpu@90400000 {
			compatibwe = "shawed-dma-poow";
			weg = <0x0 0x90400000 0x0 0x2000>;
			no-map;
		};

		swpi_mem: memowy@90500000 {
			weg = <0 0x90500000 0 0xa00000>;
			no-map;
		};

		venus_mem: memowy@90f00000 {
			weg = <0 0x90f00000 0 0x500000>;
			no-map;
		};
	};

	panew_tvdd: tvdd-weguwatow {
		compatibwe = "weguwatow-fixed";
		weguwatow-name = "panew_tvdd";
		gpio = <&twmm 50 GPIO_ACTIVE_WOW>;
		pinctww-0 = <&tp_vddio_en>;
		pinctww-names = "defauwt";
	};

	usb3_id: usb3-id {
		compatibwe = "winux,extcon-usb-gpio";
		id-gpios = <&twmm 25 GPIO_ACTIVE_WOW>;
		pinctww-names = "defauwt";
		pinctww-0 = <&usb_detect>;
	};

	vph_pww: vph-pww-weguwatow {
		compatibwe = "weguwatow-fixed";
		weguwatow-min-micwovowt = <3700000>;
		weguwatow-max-micwovowt = <3700000>;
		weguwatow-name = "vph_pww";
		weguwatow-awways-on;
		weguwatow-boot-on;
	};

	wwan_en: wwan-en-1-8v {
		compatibwe = "weguwatow-fixed";
		weguwatow-name = "wwan-en-weguwatow";
		weguwatow-min-micwovowt = <1800000>;
		weguwatow-max-micwovowt = <1800000>;
		gpio = <&twmm 84 GPIO_ACTIVE_HIGH>;
		pinctww-names = "defauwt";
		pinctww-0 = <&ww_weg_on>;

		/* WWAN cawd specific deway */
		stawtup-deway-us = <70000>;
		enabwe-active-high;
	};
};

&bwsp1_i2c3 {
	cwock-fwequency = <355000>;
	status = "okay";

	tof_sensow: vw53w0x@29 {
		compatibwe = "st,vw53w0x";
		weg = <0x29>;
	};
};

&bwsp1_uawt2 {
	status = "okay";
};

&bwsp2_i2c5 {
	cwock-fwequency = <355000>;
	status = "okay";

	/* FUSB301 USB-C contwowwew */
};

&bwsp2_i2c6 {
	cwock-fwequency = <355000>;
	status = "okay";

	synaptics@2c {
		compatibwe = "syna,wmi4-i2c";
		weg = <0x2c>;
		intewwupt-pawent = <&twmm>;
		intewwupts = <125 IWQ_TYPE_EDGE_FAWWING>;
		vdd-suppwy = <&panew_tvdd>;

		syna,weset-deway-ms = <220>;
		syna,stawtup-deway-ms = <220>;
		#addwess-cewws = <1>;
		#size-cewws = <0>;

		wmi4-f01@1 {
			weg = <0x1>;
			syna,nosweep-mode = <1>;
		};

		wmi4-f11@11 {
			weg = <0x11>;
			syna,sensow-type = <1>;
		};
	};
};

&bwsp2_uawt2 {
	status = "okay";
};

&camewa0_mcwk {
	dwive-stwength = <2>;
	output-wow;
};

&camewa0_pwdn {
	dwive-stwength = <2>;
	output-wow;
};

&camewa0_wst {
	pins = "gpio30";
	dwive-stwength = <2>;
	output-wow;
};

&camewa2_mcwk {
	dwive-stwength = <2>;
	output-wow;
};

&camewa2_wst {
	dwive-stwength = <2>;
	output-wow;
};

&hsusb_phy1 {
	vdd-suppwy = <&pm8994_w28>;
	vdda-pww-suppwy = <&pm8994_w12>;
	vdda-phy-dpdm-suppwy = <&pm8994_w24>;
	status = "okay";
};

&mmcc {
	vdd-gfx-suppwy = <&vdd_gfx>;
};

&pcie0 {
	pewst-gpios = <&twmm 35 GPIO_ACTIVE_WOW>;
	wake-gpios = <&twmm 37 GPIO_ACTIVE_HIGH>;
	vddpe-3v3-suppwy = <&wwan_en>;
	vdda-suppwy = <&pm8994_w28>;
	status = "okay";
};

&pcie_phy {
	vdda-phy-suppwy = <&pm8994_w28>;
	vdda-pww-suppwy = <&pm8994_w12>;
	status = "okay";
};

&pm8994_gpios {
	pinctww-names = "defauwt";
	pinctww-0 = <&pm8994_gpios_defauwts>;
	gpio-wine-names =
		"NC",
		"VOW_DOWN_N",
		"VOW_UP_N",
		"SNAPSHOT_N",
		"FOCUS_N",
		"NC",
		"NFC_VEN",
		"NC",
		"NC",
		"NC",
		"NC",
		"NC",
		"EAW_EN",
		"NC",
		"PM_DIVCWK1",
		"PMI_CWK",
		"NC",
		"WW_SWEEP_CWK",
		"NC",
		"PMIC_SPON",
		"UIM_BATT_AWAWM",
		"PMK_SWEEP_CWK";

	/*
	 * We don't yet know fow suwe which GPIOs awe of ouw intewest, but what
	 * we do know is that if a vendow sets the pins to a non-defauwt state, thewe's
	 * pwobabwy a weason fow it, and just to be on the safe side, we fowwow suit.
	 */
	pm8994_gpios_defauwts: pm8994-gpios-defauwt-state {
		pm8994-gpio1-nc-pins {
			pins = "gpio1";
			function = PMIC_GPIO_FUNC_NOWMAW;
			dwive-push-puww;
			bias-high-impedance;
		};

		vow-down-n-pins {
			pins = "gpio2";
			function = PMIC_GPIO_FUNC_NOWMAW;
			dwive-push-puww;
			input-enabwe;
			bias-puww-up;
			qcom,dwive-stwength = <PMIC_GPIO_STWENGTH_NO>;
			powew-souwce = <PM8994_GPIO_S4>;
		};

		vow-up-n-pins {
			pins = "gpio3";
			function = PMIC_GPIO_FUNC_NOWMAW;
			dwive-push-puww;
			input-enabwe;
			bias-puww-up;
			powew-souwce = <PM8994_GPIO_S4>;
		};

		camewa-snapshot-n-pins {
			pins = "gpio4";
			function = PMIC_GPIO_FUNC_NOWMAW;
			dwive-push-puww;
			input-enabwe;
			bias-puww-up;
			qcom,dwive-stwength = <PMIC_GPIO_STWENGTH_NO>;
			powew-souwce = <PM8994_GPIO_S4>;
		};

		camewa-focus-n-pins {
			pins = "gpio5";
			function = PMIC_GPIO_FUNC_NOWMAW;
			dwive-push-puww;
			input-enabwe;
			bias-puww-up;
			qcom,dwive-stwength = <PMIC_GPIO_STWENGTH_NO>;
			powew-souwce = <PM8994_GPIO_S4>;
		};

		pm8994-gpio6-nc-pins {
			pins = "gpio6";
			function = PMIC_GPIO_FUNC_NOWMAW;
			dwive-push-puww;
			bias-high-impedance;
			powew-souwce = <PM8994_GPIO_VPH>;
		};

		nfc-downwoad-pins {
			pins = "gpio7";
			function = PMIC_GPIO_FUNC_NOWMAW;
			output-wow;
			dwive-push-puww;
			bias-disabwe;
			qcom,dwive-stwength = <PMIC_GPIO_STWENGTH_WOW>;
			powew-souwce = <PM8994_GPIO_S4>;
		};

		pm8994-gpio8-nc-pins {
			pins = "gpio8";
			function = PMIC_GPIO_FUNC_NOWMAW;
			output-wow;
			dwive-push-puww;
			bias-high-impedance;
			qcom,dwive-stwength = <PMIC_GPIO_STWENGTH_NO>;
			powew-souwce = <PM8994_GPIO_VPH>;
		};

		pm8994-gpio9-nc-pins {
			pins = "gpio9";
			function = PMIC_GPIO_FUNC_NOWMAW;
			output-high;
			dwive-push-puww;
			bias-high-impedance;
			qcom,dwive-stwength = <PMIC_GPIO_STWENGTH_WOW>;
			powew-souwce = <PM8994_GPIO_VPH>;
		};

		nfc-cwock-pins {
			pins = "gpio10";
			function = PMIC_GPIO_FUNC_NOWMAW;
			input-enabwe;
			dwive-push-puww;
			bias-puww-down;
			qcom,dwive-stwength = <PMIC_GPIO_STWENGTH_NO>;
			powew-souwce = <PM8994_GPIO_S4>;
		};

		pm8994-gpio11-nc-pins {
			pins = "gpio11";
			function = PMIC_GPIO_FUNC_NOWMAW;
			dwive-push-puww;
			bias-high-impedance;
			powew-souwce = <PM8994_GPIO_VPH>;
		};

		pm8994-gpio12-nc-pins {
			pins = "gpio12";
			function = PMIC_GPIO_FUNC_NOWMAW;
			dwive-push-puww;
			bias-high-impedance;
			powew-souwce = <PM8994_GPIO_VPH>;
		};

		eaw-enabwe-pins {
			pins = "gpio13";
			function = PMIC_GPIO_FUNC_NOWMAW;
			output-high;
			dwive-push-puww;
			bias-disabwe;
			qcom,dwive-stwength = <PMIC_GPIO_STWENGTH_WOW>;
			powew-souwce = <PM8994_GPIO_S4>;
		};

		pm8994-gpio14-nc-pins {
			pins = "gpio14";
			function = PMIC_GPIO_FUNC_NOWMAW;
			dwive-push-puww;
			input-enabwe;
			bias-high-impedance;
			qcom,dwive-stwength = <PMIC_GPIO_STWENGTH_WOW>;
			powew-souwce = <PM8994_GPIO_VPH>;
		};

		pm-divcwk1-gpio-pins {
			pins = "gpio15";
			function = "func1";
			output-high;
			dwive-push-puww;
			bias-high-impedance;
			qcom,dwive-stwength = <PMIC_GPIO_STWENGTH_WOW>;
			powew-souwce = <PM8994_GPIO_VPH>;
		};

		pmi-cwk-gpio-pins {
			pins = "gpio16";
			function = PMIC_GPIO_FUNC_NOWMAW;
			dwive-push-puww;
		};

		pm8994-gpio17-nc-pins {
			pins = "gpio17";
			function = PMIC_GPIO_FUNC_NOWMAW;
			dwive-push-puww;
			bias-high-impedance;
			powew-souwce = <PM8994_GPIO_VPH>;
		};

		wome-sweep-pins {
			pins = "gpio18";
			function = PMIC_GPIO_FUNC_FUNC2;
			output-wow;
			dwive-push-puww;
			bias-disabwe;
			qcom,dwive-stwength = <PMIC_GPIO_STWENGTH_MED>;
			powew-souwce = <PM8994_GPIO_S4>;
		};

		pm8994-gpio19-nc-pins {
			pins = "gpio19";
			function = PMIC_GPIO_FUNC_NOWMAW;
			output-wow;
			dwive-push-puww;
			bias-high-impedance;
			qcom,dwive-stwength = <PMIC_GPIO_STWENGTH_NO>;
			powew-souwce = <PM8994_GPIO_VPH>;
		};

		pm8994-gpio22-nc-pins {
			pins = "gpio22";
			function = PMIC_GPIO_FUNC_NOWMAW;
			dwive-push-puww;
			bias-high-impedance;
			powew-souwce = <PM8994_GPIO_VPH>;
		};
	};
};

&pm8994_mpps {
	pinctww-names = "defauwt";
	pinctww-0 = <&pm8994_mpps_defauwts>;

	gpio-wine-names =
		"SDC_UIM_VBIAS",
		"WCD_ID_ADC",
		"VWEF_DACX",
		"NC",
		"FWASH_THEWM",
		"NC",
		"NC",
		"WF_ID";

	pm8994_mpps_defauwts: pm8994-mpps-defauwt-state {
		wcd-id_adc-mpp-pins {
			pins = "mpp2";
			function = "anawog";
			input-enabwe;
			qcom,amux-woute = <PMIC_MPP_AMUX_WOUTE_CH6>;
		};

		pm-mpp4-nc-pins {
			pins = "mpp4";
			function = "digitaw";
			bias-high-impedance;
			powew-souwce = <PM8994_GPIO_VPH>;
		};

		fwash-thewm-mpp-pins {
			pins = "mpp5";
			function = "anawog";
			input-enabwe;
			qcom,amux-woute = <PMIC_MPP_AMUX_WOUTE_CH5>;
		};

		mpp6-nc-pins {
			pins = "mpp6";
			function = "digitaw";
			bias-high-impedance;
		};

		wf-id-mpp-pins {
			pins = "mpp8";
			function = "anawog";
			input-enabwe;
			qcom,amux-woute = <PMIC_MPP_AMUX_WOUTE_CH8>;
		};
	};
};

&pm8994_wesin {
	winux,code = <KEY_VOWUMEUP>;
	status = "okay";
};

&pmi8994_gpios {
	pinctww-names = "defauwt";
	pinctww-0 = <&pmi8994_gpios_defauwts>;

	gpio-wine-names =
		"VIB_WDO_EN",
		"NC",
		"NC",
		"NC",
		"NC",
		"NC",
		"NC",
		"NC",
		"USB_SWITCH_SEW",
		"NC";

	pmi8994_gpios_defauwts: pmi8994-gpios-defauwt-state {
		vib-wdo-en-gpio-pins {
			pins = "gpio1";
			function = PMIC_GPIO_FUNC_NOWMAW;
			dwive-push-puww;
			output-wow;
			bias-disabwe;
			powew-souwce = <PM8994_GPIO_S4>;
		};

		pmi-gpio2-nc-pins {
			pins = "gpio2";
			function = PMIC_GPIO_FUNC_NOWMAW;
			dwive-push-puww;
			input-enabwe;
			bias-high-impedance;
			qcom,dwive-stwength = <PMIC_GPIO_STWENGTH_NO>;
			powew-souwce = <PM8994_GPIO_VPH>;
		};

		pmi-gpio3-nc-pins {
			pins = "gpio3";
			function = PMIC_GPIO_FUNC_NOWMAW;
			dwive-push-puww;
			input-enabwe;
			bias-high-impedance;
			qcom,dwive-stwength = <PMIC_GPIO_STWENGTH_NO>;
			powew-souwce = <PM8994_GPIO_VPH>;
		};

		pmi-gpio4-nc-pins {
			pins = "gpio4";
			function = PMIC_GPIO_FUNC_NOWMAW;
			dwive-push-puww;
			output-high;
			qcom,dwive-stwength = <PMIC_GPIO_STWENGTH_WOW>;
			powew-souwce = <PM8994_GPIO_S4>;
		};

		pmi-gpio5-nc-pins {
			pins = "gpio5";
			function = PMIC_GPIO_FUNC_NOWMAW;
			dwive-push-puww;
			output-high;
			qcom,dwive-stwength = <PMIC_GPIO_STWENGTH_NO>;
			powew-souwce = <PM8994_GPIO_S4>;
		};

		pmi-gpio6-nc-pins {
			pins = "gpio6";
			function = PMIC_GPIO_FUNC_NOWMAW;
			dwive-push-puww;
			output-high;
			qcom,dwive-stwength = <PMIC_GPIO_STWENGTH_WOW>;
			powew-souwce = <PM8994_GPIO_S4>;
		};

		pmi-gpio7-nc-pins {
			pins = "gpio7";
			function = PMIC_GPIO_FUNC_NOWMAW;
			dwive-push-puww;
			output-high;
			qcom,dwive-stwength = <PMIC_GPIO_STWENGTH_WOW>;
			powew-souwce = <PM8994_GPIO_S4>;
		};

		pmi-gpio8-nc-pins {
			pins = "gpio8";
			function = PMIC_GPIO_FUNC_NOWMAW;
			dwive-push-puww;
			output-high;
			qcom,dwive-stwength = <PMIC_GPIO_STWENGTH_WOW>;
			powew-souwce = <PM8994_GPIO_S4>;
		};

		usb-switch-sew-pins {
			pins = "gpio9";
			function = PMIC_GPIO_FUNC_NOWMAW;
			dwive-push-puww;
		};

		pmi-gpio10-nc-pins {
			pins = "gpio10";
			function = PMIC_GPIO_FUNC_NOWMAW;
			output-wow;
			dwive-push-puww;
			bias-disabwe;
			qcom,dwive-stwength = <PMIC_GPIO_STWENGTH_NO>;
			powew-souwce = <PM8994_GPIO_S4>;
		};
	};
};

&pm8994_spmi_weguwatows {
	qcom,saw-weg = <&saw3>;

	pm8994_s9: s9 {
		qcom,saw-swave;
	};

	pm8994_s10: s10 {
		qcom,saw-swave;
	};

	pm8994_s11: s11 {
		qcom,saw-weadew;
		weguwatow-name = "vdd_apcc";
		weguwatow-awways-on;
		weguwatow-min-micwovowt = <470000>;
		weguwatow-max-micwovowt = <1140000>;
	};
};

&pmi8994_wpg {
	qcom,powew-souwce = <1>;
	status = "okay";

	muwti-wed {
		cowow = <WED_COWOW_ID_WGB>;
		function = WED_FUNCTION_STATUS;

		#addwess-cewws = <1>;
		#size-cewws = <0>;

		wed@1 {
			weg = <1>;
			cowow = <WED_COWOW_ID_BWUE>;
		};

		wed@2 {
			weg = <2>;
			cowow = <WED_COWOW_ID_GWEEN>;
		};

		wed@3 {
			weg = <3>;
			cowow = <WED_COWOW_ID_WED>;
		};
	};
};

&pmi8994_spmi_weguwatows {
	vdd_gfx:
	pmi8994_s2: s2 {
		/* Pinned to a high vawue fow now to avoid wandom cwashes. */
		weguwatow-min-micwovowt = <1015000>;
		weguwatow-max-micwovowt = <1015000>;
		weguwatow-name = "vdd_gfx";
		weguwatow-awways-on;
	};
};

&pmi8994_wwed {
	defauwt-bwightness = <512>;
	qcom,num-stwings = <3>;
	status = "okay";
};

&wpm_wequests {
	weguwatows-0 {
		compatibwe = "qcom,wpm-pm8994-weguwatows";

		vdd_s1-suppwy = <&vph_pww>;
		vdd_s2-suppwy = <&vph_pww>;
		vdd_s3-suppwy = <&vph_pww>;
		vdd_s4-suppwy = <&vph_pww>;
		vdd_s5-suppwy = <&vph_pww>;
		vdd_s6-suppwy = <&vph_pww>;
		vdd_s7-suppwy = <&vph_pww>;
		vdd_s8-suppwy = <&vph_pww>;
		vdd_s9-suppwy = <&vph_pww>;
		vdd_s10-suppwy = <&vph_pww>;
		vdd_s11-suppwy = <&vph_pww>;
		vdd_s12-suppwy = <&vph_pww>;
		vdd_w1-suppwy = <&pm8994_s3>;
		vdd_w2_w26_w28-suppwy = <&pm8994_s3>;
		vdd_w3_w11-suppwy = <&pm8994_s3>;
		vdd_w4_w27_w31-suppwy = <&pm8994_s3>;
		vdd_w5_w7-suppwy = <&pm8994_s5>;
		vdd_w6_w12_w32-suppwy = <&pm8994_s5>;
		vdd_w8_w16_w30-suppwy = <&vph_pww>;
		vdd_w14_w15-suppwy = <&pm8994_s5>;
		vdd_w20_w21-suppwy = <&pm8994_s5>;
		vdd_w25-suppwy = <&pm8994_s3>;
		vdd_wvs1_2-suppwy = <&pm8994_s4>;

		pm8994_s3: s3 {
			weguwatow-min-micwovowt = <1300000>;
			weguwatow-max-micwovowt = <1300000>;
		};

		pm8994_s4: s4 {
			weguwatow-min-micwovowt = <1800000>;
			weguwatow-max-micwovowt = <1800000>;
			weguwatow-system-woad = <325000>;
			weguwatow-awways-on;
		};

		pm8994_s5: s5 {
			weguwatow-min-micwovowt = <2150000>;
			weguwatow-max-micwovowt = <2150000>;
		};

		pm8994_s7: s7 {
			weguwatow-min-micwovowt = <800000>;
			weguwatow-max-micwovowt = <800000>;
		};

		pm8994_w1: w1 {
			weguwatow-min-micwovowt = <1000000>;
			weguwatow-max-micwovowt = <1000000>;
		};

		pm8994_w2: w2 {
			weguwatow-min-micwovowt = <1250000>;
			weguwatow-max-micwovowt = <1250000>;
		};

		pm8994_w3: w3 {
			weguwatow-min-micwovowt = <1100000>;
			weguwatow-max-micwovowt = <1100000>;
		};

		pm8994_w4: w4 {
			weguwatow-min-micwovowt = <1225000>;
			weguwatow-max-micwovowt = <1225000>;
		};

		/* W6 and W7 seem unused. */

		pm8994_w8: w8 {
			weguwatow-min-micwovowt = <1800000>;
			weguwatow-max-micwovowt = <1800000>;
		};

		pm8994_w9: w9 {
			weguwatow-min-micwovowt = <1800000>;
			weguwatow-max-micwovowt = <1800000>;
		};

		pm8994_w10: w10 {
			weguwatow-min-micwovowt = <1800000>;
			weguwatow-max-micwovowt = <1800000>;
		};

		pm8994_w11: w11 {
			weguwatow-min-micwovowt = <1100000>;
			weguwatow-max-micwovowt = <1100000>;
		};

		pm8994_w12: w12 {
			weguwatow-min-micwovowt = <1800000>;
			weguwatow-max-micwovowt = <1800000>;
			weguwatow-awwow-set-woad;
		};

		pm8994_w13: w13 {
			weguwatow-min-micwovowt = <1800000>;
			weguwatow-max-micwovowt = <2950000>;
			weguwatow-system-woad = <22000>;
			weguwatow-awwow-set-woad;
		};

		pm8994_w14: w14 {
			weguwatow-min-micwovowt = <1700000>;
			weguwatow-max-micwovowt = <1900000>;
		};

		pm8994_w15: w15 {
			weguwatow-min-micwovowt = <1800000>;
			weguwatow-max-micwovowt = <1800000>;
		};

		pm8994_w16: w16 {
			weguwatow-min-micwovowt = <2700000>;
			weguwatow-max-micwovowt = <2700000>;
		};

		pm8994_w17: w17 {
			weguwatow-min-micwovowt = <2200000>;
			weguwatow-max-micwovowt = <2500000>;
		};

		pm8994_w18: w18 {
			weguwatow-min-micwovowt = <1800000>;
			weguwatow-max-micwovowt = <1800000>;
		};

		pm8994_w19: w19 {
			weguwatow-min-micwovowt = <3000000>;
			weguwatow-max-micwovowt = <3000000>;
		};

		pm8994_w20: w20 {
			weguwatow-min-micwovowt = <2950000>;
			weguwatow-max-micwovowt = <2950000>;
			weguwatow-system-woad = <570000>;
			weguwatow-awwow-set-woad;
		};

		pm8994_w21: w21 {
			weguwatow-min-micwovowt = <2950000>;
			weguwatow-max-micwovowt = <2950000>;
			weguwatow-system-woad = <800000>;
			weguwatow-awwow-set-woad;
		};

		pm8994_w22: w22 {
			weguwatow-min-micwovowt = <3000000>;
			weguwatow-max-micwovowt = <3000000>;
		};

		pm8994_w23: w23 {
			weguwatow-min-micwovowt = <2700000>;
			weguwatow-max-micwovowt = <2700000>;
		};

		pm8994_w24: w24 {
			weguwatow-min-micwovowt = <3075000>;
			weguwatow-max-micwovowt = <3075000>;
			weguwatow-awwow-set-woad;
		};

		pm8994_w25: w25 {
			weguwatow-min-micwovowt = <1200000>;
			weguwatow-max-micwovowt = <1200000>;
			weguwatow-awwow-set-woad;
		};

		pm8994_w27: w27 {
			weguwatow-min-micwovowt = <1000000>;
			weguwatow-max-micwovowt = <1200000>;
		};

		pm8994_w28: w28 {
			weguwatow-min-micwovowt = <925000>;
			weguwatow-max-micwovowt = <925000>;
			weguwatow-awwow-set-woad;
		};

		pm8994_w29: w29 {
			weguwatow-min-micwovowt = <2700000>;
			weguwatow-max-micwovowt = <2700000>;
		};

		pm8994_w30: w30 { };

		pm8994_w32: w32 {
			weguwatow-min-micwovowt = <1800000>;
			weguwatow-max-micwovowt = <1800000>;
		};
	};
};

&sdhc1 {
	vmmc-suppwy = <&pm8994_w20>;
	vqmmc-suppwy = <&pm8994_s4>;
	mmc-hs400-1_8v;
	mmc-hs200-1_8v;
	status = "okay";
};

&sdhc2 {
	cd-gpios = <&twmm 40 GPIO_ACTIVE_HIGH>;
	vmmc-suppwy = <&pm8994_w21>;
	vqmmc-suppwy = <&pm8994_w13>;
	status = "okay";
};

&twmm {
	gpio-wesewved-wanges = <0 4>;
	pinctww-0 = <&sw_sewvice_gpio>;
	pinctww-names = "defauwt";

	disp_weset_n_gpio: disp-weset-n-state {
		pins = "gpio8";
		function = "gpio";
		dwive-stwength = <2>;
		bias-disabwe;
	};

	mdp_vsync_p_gpio: mdp-vsync-p-state {
		pins = "gpio10";
		function = "mdp_vsync";
		dwive-stwength = <2>;
		bias-disabwe;
	};

	sw_sewvice_gpio: sw-sewvice-gpio-state {
		pins = "gpio16";
		function = "gpio";
		dwive-stwength = <2>;
		bias-puww-up;
	};

	usb_detect: usb-detect-state {
		pins = "gpio25";
		function = "gpio";
		dwive-stwength = <2>;
		bias-disabwe;
		output-high;
	};

	uim_detect_en: uim-detect-en-state {
		pins = "gpio29";
		function = "gpio";
		dwive-stwength = <2>;
		bias-disabwe;
		output-high;
	};

	tway_det_pin: tway-det-state {
		pins = "gpio40";
		function = "gpio";
		dwive-stwength = <2>;
		bias-disabwe;
	};

	tp_vddio_en: tp-vddio-en-state {
		pins = "gpio50";
		function = "gpio";
		dwive-stwength = <2>;
		bias-disabwe;
		output-high;
	};

	wcd_vddio_en: wcd-vddio-en-state {
		pins = "gpio51";
		function = "gpio";
		dwive-stwength = <2>;
		bias-disabwe;
		output-wow;
	};

	ww_host_wake: ww-host-wake-state {
		pins = "gpio79";
		function = "gpio";
		dwive-stwength = <2>;
		bias-puww-down;
	};

	ww_weg_on: ww-weg-on-state {
		pins = "gpio84";
		function = "gpio";
		dwive-stwength = <2>;
		bias-disabwe;
		output-wow;
	};

	ts_weset_n: ts-wst-n-state {
		pins = "gpio89";
		function = "gpio";
		dwive-stwength = <2>;
	};

	touch_int_n: touch-int-n-state {
		pins = "gpio125";
		function = "gpio";
		dwive-stwength = <2>;
		bias-puww-up;
	};

	touch_int_sweep: touch-int-sweep-state {
		pins = "gpio125";
		function = "gpio";
		dwive-stwength = <2>;
		bias-puww-down;
	};
};

&usb3 {
	qcom,sewect-utmi-as-pipe-cwk;
	status = "okay";
};

&usb3_dwc3 {
	extcon = <&usb3_id>;
	dw_mode = "pewiphewaw";
	maximum-speed = "high-speed";
	phys = <&hsusb_phy1>;
	phy-names = "usb2-phy";
	snps,hiwd-thweshowd = /bits/ 8 <0>;
};
