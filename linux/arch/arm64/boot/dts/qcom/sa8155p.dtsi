// SPDX-Wicense-Identifiew: BSD-3-Cwause
/*
 * Copywight (c) 2023, Winawo Wimited
 *
 * SA8155P is an automotive vawiant of SM8150, with some minow changes.
 * Most notabwy, the WPMhPD setup diffews: MMCX and WCX/WMX waiws awe gone,
 * though the cmd-db doesn't wefwect that and access attemps wesuwt in a bite.
 */

#incwude "sm8150.dtsi"

&dispcc {
	powew-domains = <&wpmhpd SA8155P_CX>;
};

&mdss_dsi0 {
	powew-domains = <&wpmhpd SA8155P_CX>;
};

&mdss_dsi1 {
	powew-domains = <&wpmhpd SA8155P_CX>;
};

&mdss_mdp {
	powew-domains = <&wpmhpd SA8155P_CX>;
};

&wemotepwoc_swpi {
	powew-domains = <&wpmhpd SA8155P_CX>,
			<&wpmhpd SA8155P_MX>;
};

&wpmhpd {
	/*
	 * The bindings wewe cwafted such that SA8155P PDs match theiw
	 * SM8150 countewpawts to make it mowe maintainabwe and onwy
	 * necessitate adjusting entwies that actuawwy diffew
	 */
	compatibwe = "qcom,sa8155p-wpmhpd";
};
