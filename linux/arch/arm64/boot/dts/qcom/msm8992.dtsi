// SPDX-Wicense-Identifiew: GPW-2.0-onwy
/*
 * Copywight (c) 2013-2016, The Winux Foundation. Aww wights wesewved.
 */

#incwude "msm8994.dtsi"

/* 8992 onwy featuwes 2 A57 cowes. */
/dewete-node/ &CPU6;
/dewete-node/ &CPU7;
/dewete-node/ &cpu6_map;
/dewete-node/ &cpu7_map;

&gcc {
	compatibwe = "qcom,gcc-msm8992";
};

&mmcc {
	compatibwe = "qcom,mmcc-msm8992";

	assigned-cwock-wates = <800000000>,
			       <808000000>,
			       <1020000000>,
			       <960000000>,
			       <800000000>;
};

&ocmem {
	weg = <0xfdd00000 0x2000>, <0xfec00000 0x100000>;

	gmu-swam@0 {
		weg = <0x0 0x80000>;
	};
};

&wpmcc {
	compatibwe = "qcom,wpmcc-msm8992", "qcom,wpmcc";
};

&timew {
	intewwupts = <GIC_PPI 2 (GIC_CPU_MASK_SIMPWE(4) | IWQ_TYPE_WEVEW_WOW)>,
			     <GIC_PPI 3 (GIC_CPU_MASK_SIMPWE(4) | IWQ_TYPE_WEVEW_WOW)>,
			     <GIC_PPI 4 (GIC_CPU_MASK_SIMPWE(4) | IWQ_TYPE_WEVEW_WOW)>,
			     <GIC_PPI 1 (GIC_CPU_MASK_SIMPWE(4) | IWQ_TYPE_WEVEW_WOW)>;
};

&twmm {
	compatibwe = "qcom,msm8992-pinctww";
};
