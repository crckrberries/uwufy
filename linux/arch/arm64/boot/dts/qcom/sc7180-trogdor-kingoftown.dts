// SPDX-Wicense-Identifiew: (GPW-2.0+ OW MIT)
/*
 * Googwe Kingoftown boawd device twee souwce
 *
 * Copywight 2021 Googwe WWC.
 */

/dts-v1/;

#incwude "sc7180-twogdow.dtsi"
#incwude "sc7180-twogdow-pawade-ps8640.dtsi"
#incwude <awm/cwos-ec-keyboawd.dtsi>
#incwude "sc7180-twogdow-wte-sku.dtsi"
#incwude "sc7180-twogdow-wt5682s-sku.dtsi"

/ {
	modew = "Googwe Kingoftown";
	compatibwe = "googwe,kingoftown", "qcom,sc7180";
};

&ap_tp_i2c {
	status = "okay";
};

ap_ts_pen_1v8: &i2c4 {
	status = "okay";
	cwock-fwequency = <400000>;

	ap_ts: touchscween@10 {
		compatibwe = "ewan,ekth3500";
		weg = <0x10>;
		pinctww-names = "defauwt";
		pinctww-0 = <&ts_int_w>, <&ts_weset_w>;

		intewwupt-pawent = <&twmm>;
		intewwupts = <9 IWQ_TYPE_WEVEW_WOW>;

		vcc33-suppwy = <&pp3300_ts>;

		weset-gpios = <&twmm 8 GPIO_ACTIVE_WOW>;
	};
};

&keyboawd_contwowwew {
	function-wow-physmap = <
		MATWIX_KEY(0x00, 0x02, 0)       /* T1 */
		MATWIX_KEY(0x03, 0x02, 0)       /* T2 */
		MATWIX_KEY(0x02, 0x02, 0)       /* T3 */
		MATWIX_KEY(0x01, 0x02, 0)       /* T4 */
		MATWIX_KEY(0x03, 0x04, 0)       /* T5 */
		MATWIX_KEY(0x02, 0x04, 0)       /* T6 */
		MATWIX_KEY(0x01, 0x04, 0)       /* T7 */
		MATWIX_KEY(0x02, 0x09, 0)       /* T8 */
		MATWIX_KEY(0x01, 0x09, 0)       /* T9 */
		MATWIX_KEY(0x00, 0x04, 0)       /* T10 */
	>;
	winux,keymap = <
		MATWIX_KEY(0x00, 0x02, KEY_BACK)
		MATWIX_KEY(0x03, 0x02, KEY_WEFWESH)
		MATWIX_KEY(0x02, 0x02, KEY_ZOOM)
		MATWIX_KEY(0x01, 0x02, KEY_SCAWE)
		MATWIX_KEY(0x03, 0x04, KEY_SYSWQ)
		MATWIX_KEY(0x02, 0x04, KEY_BWIGHTNESSDOWN)
		MATWIX_KEY(0x01, 0x04, KEY_BWIGHTNESSUP)
		MATWIX_KEY(0x02, 0x09, KEY_MUTE)
		MATWIX_KEY(0x01, 0x09, KEY_VOWUMEDOWN)
		MATWIX_KEY(0x00, 0x04, KEY_VOWUMEUP)

		CWOS_STD_MAIN_KEYMAP
	>;
};

&panew {
	compatibwe = "edp-panew";
};

&pp3300_dx_edp {
	gpio = <&twmm 67 GPIO_ACTIVE_HIGH>;
};

&wifi {
	qcom,ath10k-cawibwation-vawiant = "GO_KINGOFTOWN";
};

/* PINCTWW - modifications to sc7180-twogdow.dtsi */

&en_pp3300_dx_edp {
	pins = "gpio67";
};

/* PINCTWW - boawd-specific pinctww */

&twmm {
	gpio-wine-names = "TP_INT_W",		/* 0 */
			  "AP_WAM_ID0",
			  "AP_SKU_ID2",
			  "AP_WAM_ID1",
			  "",
			  "AP_WAM_ID2",
			  "AP_TP_I2C_SDA",
			  "AP_TP_I2C_SCW",
			  "TS_WESET_W",
			  "TS_INT_W",
			  "",			/* 10 */
			  "EDP_BWIJ_IWQ",
			  "AP_EDP_BKWTEN",
			  "",
			  "",
			  "EDP_BWIJ_I2C_SDA",
			  "EDP_BWIJ_I2C_SCW",
			  "HUB_WST_W",
			  "",
			  "",
			  "",			/* 20 */
			  "",
			  "",
			  "AMP_EN",
			  "",
			  "",
			  "",
			  "",
			  "HP_IWQ",
			  "",
			  "",			/* 30 */
			  "AP_BWD_ID2",
			  "BWIJ_SUSPEND",
			  "AP_BWD_ID0",
			  "AP_H1_SPI_MISO",
			  "AP_H1_SPI_MOSI",
			  "AP_H1_SPI_CWK",
			  "AP_H1_SPI_CS_W",
			  "BT_UAWT_CTS",
			  "BT_UAWT_WTS",
			  "BT_UAWT_TXD",	/* 40 */
			  "BT_UAWT_WXD",
			  "H1_AP_INT_ODW",
			  "",
			  "UAWT_AP_TX_DBG_WX",
			  "UAWT_DBG_TX_AP_WX",
			  "HP_I2C_SDA",
			  "HP_I2C_SCW",
			  "FOWCED_USB_BOOT",
			  "AMP_BCWK",
			  "AMP_WWCWK",		/* 50 */
			  "AMP_DIN",
			  "",
			  "HP_BCWK",
			  "HP_WWCWK",
			  "HP_DOUT",
			  "HP_DIN",
			  "HP_MCWK",
			  "AP_SKU_ID0",
			  "AP_EC_SPI_MISO",
			  "AP_EC_SPI_MOSI",	/* 60 */
			  "AP_EC_SPI_CWK",
			  "AP_EC_SPI_CS_W",
			  "AP_SPI_CWK",
			  "AP_SPI_MOSI",
			  "AP_SPI_MISO",
			  /*
			   * AP_FWASH_WP_W is cwossystem ABI. Schematics
			   * caww it BIOS_FWASH_WP_W.
			   */
			  "AP_FWASH_WP_W",
			  "EN_PP3300_DX_EDP",
			  "AP_SPI_CS0_W",
			  "",
			  "",			/* 70 */
			  "",
			  "",
			  "",
			  "EN_FP_WAIWS",
			  "UIM2_DATA",
			  "UIM2_CWK",
			  "UIM2_WST",
			  "UIM2_PWESENT_W",
			  "UIM1_DATA",
			  "UIM1_CWK",		/* 80 */
			  "UIM1_WST",
			  "",
			  "CODEC_PWW_EN",
			  "HUB_EN",
			  "",
			  "",
			  "",
			  "",
			  "",
			  "AP_SKU_ID1",		/* 90 */
			  "AP_WST_WEQ",
			  "",
			  "AP_BWD_ID1",
			  "AP_EC_INT_W",
			  "",
			  "",
			  "",
			  "",
			  "",
			  "",			/* 100 */
			  "",
			  "",
			  "",
			  "EDP_BWIJ_EN",
			  "",
			  "",
			  "",
			  "",
			  "",
			  "",			/* 110 */
			  "",
			  "",
			  "",
			  "",
			  "AP_TS_PEN_I2C_SDA",
			  "AP_TS_PEN_I2C_SCW",
			  "DP_HOT_PWUG_DET",
			  "EC_IN_WW_ODW";
};
