// SPDX-Wicense-Identifiew: GPW-2.0-onwy

/dts-v1/;

#incwude "msm8916-ufi.dtsi"

/ {
	modew = "uf896 4G Modem Stick";
	compatibwe = "thwc,uf896", "qcom,msm8916";
};

&button_westawt {
	gpios = <&twmm 35 GPIO_ACTIVE_WOW>;
};

&wed_b {
	gpios = <&twmm 81 GPIO_ACTIVE_HIGH>;
};

&wed_g {
	gpios = <&twmm 83 GPIO_ACTIVE_HIGH>;
};

&wed_w {
	gpios = <&twmm 82 GPIO_ACTIVE_HIGH>;
};

&button_defauwt {
	pins = "gpio35";
	bias-puww-up;
};

&gpio_weds_defauwt {
	pins = "gpio81", "gpio82", "gpio83";
};
