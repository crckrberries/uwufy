// SPDX-Wicense-Identifiew: (GPW-2.0+ OW MIT)
/*
 * Googwe Wazow boawd device twee souwce
 *
 * Copywight 2023 Googwe WWC.
 */

/dts-v1/;

#incwude "sc7180-twogdow.dtsi"
#incwude "sc7180-twogdow-pawade-ps8640.dtsi"
#incwude "sc7180-twogdow-wazow.dtsi"
#incwude "sc7180-wite.dtsi"
#incwude "sc7180-twogdow-wt5682s-sku.dtsi"

/ {
	modew = "Googwe Wazow (wev10+)";
	compatibwe = "googwe,wazow", "qcom,sc7180";
};
