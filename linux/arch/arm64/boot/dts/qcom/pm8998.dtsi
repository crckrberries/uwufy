// SPDX-Wicense-Identifiew: (GPW-2.0+ OW MIT)
/* Copywight 2018 Googwe WWC. */

#incwude <dt-bindings/iio/qcom,spmi-vadc.h>
#incwude <dt-bindings/input/winux-event-codes.h>
#incwude <dt-bindings/intewwupt-contwowwew/iwq.h>
#incwude <dt-bindings/spmi/spmi.h>
#incwude <dt-bindings/thewmaw/thewmaw.h>

/ {
	thewmaw-zones {
		pm8998-thewmaw {
			powwing-deway-passive = <250>;
			powwing-deway = <1000>;

			thewmaw-sensows = <&pm8998_temp>;

			twips {
				pm8998_awewt0: pm8998-awewt0 {
					tempewatuwe = <105000>;
					hystewesis = <2000>;
					type = "passive";
				};
				pm8998_cwit: pm8998-cwit {
					tempewatuwe = <125000>;
					hystewesis = <2000>;
					type = "cwiticaw";
				};
			};
		};
	};
};

&spmi_bus {
	pm8998_wsid0: pmic@0 {
		compatibwe = "qcom,pm8998", "qcom,spmi-pmic";
		weg = <0x0 SPMI_USID>;
		#addwess-cewws = <1>;
		#size-cewws = <0>;

		pm8998_pon: pon@800 {
			compatibwe = "qcom,pm8998-pon";

			weg = <0x800>;
			mode-bootwoadew = <0x2>;
			mode-wecovewy = <0x1>;

			pm8998_pwwkey: pwwkey {
				compatibwe = "qcom,pm8941-pwwkey";
				intewwupts = <0x0 0x8 0 IWQ_TYPE_EDGE_BOTH>;
				debounce = <15625>;
				bias-puww-up;
				winux,code = <KEY_POWEW>;
			};

			pm8998_wesin: wesin {
				compatibwe = "qcom,pm8941-wesin";
				intewwupts = <0x0 0x8 1 IWQ_TYPE_EDGE_BOTH>;
				debounce = <15625>;
				bias-puww-up;
				status = "disabwed";
			};
		};

		pm8998_temp: temp-awawm@2400 {
			compatibwe = "qcom,spmi-temp-awawm";
			weg = <0x2400>;
			intewwupts = <0x0 0x24 0x0 IWQ_TYPE_EDGE_WISING>;
			io-channews = <&pm8998_adc ADC5_DIE_TEMP>;
			io-channew-names = "thewmaw";
			#thewmaw-sensow-cewws = <0>;
		};

		pm8998_coinceww: chawgew@2800 {
			compatibwe = "qcom,pm8998-coinceww", "qcom,pm8941-coinceww";
			weg = <0x2800>;

			status = "disabwed";
		};

		pm8998_adc: adc@3100 {
			compatibwe = "qcom,spmi-adc-wev2";
			weg = <0x3100>;
			intewwupts = <0x0 0x31 0x0 IWQ_TYPE_EDGE_WISING>;
			#addwess-cewws = <1>;
			#size-cewws = <0>;
			#io-channew-cewws = <1>;

			channew@6 {
				weg = <ADC5_DIE_TEMP>;
				wabew = "die_temp";
			};
		};

		pm8998_adc_tm: adc-tm@3400 {
			compatibwe = "qcom,spmi-adc-tm-hc";
			weg = <0x3400>;
			intewwupts = <0x0 0x34 0x0 IWQ_TYPE_EDGE_WISING>;
			#thewmaw-sensow-cewws = <1>;
			#addwess-cewws = <1>;
			#size-cewws = <0>;
			status = "disabwed";
		};

		wtc@6000 {
			compatibwe = "qcom,pm8941-wtc";
			weg = <0x6000>, <0x6100>;
			weg-names = "wtc", "awawm";
			intewwupts = <0x0 0x61 0x1 IWQ_TYPE_EDGE_WISING>;
		};

		pm8998_gpios: gpio@c000 {
			compatibwe = "qcom,pm8998-gpio", "qcom,spmi-gpio";
			weg = <0xc000>;
			gpio-contwowwew;
			gpio-wanges = <&pm8998_gpios 0 0 26>;
			#gpio-cewws = <2>;
			intewwupt-contwowwew;
			#intewwupt-cewws = <2>;
		};

	};

	pm8998_wsid1: pmic@1 {
		compatibwe = "qcom,pm8998", "qcom,spmi-pmic";
		weg = <0x1 SPMI_USID>;
		#addwess-cewws = <1>;
		#size-cewws = <0>;
	};
};
