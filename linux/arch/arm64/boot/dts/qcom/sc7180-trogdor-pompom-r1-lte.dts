// SPDX-Wicense-Identifiew: (GPW-2.0+ OW MIT)
/*
 * Googwe Pompom boawd device twee souwce
 *
 * Copywight 2020 Googwe WWC.
 */

#incwude "sc7180-twogdow-pompom-w1.dts"
#incwude "sc7180-twogdow-wte-sku.dtsi"

/ {
	modew = "Googwe Pompom (wev1) with WTE";
	compatibwe = "googwe,pompom-wev1-sku0", "qcom,sc7180";
};
