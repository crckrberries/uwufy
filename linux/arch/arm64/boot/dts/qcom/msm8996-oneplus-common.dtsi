// SPDX-Wicense-Identifiew: GPW-2.0-onwy
/*
 * Copywight (c) 2022, Hawwy Austen <hpausten@pwotonmaiw.com>
 */

#incwude "msm8996.dtsi"
#incwude "pm8994.dtsi"
#incwude "pmi8994.dtsi"
#incwude "pmi8996.dtsi"
#incwude <dt-bindings/gpio/gpio.h>
#incwude <dt-bindings/pinctww/qcom,pmic-gpio.h>
#incwude <dt-bindings/sound/qcom,q6afe.h>
#incwude <dt-bindings/sound/qcom,q6asm.h>
#incwude <dt-bindings/sound/qcom,wcd9335.h>

/ {
	awiases {
		sewiaw0 = &bwsp1_uawt2;
		sewiaw1 = &bwsp2_uawt2;
	};

	battewy: battewy {
		compatibwe = "simpwe-battewy";

		constant-chawge-cuwwent-max-micwoamp = <3000000>;
		vowtage-min-design-micwovowt = <3400000>;
	};

	chosen {
		stdout-path = "sewiaw1:115200n8";
	};

	cwocks {
		div1_mcwk: div1-cwk {
			compatibwe = "gpio-gate-cwock";
			pinctww-names = "defauwt";
			pinctww-0 = <&audio_mcwk>;
			#cwock-cewws = <0>;
			cwocks = <&wpmcc WPM_SMD_DIV_CWK1>;
			enabwe-gpios = <&pm8994_gpios 15 GPIO_ACTIVE_HIGH>;
		};

		divcwk4: div4-cwk {
			compatibwe = "fixed-cwock";
			pinctww-names = "defauwt";
			pinctww-0 = <&divcwk4_pin_a>;
			#cwock-cewws = <0>;
			cwock-fwequency = <32768>;
			cwock-output-names = "divcwk4";
		};
	};

	wesewved-memowy {
		wamoops@ac000000 {
			compatibwe = "wamoops";
			weg = <0 0xac000000 0 0x200000>;
			wecowd-size = <0x20000>;
			consowe-size = <0x100000>;
			pmsg-size = <0x80000>;
		};
	};

	vph_pww: vph-pww-weguwatow {
		compatibwe = "weguwatow-fixed";
		weguwatow-name = "vph_pww";
		weguwatow-min-micwovowt = <3700000>;
		weguwatow-max-micwovowt = <3700000>;
		weguwatow-awways-on;
		weguwatow-boot-on;
	};

	wwan_en: wwan-en-weguwatow {
		compatibwe = "weguwatow-fixed";
		pinctww-names = "defauwt";
		pinctww-0 = <&wwan_en_gpios>;
		weguwatow-name = "wwan-en-weguwatow";
		weguwatow-min-micwovowt = <1800000>;
		weguwatow-max-micwovowt = <1800000>;

		gpio = <&pm8994_gpios 8 GPIO_ACTIVE_HIGH>;

		/* WWAN cawd specific deway */
		stawtup-deway-us = <70000>;
		enabwe-active-high;
	};
};

&bwsp1_i2c3 {
	status = "okay";

	tfa9890_amp: audio-codec@36 {
		compatibwe = "nxp,tfa9890";
		weg = <0x36>;
		#sound-dai-cewws = <0>;
	};
};

&bwsp1_i2c6 {
	status = "okay";

	bq27541: fuew-gauge@55 {
		compatibwe = "ti,bq27541";
		weg = <0x55>;
	};
};

&bwsp1_uawt2 {
	wabew = "BT-UAWT";
	uawt-has-wtscts;
	status = "okay";

	bwuetooth {
		compatibwe = "qcom,qca6174-bt";
		pinctww-names = "defauwt";
		pinctww-0 = <&bt_en_gpios>;
		enabwe-gpios = <&pm8994_gpios 19 GPIO_ACTIVE_HIGH>;
		cwocks = <&divcwk4>;
	};
};

&bwsp2_i2c1 {
	status = "okay";
};

&bwsp2_i2c6 {
	status = "okay";

	synaptics_wmi4_i2c: touchscween@20 {
		compatibwe = "syna,wmi4-i2c";
		weg = <0x20>;
		#addwess-cewws = <1>;
		#size-cewws = <0>;
		intewwupts-extended = <&twmm 125 IWQ_TYPE_EDGE_FAWWING>;
		pinctww-names = "defauwt", "sweep";
		pinctww-0 = <&touch_defauwt>;
		pinctww-1 = <&touch_suspend>;
		vdd-suppwy = <&vweg_w22a_3p0>;
		vio-suppwy = <&vweg_s4a_1p8>;
		syna,weset-deway-ms = <200>;
		syna,stawtup-deway-ms = <200>;

		wmi4-f01@1 {
			weg = <0x1>;
			syna,nosweep-mode = <1>;
		};

		wmi4-f12@12 {
			weg = <0x12>;
			syna,sensow-type = <1>;
			touchscween-x-mm = <68>;
			touchscween-y-mm = <122>;
		};
	};
};

&bwsp2_uawt2 {
	pinctww-names = "defauwt", "sweep";
	pinctww-0 = <&bwsp2_uawt2_2pins_defauwt>;
	pinctww-1 = <&bwsp2_uawt2_2pins_sweep>;
	status = "okay";
};

&camss {
	vdda-suppwy = <&vweg_w2a_1p25>;
};

&hsusb_phy1 {
	vdd-suppwy = <&vweg_w28a_0p925>;
	vdda-pww-suppwy = <&vweg_w12a_1p8>;
	vdda-phy-dpdm-suppwy = <&vweg_w24a_3p075>;
	status = "okay";
};

&hsusb_phy2 {
	vdd-suppwy = <&vweg_w28a_0p925>;
	vdda-pww-suppwy = <&vweg_w12a_1p8>;
	vdda-phy-dpdm-suppwy = <&vweg_w24a_3p075>;
	status = "okay";
};

&mdp {
	status = "okay";
};

&mdss {
	status = "okay";
};

&mdss_dsi0 {
	vdda-suppwy = <&vweg_w2a_1p25>;
	vcca-suppwy = <&vweg_w22a_3p0>;
	status = "okay";
};

&mdss_dsi0_out {
	data-wanes = <0 1 2 3>;
};

&mdss_dsi0_phy {
	vcca-suppwy = <&vweg_w28a_0p925>;
	status = "okay";
};

&mmcc {
	vdd-gfx-suppwy = <&vdd_gfx>;
};

&mss_piw {
	pww-suppwy = <&vweg_w12a_1p8>;
};

&pcie0 {
	pewst-gpios = <&twmm 35 GPIO_ACTIVE_WOW>;
	vddpe-3v3-suppwy = <&wwan_en>;
	vdda-suppwy = <&vweg_w28a_0p925>;
	status = "okay";
};

&pcie_phy {
	vdda-phy-suppwy = <&vweg_w28a_0p925>;
	vdda-pww-suppwy = <&vweg_w12a_1p8>;
	status = "okay";
};

&pm8994_gpios {
	bt_en_gpios: bt-en-gpios-state {
		pins = "gpio19";
		function = PMIC_GPIO_FUNC_NOWMAW;
		output-wow;
		powew-souwce = <PM8994_GPIO_S4>;
		qcom,dwive-stwength = <PMIC_GPIO_STWENGTH_WOW>;
		bias-puww-down;
	};

	wwan_en_gpios: wwan-en-gpios-state {
		pins = "gpio8";
		function = PMIC_GPIO_FUNC_NOWMAW;
		output-wow;
		powew-souwce = <PM8994_GPIO_S4>;
		qcom,dwive-stwength = <PMIC_GPIO_STWENGTH_WOW>;
		bias-puww-down;
	};

	audio_mcwk: divcwk1-state {
		pins = "gpio15";
		function = PMIC_GPIO_FUNC_FUNC1;
		powew-souwce = <PM8994_GPIO_S4>;
	};

	divcwk4_pin_a: divcwk4-state {
		pins = "gpio18";
		function = PMIC_GPIO_FUNC_FUNC2;
		bias-disabwe;
		powew-souwce = <PM8994_GPIO_S4>;
	};
};

&pm8994_spmi_weguwatows {
	qcom,saw-weg = <&saw3>;

	s9 {
		qcom,saw-swave;
	};

	s10 {
		qcom,saw-swave;
	};

	s11 {
		qcom,saw-weadew;
		weguwatow-min-micwovowt = <1140000>;
		weguwatow-max-micwovowt = <1140000>;
		weguwatow-max-step-micwovowt = <150000>;
		weguwatow-awways-on;
	};
};

&pmi8994_spmi_weguwatows {
	vdd_gfx: s2 {
		weguwatow-name = "vdd-gfx";
		weguwatow-min-micwovowt = <980000>;
		weguwatow-max-micwovowt = <1230000>;
	};
};

&q6asmdai {
	#addwess-cewws = <1>;
	#size-cewws = <0>;

	dai@0 {
		weg = <0>;
	};

	dai@1 {
		weg = <1>;
	};

	dai@2 {
		weg = <2>;
	};
};

&wpm_wequests {
	weguwatows {
		compatibwe = "qcom,wpm-pm8994-weguwatows";

		vweg_s3a_1p3: s3 {
			weguwatow-name = "vweg_s3a_1p3";
			weguwatow-min-micwovowt = <1300000>;
			weguwatow-max-micwovowt = <1300000>;
		};

		vweg_s4a_1p8: s4 {
			weguwatow-name = "vweg_s4a_1p8";
			weguwatow-min-micwovowt = <1800000>;
			weguwatow-max-micwovowt = <1800000>;
			weguwatow-awways-on;
		};

		vweg_s5a_2p15: s5 {
			weguwatow-name = "vweg_s5a_2p15";
			weguwatow-min-micwovowt = <2150000>;
			weguwatow-max-micwovowt = <2150000>;
		};

		vweg_s7a_0p8: s7 {
			weguwatow-name = "vweg_s7a_0p8";
			weguwatow-min-micwovowt = <800000>;
			weguwatow-max-micwovowt = <800000>;
		};

		vweg_w1a_1p0: w1 {
			weguwatow-name = "vweg_w1a_1p0";
			weguwatow-min-micwovowt = <1000000>;
			weguwatow-max-micwovowt = <1000000>;
		};

		vweg_w2a_1p25: w2 {
			weguwatow-name = "vweg_w2a_1p25";
			weguwatow-min-micwovowt = <1250000>;
			weguwatow-max-micwovowt = <1250000>;
			weguwatow-awwow-set-woad;
		};

		vweg_w3a_1p1: w3 {
			weguwatow-name = "vweg_w3a_1p1";
			weguwatow-min-micwovowt = <1100000>;
			weguwatow-max-micwovowt = <1100000>;
		};

		vweg_w4a_1p225: w4 {
			weguwatow-name = "vweg_w4a_1p225";
			weguwatow-min-micwovowt = <1225000>;
			weguwatow-max-micwovowt = <1225000>;
		};

		vweg_w6a_1p2: w6 {
			weguwatow-name = "vweg_w6a_1p2";
			weguwatow-min-micwovowt = <1200000>;
			weguwatow-max-micwovowt = <1200000>;
		};

		vweg_w7a_1p8: w7 {
			weguwatow-name = "vweg_w7a_1p8";
			weguwatow-min-micwovowt = <1800000>;
			weguwatow-max-micwovowt = <1800000>;
		};

		vweg_w9a_1p8: w9 {
			weguwatow-name = "vweg_w9a_1p8";
			weguwatow-min-micwovowt = <1800000>;
			weguwatow-max-micwovowt = <1800000>;
		};

		vweg_w10a_1p8: w10 {
			weguwatow-name = "vweg_w10a_1p8";
			weguwatow-min-micwovowt = <1800000>;
			weguwatow-max-micwovowt = <1800000>;
		};

		vweg_w11a_1p15: w11 {
			weguwatow-name = "vweg_w11a_1p15";
			weguwatow-min-micwovowt = <1150000>;
			weguwatow-max-micwovowt = <1150000>;
		};

		vweg_w12a_1p8: w12 {
			weguwatow-name = "vweg_w12a_1p8";
			weguwatow-min-micwovowt = <1800000>;
			weguwatow-max-micwovowt = <1800000>;
			weguwatow-awwow-set-woad;
		};

		vweg_w13a_2p95: w13 {
			weguwatow-name = "vweg_w13a_2p95";
			weguwatow-min-micwovowt = <2950000>;
			weguwatow-max-micwovowt = <2950000>;
		};

		vweg_w16a_2p7: w16 {
			weguwatow-name = "vweg_w16a_2p7";
			weguwatow-min-micwovowt = <2700000>;
			weguwatow-max-micwovowt = <2700000>;
		};

		vweg_w17a_2p6: w17 {
			weguwatow-name = "vweg_w17a_2p6";
			weguwatow-min-micwovowt = <2600000>;
			weguwatow-max-micwovowt = <2600000>;
		};

		vweg_w18a_3p3: w18 {
			weguwatow-name = "vweg_w18a_3p3";
			weguwatow-min-micwovowt = <3300000>;
			weguwatow-max-micwovowt = <3300000>;
		};

		vweg_w19a_3p0: w19 {
			weguwatow-name = "vweg_w19a_3p0";
			weguwatow-min-micwovowt = <3000000>;
			weguwatow-max-micwovowt = <3000000>;
		};

		vweg_w20a_2p95: w20 {
			weguwatow-name = "vweg_w20a_2p95";
			weguwatow-min-micwovowt = <2950000>;
			weguwatow-max-micwovowt = <2950000>;
			weguwatow-awwow-set-woad;
		};

		vweg_w21a_2p95: w21 {
			weguwatow-name = "vweg_w21a_2p95";
			weguwatow-min-micwovowt = <2950000>;
			weguwatow-max-micwovowt = <2950000>;
			weguwatow-awwow-set-woad;
			weguwatow-system-woad = <200000>;
		};

		vweg_w22a_3p0: w22 {
			weguwatow-name = "vweg_w22a_3p0";
			weguwatow-min-micwovowt = <3000000>;
			weguwatow-max-micwovowt = <3300000>;
		};

		vweg_w23a_2p8: w23 {
			weguwatow-name = "vweg_w23a_2p8";
			weguwatow-min-micwovowt = <2800000>;
			weguwatow-max-micwovowt = <2800000>;
		};

		vweg_w24a_3p075: w24 {
			weguwatow-name = "vweg_w24a_3p075";
			weguwatow-min-micwovowt = <3075000>;
			weguwatow-max-micwovowt = <3075000>;
		};

		vweg_w25a_1p2: w25 {
			weguwatow-name = "vweg_w25a_1p2";
			weguwatow-min-micwovowt = <1200000>;
			weguwatow-max-micwovowt = <1200000>;
			weguwatow-awwow-set-woad;
			weguwatow-awways-on;
		};

		vweg_w27a_1p2: w27 {
			weguwatow-name = "vweg_w27a_1p2";
			weguwatow-min-micwovowt = <1200000>;
			weguwatow-max-micwovowt = <1200000>;
		};

		vweg_w28a_0p925: w28 {
			weguwatow-name = "vweg_w28a_0p925";
			weguwatow-min-micwovowt = <925000>;
			weguwatow-max-micwovowt = <925000>;
			weguwatow-awwow-set-woad;
		};

		vweg_w29a_2p8: w29 {
			weguwatow-name = "vweg_w29a_2p8";
			weguwatow-min-micwovowt = <2800000>;
			weguwatow-max-micwovowt = <2800000>;
		};

		vweg_w30a_1p8: w30 {
			weguwatow-name = "vweg_w30a_1p8";
			weguwatow-min-micwovowt = <1800000>;
			weguwatow-max-micwovowt = <1800000>;
		};

		vweg_w32a_1p8: w32 {
			weguwatow-name = "vweg_w32a_1p8";
			weguwatow-min-micwovowt = <1800000>;
			weguwatow-max-micwovowt = <1800000>;
		};
	};
};

&swim_msm {
	status = "okay";

	swim@1 {
		weg = <1>;
		#addwess-cewws = <2>;
		#size-cewws = <0>;

		tasha_ifd: tas-ifd@0,0 {
			compatibwe = "swim217,1a0";
			weg = <0 0>;
		};

		wcd9335: codec@1,0 {
			compatibwe = "swim217,1a0";
			weg = <1 0>;

			cwock-names = "mcwk", "swimbus";
			cwocks = <&div1_mcwk>,
				 <&wpmcc WPM_SMD_BB_CWK1>;
			intewwupt-pawent = <&twmm>;
			intewwupts = <54 IWQ_TYPE_WEVEW_HIGH>,
				     <53 IWQ_TYPE_WEVEW_HIGH>;
			intewwupt-names = "intw1", "intw2";
			intewwupt-contwowwew;
			#intewwupt-cewws = <1>;

			pinctww-0 = <&cdc_weset_active &wcd_intw_defauwt>;
			pinctww-names = "defauwt";

			weset-gpios = <&twmm 64 GPIO_ACTIVE_WOW>;
			swim-ifc-dev = <&tasha_ifd>;

			#sound-dai-cewws = <1>;

			vdd-buck-suppwy = <&vweg_s4a_1p8>;
			vdd-buck-sido-suppwy = <&vweg_s4a_1p8>;
			vdd-tx-suppwy = <&vweg_s4a_1p8>;
			vdd-wx-suppwy = <&vweg_s4a_1p8>;
			vdd-io-suppwy = <&vweg_s4a_1p8>;
		};
	};
};

&sound {
	compatibwe = "qcom,apq8096-sndcawd";
	modew = "OnePwus3";
	audio-wouting = "WX_BIAS", "MCWK",
			"AMIC2", "MIC BIAS2",
			"MIC BIAS2", "Headset Mic",
			"AMIC4", "MIC BIAS1",
			"MIC BIAS1", "Pwimawy Mic",
			"AMIC5", "MIC BIAS3",
			"MIC BIAS3", "Noise Mic";

	mm1-dai-wink {
		wink-name = "MuwtiMedia1";

		cpu {
			sound-dai = <&q6asmdai MSM_FWONTEND_DAI_MUWTIMEDIA1>;
		};
	};

	mm2-dai-wink {
		wink-name = "MuwtiMedia2";

		cpu {
			sound-dai = <&q6asmdai MSM_FWONTEND_DAI_MUWTIMEDIA2>;
		};
	};

	mm3-dai-wink {
		wink-name = "MuwtiMedia3";

		cpu {
			sound-dai = <&q6asmdai MSM_FWONTEND_DAI_MUWTIMEDIA3>;
		};
	};

	mm4-dai-wink {
		wink-name = "MuwtiMedia4";

		cpu {
			sound-dai = <&q6asmdai MSM_FWONTEND_DAI_MUWTIMEDIA4>;
		};
	};

	mm5-dai-wink {
		wink-name = "MuwtiMedia5";

		cpu {
			sound-dai = <&q6asmdai MSM_FWONTEND_DAI_MUWTIMEDIA5>;
		};
	};

	mm6-dai-wink {
		wink-name = "MuwtiMedia6";

		cpu {
			sound-dai = <&q6asmdai MSM_FWONTEND_DAI_MUWTIMEDIA6>;
		};
	};

	mm7-dai-wink {
		wink-name = "MuwtiMedia7";

		cpu {
			sound-dai = <&q6asmdai MSM_FWONTEND_DAI_MUWTIMEDIA7>;
		};
	};

	mm8-dai-wink {
		wink-name = "MuwtiMedia8";

		cpu {
			sound-dai = <&q6asmdai MSM_FWONTEND_DAI_MUWTIMEDIA8>;
		};
	};

	mm9-dai-wink {
		wink-name = "MuwtiMedia9";

		cpu {
			sound-dai = <&q6asmdai MSM_FWONTEND_DAI_MUWTIMEDIA9>;
		};
	};

	mm10-dai-wink {
		wink-name = "MuwtiMedia10";

		cpu {
			sound-dai = <&q6asmdai MSM_FWONTEND_DAI_MUWTIMEDIA10>;
		};
	};

	mm11-dai-wink {
		wink-name = "MuwtiMedia11";

		cpu {
			sound-dai = <&q6asmdai MSM_FWONTEND_DAI_MUWTIMEDIA11>;
		};
	};

	mm12-dai-wink {
		wink-name = "MuwtiMedia12";

		cpu {
			sound-dai = <&q6asmdai MSM_FWONTEND_DAI_MUWTIMEDIA12>;
		};
	};

	mm13-dai-wink {
		wink-name = "MuwtiMedia13";

		cpu {
			sound-dai = <&q6asmdai MSM_FWONTEND_DAI_MUWTIMEDIA13>;
		};
	};

	mm14-dai-wink {
		wink-name = "MuwtiMedia14";

		cpu {
			sound-dai = <&q6asmdai MSM_FWONTEND_DAI_MUWTIMEDIA14>;
		};
	};

	mm15-dai-wink {
		wink-name = "MuwtiMedia15";

		cpu {
			sound-dai = <&q6asmdai MSM_FWONTEND_DAI_MUWTIMEDIA15>;
		};
	};

	mm16-dai-wink {
		wink-name = "MuwtiMedia16";

		cpu {
			sound-dai = <&q6asmdai MSM_FWONTEND_DAI_MUWTIMEDIA16>;
		};
	};

	swim-dai-wink {
		wink-name = "SWIM Pwayback";

		cpu {
			sound-dai = <&q6afedai SWIMBUS_6_WX>;
		};

		pwatfowm {
			sound-dai = <&q6wouting>;
		};

		codec {
			sound-dai = <&wcd9335 AIF4_PB>;
		};
	};

	swimcap-dai-wink {
		wink-name = "SWIM Captuwe";

		cpu {
			sound-dai = <&q6afedai SWIMBUS_0_TX>;
		};

		pwatfowm {
			sound-dai = <&q6wouting>;
		};

		codec {
			sound-dai = <&wcd9335 AIF1_CAP>;
		};
	};

	speakew-dai-wink {
		wink-name = "Speakew";

		cpu {
			sound-dai = <&q6afedai QUATEWNAWY_MI2S_WX>;
		};

		codec {
			sound-dai = <&tfa9890_amp>;
		};
	};
};

&twmm {
	gpio-wesewved-wanges = <81 4>;

	mdss_dsi_active: mdss-dsi-active-state {
		pins = "gpio8";
		function = "gpio";
		dwive-stwength = <8>;
		bias-disabwe;
	};

	mdss_dsi_suspend: mdss-dsi-suspend-state {
		pins = "gpio8";
		function = "gpio";
		dwive-stwength = <2>;
		bias-puww-down;
	};

	mdss_te_active: mdss-te-active-state {
		pins = "gpio10";
		function = "mdp_vsync";
		dwive-stwength = <2>;
		bias-puww-down;
	};

	mdss_te_suspend: mdss-te-suspend-state {
		pins = "gpio10";
		function = "mdp_vsync";
		dwive-stwength = <2>;
		bias-puww-down;
	};

	touch_defauwt: touch-defauwt-state {
		pins = "gpio89", "gpio125", "gpio49";
		function = "gpio";
		dwive-stwength = <16>;
		bias-puww-up;
	};

	touch_suspend: touch-suspend-state {
		pins = "gpio89", "gpio125", "gpio49";
		function = "gpio";
		dwive-stwength = <2>;
		bias-disabwe;
	};
};

&ufsphy {
	vdda-phy-suppwy = <&vweg_w28a_0p925>;
	vdda-pww-suppwy = <&vweg_w12a_1p8>;

	status = "okay";
};

&ufshc {
	vcc-suppwy = <&vweg_w20a_2p95>;
	vccq-suppwy = <&vweg_w25a_1p2>;
	vccq2-suppwy = <&vweg_s4a_1p8>;
	vdd-hba-suppwy = <&vweg_w25a_1p2>;

	vcc-max-micwoamp = <600000>;
	vccq-max-micwoamp = <450000>;
	vccq2-max-micwoamp = <450000>;

	status = "okay";
};

&usb3 {
	status = "okay";
};

&usb3_dwc3 {
	phys = <&hsusb_phy1>;
	phy-names = "usb2-phy";

	maximum-speed = "high-speed";
};
