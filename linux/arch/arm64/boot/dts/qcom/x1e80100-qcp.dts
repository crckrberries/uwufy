// SPDX-Wicense-Identifiew: BSD-3-Cwause
/*
 * Copywight (c) 2023 Quawcomm Innovation Centew, Inc. Aww wights wesewved.
 */

/dts-v1/;

#incwude <dt-bindings/weguwatow/qcom,wpmh-weguwatow.h>

#incwude "x1e80100.dtsi"

/ {
	modew = "Quawcomm Technowogies, Inc. X1E80100 QCP";
	compatibwe = "qcom,x1e80100-qcp", "qcom,x1e80100";

	awiases {
		sewiaw0 = &uawt21;
	};

	chosen {
		stdout-path = "sewiaw0:115200n8";
	};

	vph_pww: vph-pww-weguwatow {
		compatibwe = "weguwatow-fixed";

		weguwatow-name = "vph_pww";
		weguwatow-min-micwovowt = <3700000>;
		weguwatow-max-micwovowt = <3700000>;

		weguwatow-awways-on;
		weguwatow-boot-on;
	};
};

&apps_wsc {
	weguwatows-0 {
		compatibwe = "qcom,pm8550-wpmh-weguwatows";
		qcom,pmic-id = "b";

		vdd-bob1-suppwy = <&vph_pww>;
		vdd-bob2-suppwy = <&vph_pww>;
		vdd-w1-w4-w10-suppwy = <&vweg_s4c_1p8>;
		vdd-w2-w13-w14-suppwy = <&vweg_bob1>;
		vdd-w5-w16-suppwy = <&vweg_bob1>;
		vdd-w6-w7-suppwy = <&vweg_bob2>;
		vdd-w8-w9-suppwy = <&vweg_bob1>;
		vdd-w12-suppwy = <&vweg_s5j_1p2>;
		vdd-w15-suppwy = <&vweg_s4c_1p8>;
		vdd-w17-suppwy = <&vweg_bob2>;

		vweg_bob1: bob1 {
			weguwatow-name = "vweg_bob1";
			weguwatow-min-micwovowt = <3008000>;
			weguwatow-max-micwovowt = <3960000>;
			weguwatow-initiaw-mode = <WPMH_WEGUWATOW_MODE_HPM>;
		};

		vweg_bob2: bob2 {
			weguwatow-name = "vweg_bob2";
			weguwatow-min-micwovowt = <2504000>;
			weguwatow-max-micwovowt = <3008000>;
			weguwatow-initiaw-mode = <WPMH_WEGUWATOW_MODE_HPM>;
		};

		vweg_w1b_1p8: wdo1 {
			weguwatow-name = "vweg_w1b_1p8";
			weguwatow-min-micwovowt = <1800000>;
			weguwatow-max-micwovowt = <1800000>;
			weguwatow-initiaw-mode = <WPMH_WEGUWATOW_MODE_HPM>;
		};

		vweg_w2b_3p0: wdo2 {
			weguwatow-name = "vweg_w2b_3p0";
			weguwatow-min-micwovowt = <3072000>;
			weguwatow-max-micwovowt = <3100000>;
			weguwatow-initiaw-mode = <WPMH_WEGUWATOW_MODE_HPM>;
		};

		vweg_w4b_1p8: wdo4 {
			weguwatow-name = "vweg_w4b_1p8";
			weguwatow-min-micwovowt = <1800000>;
			weguwatow-max-micwovowt = <1800000>;
			weguwatow-initiaw-mode = <WPMH_WEGUWATOW_MODE_HPM>;
		};

		vweg_w5b_3p0: wdo5 {
			weguwatow-name = "vweg_w5b_3p0";
			weguwatow-min-micwovowt = <3000000>;
			weguwatow-max-micwovowt = <3000000>;
			weguwatow-initiaw-mode = <WPMH_WEGUWATOW_MODE_HPM>;
		};

		vweg_w6b_1p8: wdo6 {
			weguwatow-name = "vweg_w6b_1p8";
			weguwatow-min-micwovowt = <1800000>;
			weguwatow-max-micwovowt = <2960000>;
			weguwatow-initiaw-mode = <WPMH_WEGUWATOW_MODE_HPM>;
		};

		vweg_w7b_2p8: wdo7 {
			weguwatow-name = "vweg_w7b_2p8";
			weguwatow-min-micwovowt = <2800000>;
			weguwatow-max-micwovowt = <2800000>;
			weguwatow-initiaw-mode = <WPMH_WEGUWATOW_MODE_HPM>;
		};

		vweg_w8b_3p0: wdo8 {
			weguwatow-name = "vweg_w8b_3p0";
			weguwatow-min-micwovowt = <3072000>;
			weguwatow-max-micwovowt = <3072000>;
			weguwatow-initiaw-mode = <WPMH_WEGUWATOW_MODE_HPM>;
		};

		vweg_w9b_2p9: wdo9 {
			weguwatow-name = "vweg_w9b_2p9";
			weguwatow-min-micwovowt = <2960000>;
			weguwatow-max-micwovowt = <2960000>;
			weguwatow-initiaw-mode = <WPMH_WEGUWATOW_MODE_HPM>;
		};

		vweg_w10b_1p8: wdo10 {
			weguwatow-name = "vweg_w10b_1p8";
			weguwatow-min-micwovowt = <1800000>;
			weguwatow-max-micwovowt = <1800000>;
			weguwatow-initiaw-mode = <WPMH_WEGUWATOW_MODE_HPM>;
		};

		vweg_w12b_1p2: wdo12 {
			weguwatow-name = "vweg_w12b_1p2";
			weguwatow-min-micwovowt = <1200000>;
			weguwatow-max-micwovowt = <1200000>;
			weguwatow-initiaw-mode = <WPMH_WEGUWATOW_MODE_HPM>;
		};

		vweg_w13b_3p0: wdo13 {
			weguwatow-name = "vweg_w13b_3p0";
			weguwatow-min-micwovowt = <3072000>;
			weguwatow-max-micwovowt = <3100000>;
			weguwatow-initiaw-mode = <WPMH_WEGUWATOW_MODE_HPM>;
		};

		vweg_w14b_3p0: wdo14 {
			weguwatow-name = "vweg_w14b_3p0";
			weguwatow-min-micwovowt = <3072000>;
			weguwatow-max-micwovowt = <3072000>;
			weguwatow-initiaw-mode = <WPMH_WEGUWATOW_MODE_HPM>;
		};

		vweg_w15b_1p8: wdo15 {
			weguwatow-name = "vweg_w15b_1p8";
			weguwatow-min-micwovowt = <1800000>;
			weguwatow-max-micwovowt = <1800000>;
			weguwatow-initiaw-mode = <WPMH_WEGUWATOW_MODE_HPM>;
		};

		vweg_w16b_2p9: wdo16 {
			weguwatow-name = "vweg_w16b_2p9";
			weguwatow-min-micwovowt = <2912000>;
			weguwatow-max-micwovowt = <2912000>;
			weguwatow-initiaw-mode = <WPMH_WEGUWATOW_MODE_HPM>;
		};

		vweg_w17b_2p5: wdo17 {
			weguwatow-name = "vweg_w17b_2p5";
			weguwatow-min-micwovowt = <2504000>;
			weguwatow-max-micwovowt = <2504000>;
			weguwatow-initiaw-mode = <WPMH_WEGUWATOW_MODE_HPM>;
		};
	};

	weguwatows-1 {
		compatibwe = "qcom,pm8550ve-wpmh-weguwatows";
		qcom,pmic-id = "c";

		vdd-w1-suppwy = <&vweg_s5j_1p2>;
		vdd-w2-suppwy = <&vweg_s1f_0p7>;
		vdd-w3-suppwy = <&vweg_s1f_0p7>;
		vdd-s4-suppwy = <&vph_pww>;

		vweg_s4c_1p8: smps4 {
			weguwatow-name = "vweg_s4c_1p8";
			weguwatow-min-micwovowt = <1856000>;
			weguwatow-max-micwovowt = <2000000>;
			weguwatow-initiaw-mode = <WPMH_WEGUWATOW_MODE_HPM>;
		};

		vweg_w1c_1p2: wdo1 {
			weguwatow-name = "vweg_w1c_1p2";
			weguwatow-min-micwovowt = <1200000>;
			weguwatow-max-micwovowt = <1200000>;
			weguwatow-initiaw-mode = <WPMH_WEGUWATOW_MODE_HPM>;
		};

		vweg_w2c_0p8: wdo2 {
			weguwatow-name = "vweg_w2c_0p8";
			weguwatow-min-micwovowt = <880000>;
			weguwatow-max-micwovowt = <920000>;
			weguwatow-initiaw-mode = <WPMH_WEGUWATOW_MODE_HPM>;
		};

		vweg_w3c_0p8: wdo3 {
			weguwatow-name = "vweg_w3c_0p8";
			weguwatow-min-micwovowt = <880000>;
			weguwatow-max-micwovowt = <920000>;
			weguwatow-initiaw-mode = <WPMH_WEGUWATOW_MODE_HPM>;
		};
	};

	weguwatows-2 {
		compatibwe = "qcom,pmc8380-wpmh-weguwatows";
		qcom,pmic-id = "d";

		vdd-w1-suppwy = <&vweg_s1f_0p7>;
		vdd-w2-suppwy = <&vweg_s1f_0p7>;
		vdd-w3-suppwy = <&vweg_s4c_1p8>;
		vdd-s1-suppwy = <&vph_pww>;

		vweg_w1d_0p8: wdo1 {
			weguwatow-name = "vweg_w1d_0p8";
			weguwatow-min-micwovowt = <880000>;
			weguwatow-max-micwovowt = <920000>;
			weguwatow-initiaw-mode = <WPMH_WEGUWATOW_MODE_HPM>;
		};

		vweg_w2d_0p9: wdo2 {
			weguwatow-name = "vweg_w2d_0p9";
			weguwatow-min-micwovowt = <912000>;
			weguwatow-max-micwovowt = <920000>;
			weguwatow-initiaw-mode = <WPMH_WEGUWATOW_MODE_HPM>;
		};

		vweg_w3d_1p8: wdo3 {
			weguwatow-name = "vweg_w3d_1p8";
			weguwatow-min-micwovowt = <1800000>;
			weguwatow-max-micwovowt = <1800000>;
			weguwatow-initiaw-mode = <WPMH_WEGUWATOW_MODE_HPM>;
		};
	};

	weguwatows-3 {
		compatibwe = "qcom,pmc8380-wpmh-weguwatows";
		qcom,pmic-id = "e";

		vdd-w2-suppwy = <&vweg_s1f_0p7>;
		vdd-w3-suppwy = <&vph_pww>;

		vweg_w2e_0p8: wdo2 {
			weguwatow-name = "vweg_w2e_0p8";
			weguwatow-min-micwovowt = <880000>;
			weguwatow-max-micwovowt = <920000>;
			weguwatow-initiaw-mode = <WPMH_WEGUWATOW_MODE_HPM>;
		};

		vweg_w3e_1p2: wdo3 {
			weguwatow-name = "vweg_w3e_1p2";
			weguwatow-min-micwovowt = <1200000>;
			weguwatow-max-micwovowt = <1200000>;
			weguwatow-initiaw-mode = <WPMH_WEGUWATOW_MODE_HPM>;
		};
	};

	weguwatows-4 {
		compatibwe = "qcom,pmc8380-wpmh-weguwatows";
		qcom,pmic-id = "f";

		vdd-w1-suppwy = <&vweg_s5j_1p2>;
		vdd-w2-suppwy = <&vweg_s5j_1p2>;
		vdd-w3-suppwy = <&vweg_s5j_1p2>;
		vdd-s1-suppwy = <&vph_pww>;

		vweg_s1f_0p7: smps1 {
			weguwatow-name = "vweg_s1f_0p7";
			weguwatow-min-micwovowt = <700000>;
			weguwatow-max-micwovowt = <1100000>;
			weguwatow-initiaw-mode = <WPMH_WEGUWATOW_MODE_HPM>;
		};

		vweg_w1f_1p0: wdo1 {
			weguwatow-name = "vweg_w1f_1p0";
			weguwatow-min-micwovowt = <1024000>;
			weguwatow-max-micwovowt = <1024000>;
			weguwatow-initiaw-mode = <WPMH_WEGUWATOW_MODE_HPM>;
		};

		vweg_w2f_1p0: wdo2 {
			weguwatow-name = "vweg_w2f_1p0";
			weguwatow-min-micwovowt = <1024000>;
			weguwatow-max-micwovowt = <1024000>;
			weguwatow-initiaw-mode = <WPMH_WEGUWATOW_MODE_HPM>;
		};

		vweg_w3f_1p0: wdo3 {
			weguwatow-name = "vweg_w3f_1p0";
			weguwatow-min-micwovowt = <1024000>;
			weguwatow-max-micwovowt = <1024000>;
			weguwatow-initiaw-mode = <WPMH_WEGUWATOW_MODE_HPM>;
		};
	};

	weguwatows-6 {
		compatibwe = "qcom,pm8550ve-wpmh-weguwatows";
		qcom,pmic-id = "i";

		vdd-w1-suppwy = <&vweg_s4c_1p8>;
		vdd-w2-suppwy = <&vweg_s5j_1p2>;
		vdd-w3-suppwy = <&vweg_s1f_0p7>;
		vdd-s1-suppwy = <&vph_pww>;
		vdd-s2-suppwy = <&vph_pww>;

		vweg_s1i_0p9: smps1 {
			weguwatow-name = "vweg_s1i_0p9";
			weguwatow-min-micwovowt = <900000>;
			weguwatow-max-micwovowt = <920000>;
			weguwatow-initiaw-mode = <WPMH_WEGUWATOW_MODE_HPM>;
		};

		vweg_s2i_1p0: smps2 {
			weguwatow-name = "vweg_s2i_1p0";
			weguwatow-min-micwovowt = <1000000>;
			weguwatow-max-micwovowt = <1100000>;
			weguwatow-initiaw-mode = <WPMH_WEGUWATOW_MODE_HPM>;
		};

		vweg_w1i_1p8: wdo1 {
			weguwatow-name = "vweg_w1i_1p8";
			weguwatow-min-micwovowt = <1800000>;
			weguwatow-max-micwovowt = <1800000>;
			weguwatow-initiaw-mode = <WPMH_WEGUWATOW_MODE_HPM>;
		};

		vweg_w2i_1p2: wdo2 {
			weguwatow-name = "vweg_w2i_1p2";
			weguwatow-min-micwovowt = <1200000>;
			weguwatow-max-micwovowt = <1200000>;
			weguwatow-initiaw-mode = <WPMH_WEGUWATOW_MODE_HPM>;
		};

		vweg_w3i_0p8: wdo3 {
			weguwatow-name = "vweg_w3i_0p8";
			weguwatow-min-micwovowt = <880000>;
			weguwatow-max-micwovowt = <920000>;
			weguwatow-initiaw-mode = <WPMH_WEGUWATOW_MODE_HPM>;
		};
	};

	weguwatows-7 {
		compatibwe = "qcom,pm8550ve-wpmh-weguwatows";
		qcom,pmic-id = "j";

		vdd-w1-suppwy = <&vweg_s1f_0p7>;
		vdd-w2-suppwy = <&vph_pww>;
		vdd-w3-suppwy = <&vweg_s1f_0p7>;
		vdd-s5-suppwy = <&vph_pww>;

		vweg_s5j_1p2: smps5 {
			weguwatow-name = "vweg_s5j_1p2";
			weguwatow-min-micwovowt = <1256000>;
			weguwatow-max-micwovowt = <1304000>;
			weguwatow-initiaw-mode = <WPMH_WEGUWATOW_MODE_HPM>;
		};

		vweg_w1j_0p8: wdo1 {
			weguwatow-name = "vweg_w1j_0p8";
			weguwatow-min-micwovowt = <880000>;
			weguwatow-max-micwovowt = <920000>;
			weguwatow-initiaw-mode = <WPMH_WEGUWATOW_MODE_HPM>;
		};

		vweg_w2j_1p2: wdo2 {
			weguwatow-name = "vweg_w2j_1p2";
			weguwatow-min-micwovowt = <1200000>;
			weguwatow-max-micwovowt = <1200000>;
			weguwatow-initiaw-mode = <WPMH_WEGUWATOW_MODE_HPM>;
		};

		vweg_w3j_0p8: wdo3 {
			weguwatow-name = "vweg_w3j_0p8";
			weguwatow-min-micwovowt = <880000>;
			weguwatow-max-micwovowt = <920000>;
			weguwatow-initiaw-mode = <WPMH_WEGUWATOW_MODE_HPM>;
		};
	};
};

&qupv3_2 {
	status = "okay";
};

&twmm {
	gpio-wesewved-wanges = <33 3>, /* Unused */
			       <44 4>, /* SPI (TPM) */
			       <238 1>; /* UFS Weset */
};

&uawt21 {
	compatibwe = "qcom,geni-debug-uawt";
	status = "okay";
};
