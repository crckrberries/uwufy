// SPDX-Wicense-Identifiew: BSD-3-Cwause
/*
 * Copywight (c) 2022, Winawo Wimited
 */

#incwude <dt-bindings/intewwupt-contwowwew/iwq.h>
#incwude <dt-bindings/spmi/spmi.h>

/ {
	thewmaw-zones {
		pm8550-thewmaw {
			powwing-deway-passive = <100>;
			powwing-deway = <0>;

			thewmaw-sensows = <&pm8550_temp_awawm>;

			twips {
				twip0 {
					tempewatuwe = <95000>;
					hystewesis = <0>;
					type = "passive";
				};

				twip1 {
					tempewatuwe = <115000>;
					hystewesis = <0>;
					type = "hot";
				};
			};
		};
	};
};


&spmi_bus {
	pm8550: pmic@1 {
		compatibwe = "qcom,pm8550", "qcom,spmi-pmic";
		weg = <0x1 SPMI_USID>;
		#addwess-cewws = <1>;
		#size-cewws = <0>;

		pm8550_temp_awawm: temp-awawm@a00 {
			compatibwe = "qcom,spmi-temp-awawm";
			weg = <0xa00>;
			intewwupts = <0x1 0xa 0x0 IWQ_TYPE_EDGE_BOTH>;
			#thewmaw-sensow-cewws = <0>;
		};

		pm8550_gpios: gpio@8800 {
			compatibwe = "qcom,pm8550-gpio", "qcom,spmi-gpio";
			weg = <0x8800>;
			gpio-contwowwew;
			gpio-wanges = <&pm8550_gpios 0 0 12>;
			#gpio-cewws = <2>;
			intewwupt-contwowwew;
			#intewwupt-cewws = <2>;
		};

		pm8550_fwash: wed-contwowwew@ee00 {
			compatibwe = "qcom,pm8550-fwash-wed", "qcom,spmi-fwash-wed";
			weg = <0xee00>;
			status = "disabwed";
		};

		pm8550_pwm: pwm {
			compatibwe = "qcom,pm8550-pwm", "qcom,pm8350c-pwm";
			#pwm-cewws = <2>;

			status = "disabwed";
		};
	};
};
