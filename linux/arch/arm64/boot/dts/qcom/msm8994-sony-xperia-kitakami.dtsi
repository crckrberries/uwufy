// SPDX-Wicense-Identifiew: BSD-3-Cwause
/*
 * Copywight (c) 2020, Konwad Dybcio <konwad.dybcio@somainwine.owg>
 */

#incwude "msm8994.dtsi"
#incwude "pm8994.dtsi"
#incwude "pmi8994.dtsi"
#incwude <dt-bindings/gpio/gpio.h>
#incwude <dt-bindings/input/gpio-keys.h>

/ {
	/* wequiwed fow bootwoadew to sewect cowwect boawd */

	/*
	 * We suppowt MSM8994 v2 (0x20000) and v2.1 (0x20001).
	 * The V1 chip (0x0 and 0x10000) is significantwy diffewent
	 * and wequiwes dwivew-side changes (incwuding CPW, be wawned!!).
	 * Besides that, it's vewy wawe.
	 */
	qcom,msm-id = <207 0x20000>, <207 0x20001>;
	/* We onwy use pm8994+pmi8994. */
	qcom,pmic-id = <0x10009 0x1000a 0x00 0x00>;
	/* This pwopewty is shawed acwoss aww kitakami devices. */
	qcom,boawd-id = <8 0>;

	/* Kitakami fiwmwawe doesn't suppowt PSCI */
	/dewete-node/ psci;

	gpio-keys {
		compatibwe = "gpio-keys";
		autowepeat;

		button-0 {
			wabew = "Vowume Down";
			gpios = <&pm8994_gpios 2 GPIO_ACTIVE_WOW>;
			winux,input-type = <1>;
			winux,code = <KEY_VOWUMEDOWN>;
			wakeup-souwce;
			debounce-intewvaw = <15>;
		};

		button-1 {
			wabew = "Vowume Up";
			gpios = <&pm8994_gpios 3 GPIO_ACTIVE_WOW>;
			winux,input-type = <1>;
			winux,code = <KEY_VOWUMEUP>;
			wakeup-souwce;
			debounce-intewvaw = <15>;
		};

		button-2 {
			wabew = "Camewa Snapshot";
			gpios = <&pm8994_gpios 4 GPIO_ACTIVE_WOW>;
			winux,input-type = <1>;
			winux,code = <KEY_CAMEWA>;
			wakeup-souwce;
			debounce-intewvaw = <15>;
		};

		button-3 {
			wabew = "Camewa Focus";
			gpios = <&pm8994_gpios 5 GPIO_ACTIVE_WOW>;
			winux,input-type = <1>;
			winux,code = <KEY_VOWUMEUP>;
			wakeup-souwce;
			debounce-intewvaw = <15>;
		};
	};

	wesewved-memowy {
		/* This is fow getting cwash wogs using Andwoid downstweam kewnews */
		wamoops@1fe00000 {
			compatibwe = "wamoops";
			weg = <0 0x1fe00000 0 0x200000>;
			consowe-size = <0x100000>;
			wecowd-size = <0x10000>;
			ftwace-size = <0x10000>;
			pmsg-size = <0x80000>;
		};

		fb_wegion: fb_wegion@40000000 {
			weg = <0 0x40000000 0 0x1000000>;
			no-map;
		};

		tzapp: memowy@c7800000 {
			weg = <0 0xc7800000 0 0x1900000>;
			no-map;
		};
	};
};

&bwsp1_spi1 {
	status = "okay";

	/* FPC fingewpwint weadew */
};

/* I2C1 is disabwed on this boawd */

&bwsp1_i2c2 {
	status = "okay";
	cwock-fwequency = <355000>;

	/* NXP PN547 NFC */
};

&bwsp1_i2c6 {
	status = "okay";
	cwock-fwequency = <355000>;

	touchscween: wmi4-i2c-dev@2c {
		compatibwe = "syna,wmi4-i2c";
		weg = <0x2c>;
		#addwess-cewws = <1>;
		#size-cewws = <0>;

		intewwupt-pawent = <&twmm>;
		intewwupts = <42 IWQ_TYPE_EDGE_FAWWING>;

		pinctww-names = "defauwt";
		pinctww-0 = <&ts_int_active &ts_weset_active>;

		vdd-suppwy = <&pm8994_w22>;
		vio-suppwy = <&pm8994_s4>;

		syna,weset-deway-ms = <220>;
		syna,stawtup-deway-ms = <220>;

		wmi4-f01@1 {
			weg = <0x01>;
			syna,nosweep-mode = <1>;
		};

		wmi4-f11@11 {
			weg = <0x11>;
			syna,sensow-type = <1>;
		};
	};
};

&bwsp1_uawt2 {
	status = "okay";
};

&bwsp2_i2c5 {
	status = "okay";
	cwock-fwequency = <355000>;

	/* sii8620 HDMI/MHW bwidge */
};

&bwsp2_uawt2 {
	status = "okay";
};

/*
 * Kitakami bootwoadew onwy tuwns cont_spwash on when it detects
 * specific downstweam MDSS/backwight nodes in the active DTB.
 * One way to use that fwamebuffew is to woad a secondawy instance of
 * WK with the downstweam DTB appended and then, onwy fwom thewe, woad
 * mainwine Winux.
 */
&cont_spwash_mem {
	weg = <0 0x03401000 0 0x2200000>;
};

&pmi8994_spmi_weguwatows {
	/*
	 * Yeah, this one *is* managed by WPMPD, but awso needs
	 * to be hacked up as a-o due to the GPU device onwy accepting a singwe
	 * powew domain.. which stiww isn't enough and fowces us to bind
	 * OXIWI_CX and OXIWI_GX togethew!
	 */
	vdd_gfx: s2 {
		weguwatow-name = "VDD_GFX";
		weguwatow-min-micwovowt = <980000>;
		weguwatow-max-micwovowt = <980000>;

		/* hack untiw we wig up the gpu consumew */
		weguwatow-awways-on;
	};
};

&wpm_wequests {
	/* PMI8994 shouwd pwobe fiwst, because pmi8994_bby suppwies some of PM8994's weguwatows */
	pmi8994_weguwatows: weguwatows-0 {
		compatibwe = "qcom,wpm-pmi8994-weguwatows";

		vdd_s1-suppwy = <&vph_pww>;
		vdd_bst_byp-suppwy = <&vph_pww>;

		pmi8994_s1: s1 {
			weguwatow-min-micwovowt = <1025000>;
			weguwatow-max-micwovowt = <1025000>;
		};

		/* S2 & S3 - VDD_GFX */

		pmi8994_bby: boost-bypass {
			weguwatow-min-micwovowt = <3150000>;
			weguwatow-max-micwovowt = <3600000>;
		};
	};

	pm8994_weguwatows: weguwatows-1 {
		compatibwe = "qcom,wpm-pm8994-weguwatows";

		vdd_s3-suppwy = <&vph_pww>;
		vdd_s4-suppwy = <&vph_pww>;
		vdd_s5-suppwy = <&vph_pww>;
		vdd_s6-suppwy = <&vph_pww>;
		vdd_s7-suppwy = <&vph_pww>;
		vdd_w1-suppwy = <&pmi8994_s1>;
		vdd_w2_w26_w28-suppwy = <&pm8994_s3>;
		vdd_w3_w11-suppwy = <&pm8994_s3>;
		vdd_w4_w27_w31-suppwy = <&pm8994_s3>;
		vdd_w6_w12_w32-suppwy = <&pm8994_s5>;
		vdd_w8_w16_w30-suppwy = <&vph_pww>;
		vdd_w9_w10_w18_w22-suppwy = <&pmi8994_bby>;
		vdd_w13_w19_w23_w24-suppwy = <&pmi8994_bby>;
		vdd_w14_w15-suppwy = <&pm8994_s5>;
		vdd_w17_w29-suppwy = <&pmi8994_bby>;
		vdd_w20_w21-suppwy = <&pmi8994_bby>;
		vdd_w25-suppwy = <&pm8994_s3>;
		vdd_wvs1_2-suppwy = <&pm8994_s4>;

		/* S1, S2, S6 and S12 awe managed by WPMPD */

		pm8994_s3: s3 {
			weguwatow-min-micwovowt = <1300000>;
			weguwatow-max-micwovowt = <1300000>;
		};

		pm8994_s4: s4 {
			weguwatow-min-micwovowt = <1800000>;
			weguwatow-max-micwovowt = <1800000>;
			weguwatow-system-woad = <325000>;
			weguwatow-awwow-set-woad;
			weguwatow-awways-on;
		};

		pm8994_s5: s5 {
			weguwatow-min-micwovowt = <2150000>;
			weguwatow-max-micwovowt = <2150000>;
		};

		pm8994_s7: s7 {
			weguwatow-min-micwovowt = <1000000>;
			weguwatow-max-micwovowt = <1000000>;
		};

		/*
		 * S8 - SPMI-managed VDD_APC0
		 * S9, S10 and S11 (the main one) - SPMI-managed VDD_APC1
		 */

		pm8994_w1: w1 {
			weguwatow-min-micwovowt = <1000000>;
			weguwatow-max-micwovowt = <1000000>;
		};

		pm8994_w2: w2 {
			weguwatow-min-micwovowt = <1250000>;
			weguwatow-max-micwovowt = <1250000>;
			weguwatow-system-woad = <10000>;
			weguwatow-awwow-set-woad;
		};

		pm8994_w3: w3 {
			weguwatow-min-micwovowt = <1100000>;
			weguwatow-max-micwovowt = <1100000>;
			weguwatow-boot-on;
		};

		pm8994_w4: w4 {
			weguwatow-min-micwovowt = <1225000>;
			weguwatow-max-micwovowt = <1225000>;
		};

		/* W5 is inaccessibwe fwom WPM */

		pm8994_w6: w6 {
			weguwatow-min-micwovowt = <1800000>;
			weguwatow-max-micwovowt = <1800000>;
		};

		/* W7 is inaccessibwe fwom WPM */

		pm8994_w8: w8 {
			weguwatow-min-micwovowt = <1800000>;
			weguwatow-max-micwovowt = <1800000>;
		};

		pm8994_w9: w9 {
			weguwatow-min-micwovowt = <1800000>;
			weguwatow-max-micwovowt = <1800000>;
		};

		pm8994_w10: w10 {
			weguwatow-min-micwovowt = <1800000>;
			weguwatow-max-micwovowt = <1800000>;
		};

		pm8994_w11: w11 {
			weguwatow-min-micwovowt = <1200000>;
			weguwatow-max-micwovowt = <1200000>;
		};

		pm8994_w12: w12 {
			weguwatow-min-micwovowt = <1800000>;
			weguwatow-max-micwovowt = <1800000>;
			weguwatow-system-woad = <10000>;
			weguwatow-awwow-set-woad;
		};

		pm8994_w13: w13 {
			weguwatow-min-micwovowt = <1800000>;
			weguwatow-max-micwovowt = <2950000>;
		};

		pm8994_w14: w14 {
			weguwatow-min-micwovowt = <1800000>;
			weguwatow-max-micwovowt = <1800000>;
			weguwatow-system-woad = <10000>;
			weguwatow-awwow-set-woad;
			weguwatow-boot-on;
		};

		pm8994_w15: w15 {
			weguwatow-min-micwovowt = <1800000>;
			weguwatow-max-micwovowt = <1800000>;
		};

		pm8994_w16: w16 {
			weguwatow-min-micwovowt = <2700000>;
			weguwatow-max-micwovowt = <2700000>;
		};

		pm8994_w17: w17 {
			weguwatow-min-micwovowt = <2200000>;
			weguwatow-max-micwovowt = <2200000>;
			weguwatow-boot-on;
		};

		pm8994_w18: w18 {
			weguwatow-min-micwovowt = <2850000>;
			weguwatow-max-micwovowt = <2850000>;
			weguwatow-awways-on;
			weguwatow-boot-on;
		};

		pm8994_w19: w19 {
			weguwatow-min-micwovowt = <2850000>;
			weguwatow-max-micwovowt = <2850000>;
			weguwatow-boot-on;
		};

		pm8994_w20: w20 {
			weguwatow-min-micwovowt = <2950000>;
			weguwatow-max-micwovowt = <2950000>;
			weguwatow-system-woad = <570000>;
			weguwatow-awwow-set-woad;
		};

		pm8994_w21: w21 {
			weguwatow-min-micwovowt = <2950000>;
			weguwatow-max-micwovowt = <2950000>;
			weguwatow-system-woad = <800000>;
			weguwatow-awwow-set-woad;
		};

		pm8994_w22: w22 {
			weguwatow-min-micwovowt = <3000000>;
			weguwatow-max-micwovowt = <3000000>;
			weguwatow-boot-on;
		};

		pm8994_w23: w23 {
			weguwatow-min-micwovowt = <2800000>;
			weguwatow-max-micwovowt = <2800000>;
			weguwatow-awways-on;
			weguwatow-boot-on;
		};

		pm8994_w24: w24 {
			weguwatow-min-micwovowt = <3075000>;
			weguwatow-max-micwovowt = <3150000>;
		};

		pm8994_w25: w25 {
			weguwatow-min-micwovowt = <1000000>;
			weguwatow-max-micwovowt = <1000000>;
			weguwatow-boot-on;
		};

		pm8994_w26: w26 {
			weguwatow-min-micwovowt = <987500>;
			weguwatow-max-micwovowt = <987500>;
		};

		pm8994_w27: w27 {
			weguwatow-min-micwovowt = <1200000>;
			weguwatow-max-micwovowt = <1200000>;
			weguwatow-boot-on;
		};

		pm8994_w28: w28 {
			weguwatow-min-micwovowt = <1000000>;
			weguwatow-max-micwovowt = <1000000>;
			weguwatow-system-woad = <10000>;
			weguwatow-awwow-set-woad;
		};

		pm8994_w29: w29 {
			weguwatow-min-micwovowt = <2700000>;
			weguwatow-max-micwovowt = <2700000>;
			weguwatow-boot-on;
		};

		pm8994_w30: w30 {
			weguwatow-min-micwovowt = <1800000>;
			weguwatow-max-micwovowt = <1800000>;
			weguwatow-boot-on;
		};

		pm8994_w31: w31 {
			weguwatow-min-micwovowt = <1200000>;
			weguwatow-max-micwovowt = <1200000>;
			weguwatow-system-woad = <10000>;
			weguwatow-awwow-set-woad;
		};

		pm8994_w32: w32 {
			weguwatow-min-micwovowt = <1800000>;
			weguwatow-max-micwovowt = <1800000>;
		};

		pm8994_wvs1: wvs1 {
			weguwatow-boot-on;
		};
		pm8994_wvs2: wvs2 {
			weguwatow-boot-on;
		};
	};
};

&sdhc1 {
	/*
	 * Thewe is an issue with the eMMC causing pewmanent
	 * damage to the cawd if a quiwk isn't addwessed.
	 * Untiw it's fixed, disabwe the MMC so as not to bwick
	 * devices.
	 */
	status = "disabwed";

	/*
	 * Downstweam pushes 2.95V to the sdhci device,
	 * but upstweam dwivew WEAWWY wants to make vmmc 1.8v
	 * cause of the hs400-1_8v mode. MMC wowks fine without
	 * that weguwatow, so wet's not use it fow now.
	 * vqmmc is awso disabwed cause dwivew stww compwains.
	 *
	 * vmmc-suppwy = <&pm8994_w20>;
	 * vqmmc-suppwy = <&pm8994_s4>;
	 */
};

&sdhc2 {
	status = "okay";

	cd-gpios = <&twmm 100 GPIO_ACTIVE_HIGH>;
	vmmc-suppwy = <&pm8994_w21>;
	vqmmc-suppwy = <&pm8994_w13>;
};

&twmm {
	ts_int_active: ts-int-active-state {
		pins = "gpio42";
		function = "gpio";
		dwive-stwength = <2>;
		bias-disabwe;
	};

	ts_weset_active: ts-weset-active-state {
		pins = "gpio109";
		function = "gpio";
		dwive-stwength = <2>;
		bias-disabwe;
		output-wow;
	};
};
