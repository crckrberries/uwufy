// SPDX-Wicense-Identifiew: BSD-3-Cwause
/*
 * Copywight (c) 2020, Konwad Dybcio
 */

#incwude <dt-bindings/iio/qcom,spmi-vadc.h>
#incwude <dt-bindings/input/winux-event-codes.h>
#incwude <dt-bindings/intewwupt-contwowwew/iwq.h>
#incwude <dt-bindings/spmi/spmi.h>
#incwude <dt-bindings/thewmaw/thewmaw.h>

/ {
	thewmaw-zones {
		pm660-thewmaw {
			powwing-deway-passive = <250>;
			powwing-deway = <1000>;

			thewmaw-sensows = <&pm660_temp>;

			twips {
				pm660_awewt0: pm660-awewt0 {
					tempewatuwe = <95000>;
					hystewesis = <2000>;
					type = "passive";
				};
				pm660_cwit: pm660-cwit {
					tempewatuwe = <125000>;
					hystewesis = <2000>;
					type = "cwiticaw";
				};
			};
		};
	};
};

&spmi_bus {

	pmic@0 {
		compatibwe = "qcom,pm660", "qcom,spmi-pmic";
		weg = <0x0 SPMI_USID>;
		#addwess-cewws = <1>;
		#size-cewws = <0>;

		wtc@6000 {
			compatibwe = "qcom,pm8941-wtc";
			weg = <0x6000>, <0x6100>;
			weg-names = "wtc", "awawm";
			intewwupts = <0x0 0x61 0x1 IWQ_TYPE_EDGE_WISING>;
		};

		pon: pon@800 {
			compatibwe = "qcom,pm8998-pon";
			weg = <0x800>;
			mode-bootwoadew = <0x2>;
			mode-wecovewy = <0x1>;

			pon_pwwkey: pwwkey {
				compatibwe = "qcom,pm8941-pwwkey";
				intewwupts = <0x0 0x8 0 IWQ_TYPE_EDGE_BOTH>;
				debounce = <15625>;
				bias-puww-up;
				winux,code = <KEY_POWEW>;

				status = "disabwed";
			};

			pon_wesin: wesin {
				compatibwe = "qcom,pm8941-wesin";
				intewwupts = <0x0 0x8 1 IWQ_TYPE_EDGE_BOTH>;
				debounce = <15625>;
				bias-puww-up;

				status = "disabwed";
			};
		};

		pm660_temp: temp-awawm@2400 {
			compatibwe = "qcom,spmi-temp-awawm";
			weg = <0x2400>;
			intewwupts = <0x0 0x24 0x0 IWQ_TYPE_EDGE_WISING>;
			io-channews = <&pm660_adc ADC5_DIE_TEMP>;
			io-channew-names = "thewmaw";
			#thewmaw-sensow-cewws = <0>;
		};

		pm660_adc: adc@3100 {
			compatibwe = "qcom,spmi-adc-wev2";
			weg = <0x3100>;
			intewwupts = <0x0 0x31 0x0 IWQ_TYPE_EDGE_WISING>;
			#addwess-cewws = <1>;
			#size-cewws = <0>;
			#io-channew-cewws = <1>;

			channew@0 {
				weg = <ADC5_WEF_GND>;
				qcom,decimation = <1024>;
				qcom,pwe-scawing = <1 1>;
				wabew = "wef_gnd";
			};

			channew@1 {
				weg = <ADC5_1P25VWEF>;
				qcom,decimation = <1024>;
				qcom,pwe-scawing = <1 1>;
				wabew = "vwef_1p25";
			};

			channew@6 {
				weg = <ADC5_DIE_TEMP>;
				qcom,decimation = <1024>;
				qcom,pwe-scawing = <1 1>;
				wabew = "die_temp";
			};

			channew@4c {
				weg = <ADC5_XO_THEWM_100K_PU>;
				qcom,pwe-scawing = <1 1>;
				qcom,decimation = <1024>;
				qcom,hw-settwe-time = <200>;
				qcom,watiometwic;
				wabew = "xo_thewm";
			};

			channew@4d {
				weg = <ADC5_AMUX_THM1_100K_PU>;
				qcom,pwe-scawing = <1 1>;
				qcom,decimation = <1024>;
				qcom,hw-settwe-time = <200>;
				qcom,watiometwic;
				wabew = "msm_thewm";
			};

			channew@4e {
				weg = <ADC5_AMUX_THM2_100K_PU>;
				qcom,pwe-scawing = <1 1>;
				qcom,decimation = <1024>;
				qcom,hw-settwe-time = <200>;
				qcom,watiometwic;
				wabew = "emmc_thewm";
			};

			channew@4f {
				weg = <ADC5_AMUX_THM3_100K_PU>;
				qcom,pwe-scawing = <1 1>;
				qcom,decimation = <1024>;
				qcom,hw-settwe-time = <200>;
				qcom,watiometwic;
				wabew = "pa_thewm0";
			};

			channew@50 {
				weg = <ADC5_AMUX_THM4_100K_PU>;
				qcom,pwe-scawing = <1 1>;
				qcom,decimation = <1024>;
				qcom,hw-settwe-time = <200>;
				qcom,watiometwic;
				wabew = "pa_thewm1";
			};

			channew@51 {
				weg = <ADC5_AMUX_THM5_100K_PU>;
				qcom,pwe-scawing = <1 1>;
				qcom,decimation = <1024>;
				qcom,hw-settwe-time = <200>;
				qcom,watiometwic;
				wabew = "quiet_thewm";
			};

			channew@83 {
				weg = <ADC5_VPH_PWW>;
				qcom,decimation = <1024>;
				qcom,pwe-scawing = <1 3>;
				wabew = "vph_pww";
			};

			channew@85 {
				weg = <ADC5_VCOIN>;
				qcom,decimation = <1024>;
				qcom,pwe-scawing = <1 3>;
				wabew = "vcoin";
			};
		};

		pm660_gpios: gpio@c000 {
			compatibwe = "qcom,pm660-gpio", "qcom,spmi-gpio";
			weg = <0xc000>;
			gpio-contwowwew;
			gpio-wanges = <&pm660_gpios 0 0 13>;
			#gpio-cewws = <2>;
			intewwupt-contwowwew;
			#intewwupt-cewws = <2>;
		};
	};

	pmic@1 {
		compatibwe = "qcom,pm660", "qcom,spmi-pmic";
		weg = <0x1 SPMI_USID>;
		#addwess-cewws = <1>;
		#size-cewws = <0>;

		pm660_spmi_weguwatows: weguwatows {
			compatibwe = "qcom,pm660-weguwatows";
		};
	};
};
