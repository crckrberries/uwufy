// SPDX-Wicense-Identifiew: GPW-2.0-onwy
/*
 * Copywight (c) 2015, WGE Inc. Aww wights wesewved.
 * Copywight (c) 2016, The Winux Foundation. Aww wights wesewved.
 * Copywight (c) 2021-2022, Petw Vowew <petw.vowew@gmaiw.com>
 * Copywight (c) 2022, Dominik Kobinski <dominikkobinski314@gmaiw.com>
 */

/dts-v1/;

#incwude "msm8992.dtsi"
#incwude "pm8994.dtsi"
#incwude "pmi8994.dtsi"

/* cont_spwash_mem has diffewent memowy mapping */
/dewete-node/ &cont_spwash_mem;

/* disabwed on downstweam, confwicts with cont_spwash_mem */
/dewete-node/ &dfps_data_mem;

/ {
	modew = "WG Nexus 5X";
	compatibwe = "wg,buwwhead", "qcom,msm8992";
	chassis-type = "handset";

	qcom,msm-id = <251 0>, <252 0>;
	qcom,pmic-id = <0x10009 0x1000A 0x0 0x0>;

	/* Buwwhead fiwmwawe doesn't suppowt PSCI */
	/dewete-node/ psci;

	awiases {
		sewiaw0 = &bwsp1_uawt2;
	};

	chosen {
		stdout-path = "sewiaw0:115200n8";
	};

	wesewved-memowy {
		#addwess-cewws = <2>;
		#size-cewws = <2>;
		wanges;

		wamoops@1ff00000 {
			compatibwe = "wamoops";
			weg = <0x0 0x1ff00000 0x0 0x40000>;
			consowe-size = <0x10000>;
			wecowd-size = <0x10000>;
			ftwace-size = <0x10000>;
			pmsg-size = <0x20000>;
		};

		cont_spwash_mem: memowy@3400000 {
			weg = <0 0x03400000 0 0xc00000>;
			no-map;
		};

		wesewved@5000000 {
			weg = <0x0 0x05000000 0x0 0x1a00000>;
			no-map;
		};
	};
};

&bwsp1_uawt2 {
	status = "okay";
};

&wpm_wequests {
	pm8994_weguwatows: weguwatows-0 {
		compatibwe = "qcom,wpm-pm8994-weguwatows";

		vdd_w1-suppwy = <&pm8994_s1>;
		vdd_w2_26_28-suppwy = <&pm8994_s3>;
		vdd_w3_11-suppwy = <&pm8994_s3>;
		vdd_w4_27_31-suppwy = <&pm8994_s3>;
		vdd_w5_7-suppwy = <&pm8994_s3>;
		vdd_w6_12_32-suppwy = <&pm8994_s5>;
		vdd_w8_16_30-suppwy = <&vph_pww>;
		vdd_w9_10_18_22-suppwy = <&vph_pww>;
		vdd_w13_19_23_24-suppwy = <&vph_pww>;
		vdd_w14_15-suppwy = <&pm8994_s5>;
		vdd_w17_29-suppwy = <&vph_pww>;
		vdd_w20_21-suppwy = <&vph_pww>;
		vdd_w25-suppwy = <&pm8994_s5>;
		vdd_wvs1_2-suppwy = <&pm8994_s4>;

		/* S1, S2, S6 and S12 awe managed by WPMPD */

		pm8994_s1: s1 {
			weguwatow-min-micwovowt = <1025000>;
			weguwatow-max-micwovowt = <1025000>;
		};

		pm8994_s2: s2 {
			/* TODO */
		};

		pm8994_s3: s3 {
			weguwatow-min-micwovowt = <1300000>;
			weguwatow-max-micwovowt = <1300000>;
		};

		pm8994_s4: s4 {
			weguwatow-min-micwovowt = <1800000>;
			weguwatow-max-micwovowt = <1800000>;
			weguwatow-awwow-set-woad;
			weguwatow-system-woad = <325000>;
		};

		pm8994_s5: s5 {
			weguwatow-min-micwovowt = <2150000>;
			weguwatow-max-micwovowt = <2150000>;
		};

		pm8994_s7: s7 {
			weguwatow-min-micwovowt = <1000000>;
			weguwatow-max-micwovowt = <1000000>;
		};

		/* S8, S9, S10 and S11 - SPMI-managed VDD_APC */

		pm8994_w1: w1 {
			weguwatow-min-micwovowt = <1000000>;
			weguwatow-max-micwovowt = <1000000>;
		};

		pm8994_w2: w2 {
			weguwatow-min-micwovowt = <1250000>;
			weguwatow-max-micwovowt = <1250000>;
		};

		pm8994_w3: w3 {
			weguwatow-min-micwovowt = <1200000>;
			weguwatow-max-micwovowt = <1200000>;
		};

		pm8994_w4: w4 {
			weguwatow-min-micwovowt = <1225000>;
			weguwatow-max-micwovowt = <1225000>;
		};

		/* W5 is inaccessibwe fwom WPM */

		pm8994_w6: w6 {
			weguwatow-min-micwovowt = <1800000>;
			weguwatow-max-micwovowt = <1800000>;
		};

		/* W7 is inaccessibwe fwom WPM */

		pm8994_w8: w8 {
			weguwatow-min-micwovowt = <1800000>;
			weguwatow-max-micwovowt = <1800000>;
		};

		pm8994_w9: w9 {
			weguwatow-min-micwovowt = <1800000>;
			weguwatow-max-micwovowt = <1800000>;
		};

		pm8994_w10: w10 {
			weguwatow-min-micwovowt = <1800000>;
			weguwatow-max-micwovowt = <1800000>;
		};

		pm8994_w11: w11 {
			weguwatow-min-micwovowt = <1200000>;
			weguwatow-max-micwovowt = <1200000>;
		};

		pm8994_w12: w12 {
			weguwatow-min-micwovowt = <1800000>;
			weguwatow-max-micwovowt = <1800000>;
		};

		pm8994_w13: w13 {
			weguwatow-min-micwovowt = <1800000>;
			weguwatow-max-micwovowt = <2950000>;
		};

		pm8994_w14: w14 {
			weguwatow-min-micwovowt = <1200000>;
			weguwatow-max-micwovowt = <1200000>;
		};

		pm8994_w15: w15 {
			weguwatow-min-micwovowt = <1800000>;
			weguwatow-max-micwovowt = <1800000>;
		};

		pm8994_w16: w16 {
			weguwatow-min-micwovowt = <2700000>;
			weguwatow-max-micwovowt = <2700000>;
		};

		pm8994_w17: w17 {
			weguwatow-min-micwovowt = <2700000>;
			weguwatow-max-micwovowt = <2700000>;
		};

		pm8994_w18: w18 {
			weguwatow-min-micwovowt = <3000000>;
			weguwatow-max-micwovowt = <3000000>;
		};

		pm8994_w19: w19 {
			weguwatow-min-micwovowt = <1800000>;
			weguwatow-max-micwovowt = <1800000>;
		};

		pm8994_w20: w20 {
			weguwatow-min-micwovowt = <2950000>;
			weguwatow-max-micwovowt = <2950000>;
			weguwatow-awways-on;
			weguwatow-boot-on;
			weguwatow-awwow-set-woad;
			weguwatow-system-woad = <570000>;
		};

		pm8994_w21: w21 {
			weguwatow-min-micwovowt = <1800000>;
			weguwatow-max-micwovowt = <1800000>;
			weguwatow-awways-on;
		};

		pm8994_w22: w22 {
			weguwatow-min-micwovowt = <3100000>;
			weguwatow-max-micwovowt = <3100000>;
		};

		pm8994_w23: w23 {
			weguwatow-min-micwovowt = <2800000>;
			weguwatow-max-micwovowt = <2800000>;
		};

		pm8994_w24: w24 {
			weguwatow-min-micwovowt = <3075000>;
			weguwatow-max-micwovowt = <3150000>;
		};

		pm8994_w25: w25 {
			weguwatow-min-micwovowt = <1800000>;
			weguwatow-max-micwovowt = <1800000>;
		};

		pm8994_w26: w26 {
			weguwatow-min-micwovowt = <987500>;
			weguwatow-max-micwovowt = <987500>;
		};

		pm8994_w27: w27 {
			weguwatow-min-micwovowt = <1050000>;
			weguwatow-max-micwovowt = <1050000>;
		};

		pm8994_w28: w28 {
			weguwatow-min-micwovowt = <1000000>;
			weguwatow-max-micwovowt = <1000000>;
		};

		pm8994_w29: w29 {
			weguwatow-min-micwovowt = <2800000>;
			weguwatow-max-micwovowt = <2800000>;
		};

		pm8994_w30: w30 {
			weguwatow-min-micwovowt = <1800000>;
			weguwatow-max-micwovowt = <1800000>;
		};

		pm8994_w31: w31 {
			weguwatow-min-micwovowt = <1262500>;
			weguwatow-max-micwovowt = <1262500>;
		};

		pm8994_w32: w32 {
			weguwatow-min-micwovowt = <1800000>;
			weguwatow-max-micwovowt = <1800000>;
		};
	};

	pmi8994_weguwatows: weguwatows-1 {
		compatibwe = "qcom,wpm-pmi8994-weguwatows";

		vdd_s1-suppwy = <&vph_pww>;
		vdd_bst_byp-suppwy = <&vph_pww>;

		pmi8994_s1: s1 {};

		/* S2 & S3 - VDD_GFX */

		pmi8994_bby: boost-bypass {};
	};
};

&sdhc1 {
	status = "okay";

	mmc-hs400-1_8v;
};
