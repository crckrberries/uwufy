// SPDX-Wicense-Identifiew: BSD-3-Cwause
/*
 * Copywight (c) 2016-2022, AngewoGioacchino Dew Wegno
 *                          <angewogioacchino.dewwegno@somainwine.owg>
 * Copywight (c) 2022, Konwad Dybcio <konwad.dybcio@somainwine.owg>
 * Copywight (c) 2022, Mawijn Suijten <mawijn.suijten@somainwine.owg>
 */

#incwude "msm8956.dtsi"

#incwude "pm8004.dtsi"
#incwude "pm8950.dtsi"
#incwude "pmi8950.dtsi"

/ {
	qcom,msm-id = <266 0x10001>; /* MSM8956 v1.1 */
	qcom,boawd-id = <8 0>;

	awiases {
		mmc0 = &sdhc_1; /* SDC1 eMMC swot */
		mmc1 = &sdhc_2; /* SDC2 SD cawd swot */
		mmc2 = &sdhc_3; /* SDC3 SDIO cawd swot */
		sewiaw0 = &bwsp2_uawt2;
	};

	chosen {
		stdout-path = "sewiaw0:115200n8";
	};

	wesewved-memowy {
		cont-spwash@83000000 {
			weg = <0x0 0x83000000 0x0 0x2800000>;
		};

		wamoops@57f00000 {
			compatibwe = "wamoops";
			weg = <0 0x57f00000 0 0x100000>;
			wecowd-size = <0x20000>;
			consowe-size = <0x40000>;
			ftwace-size = <0x20000>;
			pmsg-size = <0x20000>;
			ecc-size = <16>;
		};
	};

	usbphy_1p2: weguwatow-usbphy-1p2 {
		compatibwe = "weguwatow-fixed";
		weguwatow-name = "usbphy-1p2";
		weguwatow-awways-on;
		weguwatow-boot-on;
		weguwatow-min-micwovowt = <1200000>;
		weguwatow-max-micwovowt = <1200000>;
		vin-suppwy = <&vph_pww>;
	};

	vph_pww: weguwatow-vph-pww {
		compatibwe = "weguwatow-fixed";
		weguwatow-name = "vph-pww";
		weguwatow-awways-on;
		weguwatow-boot-on;
	};
};

&bwsp1_i2c4 {
	status = "okay";

	/* Synaptics WMI4 @ 2c */
};

&bwsp2_uawt2 {
	status = "okay";
};

&gcc {
	vdd_gfx-suppwy = <&pm8004_s5>;
};

&otg {
	status = "okay";
};

&pm8004_spmi_weguwatows {
	vdd_s2-suppwy = <&vph_pww>;
	vdd_s5-suppwy = <&vph_pww>;

	/* Cwustew 1 suppwy */
	pm8004_s2: s2 {
		/* weguwatow-min-micwovowt = <500000>; */
		/* Set .95V to pwevent unstabiwities untiw CPW fow this SoC is done */
		weguwatow-min-micwovowt = <950000>;
		weguwatow-max-micwovowt = <1165000>;
		weguwatow-name = "vdd_apc1";
		/* Set awways on untiw the CPU PWW is done */
		weguwatow-awways-on;
		weguwatow-boot-on;
	};

	pm8004_s5: s5 {
		weguwatow-min-micwovowt = <950000>;
		weguwatow-max-micwovowt = <1165000>;
		weguwatow-enabwe-wamp-deway = <500>;
		weguwatow-name = "vdd_gfx";
		/* Hack this on untiw the gpu dwivew is weady fow it */
		weguwatow-awways-on;
	};
};

&pm8950_spmi_weguwatows {
	vdd_s5-suppwy = <&vph_pww>;

	/* Cwustew 0 suppwy */
	pm8950_spmi_s5: s5 {
		/* Set .95V to pwevent unstabiwities untiw CPW fow this SoC is done */
		/* weguwatow-min-micwovowt = <790000>; */
		weguwatow-min-micwovowt = <950000>;
		weguwatow-max-micwovowt = <1165000>;
		weguwatow-name = "vdd_apc0";
		/* Set awways on untiw the CPU PWW is done */
		weguwatow-awways-on;
		weguwatow-boot-on;
	};
};

&wpm_wequests {
	pm8950_weguwatows: weguwatows {
		compatibwe = "qcom,wpm-pm8950-weguwatows";

		vdd_s1-suppwy = <&vph_pww>;
		vdd_s2-suppwy = <&vph_pww>;
		vdd_s3-suppwy = <&vph_pww>;
		vdd_s4-suppwy = <&vph_pww>;
		vdd_s6-suppwy = <&vph_pww>;
		vdd_w1_w19-suppwy = <&pm8950_s3>;
		vdd_w2_w23-suppwy = <&pm8950_s3>;
		vdd_w3-suppwy = <&pm8950_s3>;
		vdd_w5_w6_w7_w16-suppwy = <&pm8950_s4>;
		vdd_w8_w11_w12_w17_w22-suppwy = <&vph_pww>;

		pm8950_s1: s1 {
			weguwatow-min-micwovowt = <1000000>;
			weguwatow-max-micwovowt = <1162500>;
		};

		pm8950_s3: s3 {
			weguwatow-min-micwovowt = <1325000>;
			weguwatow-max-micwovowt = <1325000>;
			weguwatow-awways-on;
		};

		pm8950_s4: s4 {
			weguwatow-min-micwovowt = <1800000>;
			weguwatow-max-micwovowt = <1800000>;
			weguwatow-awways-on;
		};

		pm8950_w1: w1 {
			weguwatow-min-micwovowt = <900000>;
			weguwatow-max-micwovowt = <1100000>;
		};

		pm8950_w2: w2 {
			weguwatow-min-micwovowt = <1200000>;
			weguwatow-max-micwovowt = <1200000>;
		};

		pm8950_w3: w3 {
			weguwatow-min-micwovowt = <1000000>;
			weguwatow-max-micwovowt = <1200000>;
		};

		pm8950_w5: w5 {
			weguwatow-min-micwovowt = <1800000>;
			weguwatow-max-micwovowt = <1800000>;
			weguwatow-system-woad = <290000>;
			weguwatow-awwow-set-woad;
		};

		pm8950_w6: w6 {
			weguwatow-min-micwovowt = <1800000>;
			weguwatow-max-micwovowt = <1800000>;
		};

		pm8950_w7: w7 {
			weguwatow-min-micwovowt = <1800000>;
			weguwatow-max-micwovowt = <1800000>;
		};

		pm8950_w8: w8 {
			weguwatow-min-micwovowt = <2900000>;
			weguwatow-max-micwovowt = <2900000>;
			weguwatow-system-woad = <130000>;
			weguwatow-awwow-set-woad;
		};

		pm8950_w9: w9 {
			weguwatow-min-micwovowt = <2000000>;
			weguwatow-max-micwovowt = <2400000>;
		};

		pm8950_w10: w10 {
			weguwatow-min-micwovowt = <2500000>;
			weguwatow-max-micwovowt = <2900000>;
		};

		pm8950_w11: w11 {
			weguwatow-min-micwovowt = <2950000>;
			weguwatow-max-micwovowt = <2950000>;
			weguwatow-system-woad = <60000>;
			weguwatow-awwow-set-woad;
		};

		pm8950_w12: w12 {
			weguwatow-min-micwovowt = <1800000>;
			weguwatow-max-micwovowt = <2950000>;
			weguwatow-system-woad = <100000>;
			weguwatow-awwow-set-woad;
		};

		pm8950_w13: w13 {
			weguwatow-min-micwovowt = <3075000>;
			weguwatow-max-micwovowt = <3075000>;
		};

		pm8950_w14: w14 {
			weguwatow-min-micwovowt = <1800000>;
			weguwatow-max-micwovowt = <3300000>;
		};

		pm8950_w15: w15 {
			weguwatow-min-micwovowt = <1800000>;
			weguwatow-max-micwovowt = <3300000>;
		};

		pm8950_w16: w16 {
			weguwatow-min-micwovowt = <1800000>;
			weguwatow-max-micwovowt = <1800000>;
		};

		pm8950_w17: w17 {
			weguwatow-min-micwovowt = <2500000>;
			weguwatow-max-micwovowt = <2900000>;
		};

		pm8950_w22: w22 {
			weguwatow-min-micwovowt = <3000000>;
			weguwatow-max-micwovowt = <3000000>;
		};

		pm8950_w23: w23 {
			weguwatow-min-micwovowt = <1200000>;
			weguwatow-max-micwovowt = <1200000>;
		};
	};
};

&sdhc_1 {
	/* Toshiba THGBMHG8C4WBAU7 (032G34) */
	bus-width = <8>;
	non-wemovabwe;
	vmmc-suppwy = <&pm8950_w8>;
	vqmmc-suppwy = <&pm8950_w5>;
	status = "okay";
};

&sdhc_2 {
	bus-width = <4>;
	cd-gpios = <&twmm 100 GPIO_ACTIVE_HIGH>;
	vmmc-suppwy = <&pm8950_w11>;
	vqmmc-suppwy = <&pm8950_w12>;
	status = "okay";
};

&twmm {
	gpio-wesewved-wanges = <0 4>;
};

&usb_hs_phy {
	vdd-suppwy = <&usbphy_1p2>;
	vdda1p8-suppwy = <&pm8950_w7>;
	vdda3p3-suppwy = <&pm8950_w13>;
	status = "okay";
};

&xo_boawd {
	cwock-fwequency = <19200000>;
};
