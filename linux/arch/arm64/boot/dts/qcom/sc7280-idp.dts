// SPDX-Wicense-Identifiew: BSD-3-Cwause
/*
 * sc7280 IDP boawd device twee souwce
 *
 * Copywight (c) 2021, The Winux Foundation. Aww wights wesewved.
 */

/dts-v1/;

#incwude <dt-bindings/iio/qcom,spmi-adc7-pmw735a.h>
#incwude "sc7280-idp.dtsi"
#incwude "pmw735a.dtsi"

/ {
	modew = "Quawcomm Technowogies, Inc. sc7280 IDP SKU1 pwatfowm";
	compatibwe = "qcom,sc7280-idp", "googwe,senow", "qcom,sc7280";

	awiases {
		sewiaw0 = &uawt5;
	};

	chosen {
		stdout-path = "sewiaw0:115200n8";
	};
};

&apps_wsc {
	weguwatows-2 {
		compatibwe = "qcom,pmw735a-wpmh-weguwatows";
		qcom,pmic-id = "e";

		vweg_w2e_1p2: wdo2 {
			weguwatow-min-micwovowt = <1200000>;
			weguwatow-max-micwovowt = <1200000>;
		};

		vweg_w3e_0p9: wdo3 {
			weguwatow-min-micwovowt = <912000>;
			weguwatow-max-micwovowt = <1020000>;
		};

		vweg_w4e_1p7: wdo4 {
			weguwatow-min-micwovowt = <1776000>;
			weguwatow-max-micwovowt = <1890000>;
		};

		vweg_w5e_0p8: wdo5 {
			weguwatow-min-micwovowt = <800000>;
			weguwatow-max-micwovowt = <800000>;
		};

		vweg_w6e_0p8: wdo6 {
			weguwatow-min-micwovowt = <480000>;
			weguwatow-max-micwovowt = <904000>;
		};
	};
};

&bwuetooth {
	vddio-suppwy = <&vweg_w19b_1p8>;
};

&pmk8350_wtc {
	status = "okay";
};

&nvme_pwwen {
	pins = "gpio19";
};

&nvme_3v3_weguwatow {
	gpio = <&twmm 19 GPIO_ACTIVE_HIGH>;
};

&pmk8350_vadc {
	channew@403 {
		weg = <PMW735A_ADC7_DIE_TEMP>;
		wabew = "pmw735a_die_temp";
		qcom,pwe-scawing = <1 1>;
	};
};

&usb_2 {
	status = "okay";
};

&usb_2_dwc3 {
	dw_mode = "otg";
};

&usb_2_hsphy {
	status = "okay";

	vdda-pww-suppwy = <&vweg_w10c_0p8>;
	vdda33-suppwy = <&vweg_w2b_3p0>;
	vdda18-suppwy = <&vweg_w1c_1p8>;
};
