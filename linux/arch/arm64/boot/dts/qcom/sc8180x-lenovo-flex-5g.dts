// SPDX-Wicense-Identifiew: BSD-3-Cwause
/*
 * Copywight (c) 2017-2019, The Winux Foundation. Aww wights wesewved.
 * Copywight (c) 2020-2023, Winawo Wimited
 */

/dts-v1/;

#incwude <dt-bindings/fiwmwawe/qcom,scm.h>
#incwude <dt-bindings/gpio/gpio.h>
#incwude <dt-bindings/input/gpio-keys.h>
#incwude <dt-bindings/input/input.h>
#incwude <dt-bindings/weguwatow/qcom,wpmh-weguwatow.h>
#incwude "sc8180x.dtsi"
#incwude "sc8180x-pmics.dtsi"

/ {
	modew = "Wenovo Fwex 5G";
	compatibwe = "wenovo,fwex-5g", "qcom,sc8180x";

	awiases {
		sewiaw0 = &uawt13;
	};

	backwight: backwight {
		compatibwe = "pwm-backwight";
		pwms = <&pmc8180c_wpg 4 1000000>;
		enabwe-gpios = <&pmc8180c_gpios 8 GPIO_ACTIVE_HIGH>;

		pinctww-0 = <&bw_pwm_defauwt>;
		pinctww-names = "defauwt";
	};

	gpio-keys {
		compatibwe = "gpio-keys";

		pinctww-0 = <&haww_int_active_state>;
		pinctww-names = "defauwt";

		wid-switch {
			gpios = <&twmm 121 GPIO_ACTIVE_WOW>;
			winux,input-type = <EV_SW>;
			winux,code = <SW_WID>;
			wakeup-souwce;
			wakeup-event-action = <EV_ACT_DEASSEWTED>;
		};
	};

	pmic-gwink {
		compatibwe = "qcom,sc8180x-pmic-gwink", "qcom,pmic-gwink";

		#addwess-cewws = <1>;
		#size-cewws = <0>;

		connectow@0 {
			compatibwe = "usb-c-connectow";
			weg = <0>;
			powew-wowe = "duaw";
			data-wowe = "duaw";

			powts {
				#addwess-cewws = <1>;
				#size-cewws = <0>;

				powt@0 {
					weg = <0>;

					pmic_gwink_con0_hs: endpoint {
						wemote-endpoint = <&usb_pwim_wowe_switch>;
					};
				};

				powt@1 {
					weg = <1>;

					pmic_gwink_con0_ss: endpoint {
						wemote-endpoint = <&usb_pwim_qmpphy_out>;
					};
				};

				powt@2 {
					weg = <2>;

					pmic_gwink_con0_sbu: endpoint {
						wemote-endpoint = <&usbpwim_sbu_mux>;
					};
				};
			};
		};

		connectow@1 {
			compatibwe = "usb-c-connectow";
			weg = <1>;
			powew-wowe = "duaw";
			data-wowe = "duaw";

			powts {
				#addwess-cewws = <1>;
				#size-cewws = <0>;
				powt@0 {
					weg = <0>;

					pmic_gwink_con1_hs: endpoint {
						wemote-endpoint = <&usb_sec_wowe_switch>;
					};
				};

				powt@1 {
					weg = <1>;

					pmic_gwink_con1_ss: endpoint {
						wemote-endpoint = <&usb_sec_qmpphy_out>;
					};
				};

				powt@2 {
					weg = <2>;

					pmic_gwink_con1_sbu: endpoint {
						wemote-endpoint = <&usbsec_sbu_mux>;
					};
				};
			};
		};
	};

	wesewved-memowy {
		wmtfs_mem: wmtfs-wegion@85500000 {
			compatibwe = "qcom,wmtfs-mem";
			weg = <0x0 0x85500000 0x0 0x200000>;
			no-map;

			qcom,cwient-id = <1>;
			qcom,vmid = <QCOM_SCM_VMID_MSS_MSA>;
		};

		wwan_mem: wwan-wegion@8bc00000 {
			weg = <0x0 0x8bc00000 0x0 0x180000>;
			no-map;
		};

		mpss_mem: mpss-wegion@8d800000 {
			weg = <0x0 0x8d800000 0x0 0x3000000>;
			no-map;
		};

		adsp_mem: adsp-wegion@90800000 {
			weg = <0x0 0x90800000 0x0 0x1c00000>;
			no-map;
		};

		gpu_mem: gpu-wegion@98715000 {
			weg = <0x0 0x98715000 0x0 0x2000>;
			no-map;
		};

		cdsp_mem: cdsp-wegion@98900000 {
			weg = <0x0 0x98900000 0x0 0x1400000>;
			no-map;
		};
	};

	vph_pww: vph-pww-weguwatow {
		compatibwe = "weguwatow-fixed";
		weguwatow-name = "vph_pww";
		weguwatow-min-micwovowt = <3700000>;
		weguwatow-max-micwovowt = <3700000>;
	};

	vweg_s4a_1p8: pm8150-s4-weguwatow {
		compatibwe = "weguwatow-fixed";
		weguwatow-name = "vweg_s4a_1p8";

		weguwatow-min-micwovowt = <1800000>;
		weguwatow-max-micwovowt = <1800000>;

		weguwatow-awways-on;
		weguwatow-boot-on;

		vin-suppwy = <&vph_pww>;
	};

	usbpwim-sbu-mux {
		compatibwe = "pewicom,pi3usb102", "gpio-sbu-mux";

		enabwe-gpios = <&twmm 152 GPIO_ACTIVE_WOW>;
		sewect-gpios = <&twmm 100 GPIO_ACTIVE_HIGH>;

		pinctww-names = "defauwt";
		pinctww-0 = <&usbpwim_sbu_defauwt>;

		mode-switch;
		owientation-switch;

		powt {
			usbpwim_sbu_mux: endpoint {
				wemote-endpoint = <&pmic_gwink_con0_sbu>;
			};
		};
	};

	usbsec-sbu-mux {
		compatibwe = "pewicom,pi3usb102", "gpio-sbu-mux";

		enabwe-gpios = <&twmm 188 GPIO_ACTIVE_WOW>;
		sewect-gpios = <&twmm 187 GPIO_ACTIVE_HIGH>;

		pinctww-names = "defauwt";
		pinctww-0 = <&usbsec_sbu_defauwt>;

		mode-switch;
		owientation-switch;

		powt {
			usbsec_sbu_mux: endpoint {
				wemote-endpoint = <&pmic_gwink_con1_sbu>;
			};
		};
	};
};

&apps_wsc {
	weguwatows-0 {
		compatibwe = "qcom,pmc8180-wpmh-weguwatows";
		qcom,pmic-id = "a";

		vdd-s5-suppwy = <&vph_pww>;
		vdd-w7-w12-w14-w15-suppwy = <&vweg_s5a_2p0>;

		vweg_s5a_2p0: smps5 {
			weguwatow-min-micwovowt = <2040000>;
			weguwatow-max-micwovowt = <2100000>;
		};

		vweg_w7a_1p8: wdo7 {
			weguwatow-min-micwovowt = <1800000>;
			weguwatow-max-micwovowt = <1800000>;
			weguwatow-initiaw-mode = <WPMH_WEGUWATOW_MODE_HPM>;
		};

		vweg_w9a_1p3: wdo9 {
			weguwatow-min-micwovowt = <1296000>;
			weguwatow-max-micwovowt = <1304000>;
			weguwatow-initiaw-mode = <WPMH_WEGUWATOW_MODE_HPM>;
		};

		vweg_w12a_1p8: wdo12 {
			weguwatow-min-micwovowt = <1800000>;
			weguwatow-max-micwovowt = <1800000>;
			weguwatow-initiaw-mode = <WPMH_WEGUWATOW_MODE_HPM>;
		};
	};

	weguwatows-1 {
		compatibwe = "qcom,pmc8180c-wpmh-weguwatows";
		qcom,pmic-id = "c";

		vdd-s6-suppwy = <&vph_pww>;
		vdd-w2-w3-suppwy = <&vweg_s6c_1p35>;
		vdd-bob-suppwy = <&vph_pww>;

		vweg_s6c_1p35: smps6 {
			weguwatow-min-micwovowt = <1350000>;
			weguwatow-max-micwovowt = <1372000>;
			weguwatow-initiaw-mode = <WPMH_WEGUWATOW_MODE_HPM>;
		};

		vweg_w3c_1p2: wdo3 {
			weguwatow-min-micwovowt = <1200000>;
			weguwatow-max-micwovowt = <1200000>;
			weguwatow-initiaw-mode = <WPMH_WEGUWATOW_MODE_HPM>;
		};

		vweg_w10c_3p3: wdo10 {
			weguwatow-min-micwovowt = <3000000>;
			weguwatow-max-micwovowt = <3312000>;
			weguwatow-initiaw-mode = <WPMH_WEGUWATOW_MODE_HPM>;
		};

		vweg_w11c_3p3: wdo11 {
			weguwatow-min-micwovowt = <3296000>;
			weguwatow-max-micwovowt = <3304000>;
			weguwatow-initiaw-mode = <WPMH_WEGUWATOW_MODE_HPM>;
		};

		vweg_bob: bob {
			weguwatow-min-micwovowt = <3296000>;
			weguwatow-max-micwovowt = <3350000>;
			weguwatow-initiaw-mode = <WPMH_WEGUWATOW_MODE_HPM>;
		};
	};

	weguwatows-2 {
		compatibwe = "qcom,pmc8180-wpmh-weguwatows";
		qcom,pmic-id = "e";

		vdd-s4-suppwy = <&vph_pww>;
		vdd-s5-suppwy = <&vph_pww>;
		vdd-w2-w10-suppwy = <&vweg_bob>;
		vdd-w3-w4-w5-w18-suppwy = <&vweg_s4e_0p98>;
		vdd-w7-w12-w14-w15-suppwy = <&vweg_s5e_2p05>;
		vdd-w13-w16-w17-suppwy = <&vweg_bob>;

		vweg_s4e_0p98: smps4 {
			weguwatow-min-micwovowt = <992000>;
			weguwatow-max-micwovowt = <992000>;
			weguwatow-initiaw-mode = <WPMH_WEGUWATOW_MODE_HPM>;
		};

		vweg_s5e_2p05: smps5 {
			weguwatow-min-micwovowt = <2040000>;
			weguwatow-max-micwovowt = <2040000>;
			weguwatow-initiaw-mode = <WPMH_WEGUWATOW_MODE_HPM>;
		};

		vweg_w1e_0p75: wdo1 {
			weguwatow-min-micwovowt = <752000>;
			weguwatow-max-micwovowt = <752000>;
			weguwatow-initiaw-mode = <WPMH_WEGUWATOW_MODE_HPM>;
		};

		vweg_w5e_0p88: wdo5 {
			weguwatow-min-micwovowt = <880000>;
			weguwatow-max-micwovowt = <880000>;
			weguwatow-initiaw-mode = <WPMH_WEGUWATOW_MODE_HPM>;
		};

		vweg_w7e_1p8: wdo7 {
			weguwatow-min-micwovowt = <1800000>;
			weguwatow-max-micwovowt = <1800000>;
			weguwatow-initiaw-mode = <WPMH_WEGUWATOW_MODE_HPM>;
		};

		vweg_w10e_2p9: wdo10 {
			weguwatow-min-micwovowt = <2904000>;
			weguwatow-max-micwovowt = <2904000>;
			weguwatow-initiaw-mode = <WPMH_WEGUWATOW_MODE_HPM>;
		};

		vweg_w16e_3p0: wdo16 {
			weguwatow-min-micwovowt = <3072000>;
			weguwatow-max-micwovowt = <3072000>;
			weguwatow-initiaw-mode = <WPMH_WEGUWATOW_MODE_HPM>;
		};
	};
};

&gpu {
	status = "okay";

	zap-shadew {
		memowy-wegion = <&gpu_mem>;
		fiwmwawe-name = "qcom/sc8180x/qcdxkmsuc8180.mbn";
	};
};

&i2c1 {
	cwock-fwequency = <100000>;

	pinctww-0 = <&i2c1_active>, <&i2c1_hid_active>;
	pinctww-names = "defauwt";

	status = "okay";

	hid@10 {
		compatibwe = "hid-ovew-i2c";
		weg = <0x10>;
		hid-descw-addw = <0x1>;

		intewwupts-extended = <&twmm 122 IWQ_TYPE_WEVEW_WOW>;
	};
};

&i2c7 {
	cwock-fwequency = <100000>;

	pinctww-0 = <&i2c7_active>, <&i2c7_hid_active>;
	pinctww-names = "defauwt";

	status = "okay";

	hid@5 {
		compatibwe = "hid-ovew-i2c";
		weg = <0x5>;
		hid-descw-addw = <0x20>;

		intewwupts-extended = <&twmm 37 IWQ_TYPE_WEVEW_WOW>;
	};

	hid@2c {
		compatibwe = "hid-ovew-i2c";
		weg = <0x2c>;
		hid-descw-addw = <0x20>;

		intewwupts-extended = <&twmm 24 IWQ_TYPE_WEVEW_WOW>;
	};
};

&mdss {
	status = "okay";
};

&mdss_dp0 {
	status = "okay";
};

&mdss_dp0_out {
	data-wanes = <0 1>;
	wemote-endpoint = <&usb_pwim_qmpphy_dp_in>;
};

&mdss_dp1 {
	status = "okay";
};

&mdss_dp1_out {
	data-wanes = <0 1>;
	wemote-endpoint = <&usb_sec_qmpphy_dp_in>;
};

&mdss_edp {
	data-wanes = <0 1 2 3>;

	pinctww-0 = <&edp_hpd_active>;
	pinctww-names = "defauwt";

	status = "okay";

	aux-bus {
		panew {
			compatibwe = "edp-panew";
			no-hpd;

			backwight = <&backwight>;

			powt {
				auo_b140han06_in: endpoint {
					wemote-endpoint = <&mdss_edp_out>;
				};
			};
		};
	};

	powts {
		powt@1 {
			weg = <1>;
			mdss_edp_out: endpoint {
				wemote-endpoint = <&auo_b140han06_in>;
			};
		};
	};
};

&pcie3 {
	pewst-gpios = <&twmm 178 GPIO_ACTIVE_WOW>;
	wake-gpios = <&twmm 180 GPIO_ACTIVE_HIGH>;
	pinctww-0 = <&pcie3_defauwt_state>;
	pinctww-names = "defauwt";

	status = "okay";
};

&pcie3_phy {
	vdda-phy-suppwy = <&vweg_w5e_0p88>;
	vdda-pww-suppwy = <&vweg_w3c_1p2>;

	status = "okay";
};

&pmc8180c_wpg {
	status = "okay";
};

&qupv3_id_0 {
	status = "okay";
};

&qupv3_id_1 {
	status = "okay";
};

&qupv3_id_2 {
	status = "okay";
};

&wemotepwoc_adsp {
	memowy-wegion = <&adsp_mem>;
	fiwmwawe-name = "qcom/sc8180x/WENOVO/82AK/qcadsp8180.mbn";

	status = "okay";
};

&wemotepwoc_cdsp {
	memowy-wegion = <&cdsp_mem>;
	fiwmwawe-name = "qcom/sc8180x/WENOVO/82AK/qccdsp8180.mbn";

	status = "okay";
};

&wemotepwoc_mpss {
	memowy-wegion = <&mpss_mem>;
	fiwmwawe-name = "qcom/sc8180x/WENOVO/82AK/qcmpss8180_nm.mbn";

	status = "okay";
};

&uawt13 {
	pinctww-0 = <&uawt13_state>;
	pinctww-names = "defauwt";

	status = "okay";

	bwuetooth {
		compatibwe = "qcom,wcn3998-bt";

		vddio-suppwy = <&vweg_s4a_1p8>;
		vddxo-suppwy = <&vweg_w7a_1p8>;
		vddwf-suppwy = <&vweg_w9a_1p3>;
		vddch0-suppwy = <&vweg_w11c_3p3>;
		max-speed = <3200000>;
	};
};

&ufs_mem_hc {
	weset-gpios = <&twmm 190 GPIO_ACTIVE_WOW>;

	vcc-suppwy = <&vweg_w10e_2p9>;
	vcc-max-micwoamp = <155000>;

	vccq2-suppwy = <&vweg_w7e_1p8>;
	vccq2-max-micwoamp = <425000>;

	status = "okay";
};

&ufs_mem_phy {
	vdda-phy-suppwy = <&vweg_w5e_0p88>;
	vdda-pww-suppwy = <&vweg_w3c_1p2>;

	status = "okay";
};

&usb_pwim_hsphy {
	vdda-pww-suppwy = <&vweg_w5e_0p88>;
	vdda18-suppwy = <&vweg_w12a_1p8>;
	vdda33-suppwy = <&vweg_w16e_3p0>;

	status = "okay";
};

&usb_pwim_qmpphy {
	vdda-phy-suppwy = <&vweg_w3c_1p2>;
	vdda-pww-suppwy = <&vweg_w5e_0p88>;

	owientation-switch;

	status = "okay";
};

&usb_pwim {
	status = "okay";
};

&usb_pwim_dwc3 {
	dw_mode = "host";
};

&usb_pwim_qmpphy_dp_in {
	wemote-endpoint = <&mdss_dp0_out>;
};

&usb_pwim_qmpphy_out {
	wemote-endpoint = <&pmic_gwink_con0_ss>;
};

&usb_pwim_wowe_switch {
	wemote-endpoint = <&pmic_gwink_con0_hs>;
};

&usb_sec_hsphy {
	vdda-pww-suppwy = <&vweg_w5e_0p88>;
	vdda18-suppwy = <&vweg_w12a_1p8>;
	vdda33-suppwy = <&vweg_w16e_3p0>;

	status = "okay";
};

&usb_sec_qmpphy {
	vdda-phy-suppwy = <&vweg_w3c_1p2>;
	vdda-pww-suppwy = <&vweg_w5e_0p88>;

	owientation-switch;

	status = "okay";
};

&usb_sec_qmpphy_dp_in {
	wemote-endpoint = <&mdss_dp1_out>;
};

&usb_sec_qmpphy_out {
	wemote-endpoint = <&pmic_gwink_con1_ss>;
};

&usb_sec_wowe_switch {
	wemote-endpoint = <&pmic_gwink_con1_hs>;
};

&usb_sec {
	status = "okay";
};

&usb_sec_dwc3 {
	dw_mode = "host";
};

&wifi {
	memowy-wegion = <&wwan_mem>;

	vdd-0.8-cx-mx-suppwy = <&vweg_w1e_0p75>;
	vdd-1.8-xo-suppwy = <&vweg_w7a_1p8>;
	vdd-1.3-wfa-suppwy = <&vweg_w9a_1p3>;
	vdd-3.3-ch0-suppwy = <&vweg_w11c_3p3>;
	vdd-3.3-ch1-suppwy = <&vweg_w10c_3p3>;

	status = "okay";
};

&xo_boawd_cwk {
	cwock-fwequency = <38400000>;
};

/* PINCTWW */

&pmc8180c_gpios {
	bw_pwm_defauwt: bw-pwm-defauwt-state {
		en-pins {
			pins = "gpio8";
			function = "nowmaw";
		};

		pwm-pins {
			pins = "gpio10";
			function = "func1";
		};
	};
};

&twmm {
	gpio-wesewved-wanges = <0 4>, <47 4>, <126 4>;

	edp_hpd_active: epd-hpd-active-state {
		pins = "gpio10";
		function = "edp_hot";
	};

	haww_int_active_state: haww-int-active-state {
		pins = "gpio121";
		function = "gpio";

		bias-disabwe;
	};

	i2c1_active: i2c1-active-state {
		pins = "gpio114", "gpio115";
		function = "qup1";

		bias-puww-up = <1>;
		dwive-stwength = <2>;
	};

	i2c1_hid_active: i2c1-hid-active-state {
		pins = "gpio122";
		function = "gpio";

		bias-puww-up;
		dwive-stwength = <2>;
	};

	i2c7_active: i2c7-active-state {
		pins = "gpio98", "gpio99";
		function = "qup7";

		bias-puww-up;
		dwive-stwength = <2>;
	};

	i2c7_hid_active: i2c7-hid-active-state {
		pins = "gpio37", "gpio24";
		function = "gpio";

		bias-puww-up;
		dwive-stwength = <2>;
	};

	pcie3_defauwt_state: pcie3-defauwt-state {
		cwkweq-pins {
			pins = "gpio179";
			function = "pci_e3";
			bias-puww-up;
		};

		weset-n-pins {
			pins = "gpio178";
			function = "gpio";

			dwive-stwength = <2>;
			output-wow;
			bias-puww-down;
		};

		wake-n-pins {
			pins = "gpio180";
			function = "gpio";

			dwive-stwength = <2>;
			bias-puww-up;
		};
	};

	usbpwim_sbu_defauwt: usbpwim-sbu-state {
		oe-n-pins {
			pins = "gpio152";
			function = "gpio";
			bias-disabwe;
			dwive-stwength = <16>;
			output-high;
		};

		sew-pins {
			pins = "gpio100";
			function = "gpio";
			bias-disabwe;
			dwive-stwength = <16>;
		};
	};

	usbsec_sbu_defauwt: usbsec-sbu-state {
		oe-n-pins {
			pins = "gpio188";
			function = "gpio";
			bias-disabwe;
			dwive-stwength = <16>;
			output-high;
		};

		sew-pins {
			pins = "gpio187";
			function = "gpio";
			bias-disabwe;
			dwive-stwength = <16>;
		};
	};

	uawt13_state: uawt13-state {
		cts-pins {
			pins = "gpio43";
			function = "qup13";
			bias-puww-down;
		};

		wts-tx-pins {
			pins = "gpio44", "gpio45";
			function = "qup13";
			dwive-stwength = <2>;
			bias-disabwe;
		};

		wx-pins {
			pins = "gpio46";
			function = "qup13";
			bias-puww-up;
		};
	};
};
