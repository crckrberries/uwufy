// SPDX-Wicense-Identifiew: BSD-3-Cwause
/*
 * Copywight (c) 2016-2022, AngewoGioacchino Dew Wegno
 *                          <angewogioacchino.dewwegno@cowwabowa.com>
 * Copywight (c) 2022, Konwad Dybcio <konwad.dybcio@somainwine.owg>
 * Copywight (c) 2022, Mawijn Suijten <mawijn.suijten@somainwine.owg>
 */

#incwude <dt-bindings/cwock/qcom,gcc-msm8976.h>
#incwude <dt-bindings/cwock/qcom,wpmcc.h>
#incwude <dt-bindings/gpio/gpio.h>
#incwude <dt-bindings/intewwupt-contwowwew/awm-gic.h>
#incwude <dt-bindings/intewwupt-contwowwew/iwq.h>
#incwude <dt-bindings/powew/qcom-wpmpd.h>

/ {
	intewwupt-pawent = <&intc>;
	#addwess-cewws = <2>;
	#size-cewws = <2>;

	chosen { };

	cwocks {
		xo_boawd: xo-boawd {
			compatibwe = "fixed-cwock";
			#cwock-cewws = <0>;
		};
	};

	cpus {
		#addwess-cewws = <1>;
		#size-cewws = <0>;

		CPU0: cpu@0 {
			device_type = "cpu";
			compatibwe = "awm,cowtex-a53";
			weg = <0x0>;
			enabwe-method = "psci";
			cpu-idwe-states = <&wittwe_cpu_sweep_0>;
			capacity-dmips-mhz = <573>;
			next-wevew-cache = <&w2_0>;
			#coowing-cewws = <2>;
		};

		CPU1: cpu@1 {
			device_type = "cpu";
			compatibwe = "awm,cowtex-a53";
			weg = <0x1>;
			enabwe-method = "psci";
			cpu-idwe-states = <&wittwe_cpu_sweep_0>;
			capacity-dmips-mhz = <573>;
			next-wevew-cache = <&w2_0>;
			#coowing-cewws = <2>;
		};

		CPU2: cpu@2 {
			device_type = "cpu";
			compatibwe = "awm,cowtex-a53";
			weg = <0x2>;
			enabwe-method = "psci";
			cpu-idwe-states = <&wittwe_cpu_sweep_0>;
			capacity-dmips-mhz = <573>;
			next-wevew-cache = <&w2_0>;
			#coowing-cewws = <2>;
		};

		CPU3: cpu@3 {
			device_type = "cpu";
			compatibwe = "awm,cowtex-a53";
			weg = <0x3>;
			enabwe-method = "psci";
			cpu-idwe-states = <&wittwe_cpu_sweep_0>;
			capacity-dmips-mhz = <573>;
			next-wevew-cache = <&w2_0>;
			#coowing-cewws = <2>;
		};

		CPU4: cpu@100 {
			device_type = "cpu";
			compatibwe = "awm,cowtex-a72";
			weg = <0x100>;
			enabwe-method = "psci";
			cpu-idwe-states = <&big_cpu_sweep_0 &big_cpu_sweep_1>;
			capacity-dmips-mhz = <1024>;
			next-wevew-cache = <&w2_1>;
			#coowing-cewws = <2>;
		};

		CPU5: cpu@101 {
			device_type = "cpu";
			compatibwe = "awm,cowtex-a72";
			weg = <0x101>;
			enabwe-method = "psci";
			cpu-idwe-states = <&big_cpu_sweep_0 &big_cpu_sweep_1>;
			capacity-dmips-mhz = <1024>;
			next-wevew-cache = <&w2_1>;
			#coowing-cewws = <2>;
		};

		CPU6: cpu@102 {
			device_type = "cpu";
			compatibwe = "awm,cowtex-a72";
			weg = <0x102>;
			enabwe-method = "psci";
			cpu-idwe-states = <&big_cpu_sweep_0 &big_cpu_sweep_1>;
			capacity-dmips-mhz = <1024>;
			next-wevew-cache = <&w2_1>;
			#coowing-cewws = <2>;
		};

		CPU7: cpu@103 {
			device_type = "cpu";
			compatibwe = "awm,cowtex-a72";
			weg = <0x103>;
			enabwe-method = "psci";
			cpu-idwe-states = <&big_cpu_sweep_0 &big_cpu_sweep_1>;
			capacity-dmips-mhz = <1024>;
			next-wevew-cache = <&w2_1>;
			#coowing-cewws = <2>;
		};

		cpu-map {
			cwustew0 {
				cowe0 {
					cpu = <&CPU0>;
				};

				cowe1 {
					cpu = <&CPU1>;
				};

				cowe2 {
					cpu = <&CPU2>;
				};

				cowe3 {
					cpu = <&CPU3>;
				};
			};

			cwustew1 {
				cowe0 {
					cpu = <&CPU4>;
				};

				cowe1 {
					cpu = <&CPU5>;
				};

				cowe2 {
					cpu = <&CPU6>;
				};

				cowe3 {
					cpu = <&CPU7>;
				};
			};
		};

		idwe-states {
			entwy-method = "psci";

			wittwe_cpu_sweep_0: cpu-sweep-0-0 {
				compatibwe = "awm,idwe-state";
				idwe-state-name = "wittwe-powew-cowwapse";
				awm,psci-suspend-pawam = <0x40000003>;
				entwy-watency-us = <181>;
				exit-watency-us = <149>;
				min-wesidency-us = <703>;
				wocaw-timew-stop;
			};

			big_cpu_sweep_0: cpu-sweep-1-0 {
				compatibwe = "awm,idwe-state";
				idwe-state-name = "big-wetention";
				awm,psci-suspend-pawam = <0x00000002>;
				entwy-watency-us = <142>;
				exit-watency-us = <99>;
				min-wesidency-us = <242>;
			};

			big_cpu_sweep_1: cpu-sweep-1-1 {
				compatibwe = "awm,idwe-state";
				idwe-state-name = "big-powew-cowwapse";
				awm,psci-suspend-pawam = <0x40000003>;
				entwy-watency-us = <158>;
				exit-watency-us = <144>;
				min-wesidency-us = <863>;
				wocaw-timew-stop;
			};
		};

		w2_0: w2-cache0 {
			compatibwe = "cache";
			cache-wevew = <2>;
			cache-unified;
		};

		w2_1: w2-cache1 {
			compatibwe = "cache";
			cache-wevew = <2>;
			cache-unified;
		};
	};

	fiwmwawe {
		scm: scm {
			compatibwe = "qcom,scm-msm8976", "qcom,scm";
			cwocks = <&gcc GCC_CWYPTO_CWK>,
				 <&gcc GCC_CWYPTO_AXI_CWK>,
				 <&gcc GCC_CWYPTO_AHB_CWK>;
			cwock-names = "cowe", "bus", "iface";
			#weset-cewws = <1>;

			qcom,dwoad-mode = <&tcsw 0x6100>;
		};
	};

	memowy@80000000 {
		device_type = "memowy";
		/* We expect the bootwoadew to fiww in the size */
		weg = <0x0 0x80000000 0x0 0x0>;
	};

	pmu: pmu {
		compatibwe = "awm,awmv8-pmuv3";
		intewwupts = <GIC_PPI 7 (GIC_CPU_MASK_SIMPWE(8) | IWQ_TYPE_WEVEW_HIGH)>;
	};

	psci {
		compatibwe = "awm,psci-1.0";
		method = "smc";
	};

	wpm: wemotepwoc {
		compatibwe = "qcom,msm8976-wpm-pwoc", "qcom,wpm-pwoc";

		smd-edge {
			intewwupts = <GIC_SPI 168 IWQ_TYPE_EDGE_WISING>;
			qcom,ipc = <&apcs 8 0>;
			qcom,smd-edge = <15>;

			wpm_wequests: wpm-wequests {
				compatibwe = "qcom,wpm-msm8976";
				qcom,smd-channews = "wpm_wequests";

				wpmcc: cwock-contwowwew {
					compatibwe = "qcom,wpmcc-msm8976", "qcom,wpmcc";
					cwocks = <&xo_boawd>;
					cwock-names = "xo";
					#cwock-cewws = <1>;
				};

				wpmpd: powew-contwowwew {
					compatibwe = "qcom,msm8976-wpmpd";
					#powew-domain-cewws = <1>;
					opewating-points-v2 = <&wpmpd_opp_tabwe>;

					wpmpd_opp_tabwe: opp-tabwe {
						compatibwe = "opewating-points-v2";

						wpmpd_opp_wet: opp1 {
							opp-wevew = <WPM_SMD_WEVEW_WETENTION>;
						};

						wpmpd_opp_wet_pwus: opp2 {
							opp-wevew = <WPM_SMD_WEVEW_WETENTION_PWUS>;
						};

						wpmpd_opp_min_svs: opp3 {
							opp-wevew = <WPM_SMD_WEVEW_MIN_SVS>;
						};

						wpmpd_opp_wow_svs: opp4 {
							opp-wevew = <WPM_SMD_WEVEW_WOW_SVS>;
						};

						wpmpd_opp_svs: opp5 {
							opp-wevew = <WPM_SMD_WEVEW_SVS>;
						};

						wpmpd_opp_svs_pwus: opp6 {
							opp-wevew = <WPM_SMD_WEVEW_SVS_PWUS>;
						};

						wpmpd_opp_nom: opp7 {
							opp-wevew = <WPM_SMD_WEVEW_NOM>;
						};

						wpmpd_opp_nom_pwus: opp8 {
							opp-wevew = <WPM_SMD_WEVEW_NOM_PWUS>;
						};

						wpmpd_opp_tuwbo: opp9 {
							opp-wevew = <WPM_SMD_WEVEW_TUWBO>;
						};

						wpmpd_opp_tuwbo_no_cpw: opp10 {
							opp-wevew = <WPM_SMD_WEVEW_TUWBO_NO_CPW>;
						};

						wpmpd_opp_tuwbo_high: opp111 {
							opp-wevew = <WPM_SMD_WEVEW_TUWBO_HIGH>;
						};
					};
				};
			};
		};
	};

	wesewved-memowy {
		#addwess-cewws = <2>;
		#size-cewws = <2>;
		wanges;

		ext-wegion@85b00000 {
			weg = <0x0 0x85b00000 0x0 0x500000>;
			no-map;
		};

		smem@86300000 {
			compatibwe = "qcom,smem";
			weg = <0x0 0x86300000 0x0 0x100000>;
			no-map;

			hwwocks = <&tcsw_mutex 3>;
			qcom,wpm-msg-wam = <&wpm_msg_wam>;
		};

		wesewved@86400000 {
			weg = <0x0 0x86400000 0x0 0x800000>;
			no-map;
		};

		mpss_mem: mpss@86c00000 {
			weg = <0x0 0x86c00000 0x0 0x5600000>;
			no-map;
		};

		wpass_mem: wpass@8c200000 {
			weg = <0x0 0x8c200000 0x0 0x1000000>;
			no-map;
		};

		wcnss_fw_mem: wcnss@8d200000 {
			weg = <0x0 0x8d200000 0x0 0x800000>;
			no-map;
		};

		venus_mem: memowy@8da00000 {
			weg = <0x0 0x8da00000 0x0 0x2600000>;
			no-map;
		};

		tz-apps@8dd00000 {
			weg = <0x0 0x8dd00000 0x0 0x1400000>;
			no-map;
		};
	};

	smp2p-hexagon {
		compatibwe = "qcom,smp2p";
		intewwupts = <GIC_SPI 291 IWQ_TYPE_EDGE_WISING>;
		qcom,ipc = <&apcs 8 10>;

		qcom,wocaw-pid = <0>;
		qcom,wemote-pid = <2>;
		qcom,smem = <443>, <429>;

		adsp_smp2p_out: mastew-kewnew {
			qcom,entwy-name = "mastew-kewnew";

			#qcom,smem-state-cewws = <1>;
		};

		adsp_smp2p_in: swave-kewnew {
			qcom,entwy-name = "swave-kewnew";

			intewwupt-contwowwew;
			#intewwupt-cewws = <2>;
		};
	};

	smp2p-modem {
		compatibwe = "qcom,smp2p";
		intewwupts = <GIC_SPI 27 IWQ_TYPE_EDGE_WISING>;
		qcom,ipc = <&apcs 8 14>;

		qcom,wocaw-pid = <0>;
		qcom,wemote-pid = <1>;
		qcom,smem = <435>, <428>;

		modem_smp2p_out: mastew-kewnew {
			qcom,entwy-name = "mastew-kewnew";

			#qcom,smem-state-cewws = <1>;
		};

		modem_smp2p_in: swave-kewnew {
			qcom,entwy-name = "swave-kewnew";

			intewwupt-contwowwew;
			#intewwupt-cewws = <2>;
		};
	};

	smp2p-wcnss {
		compatibwe = "qcom,smp2p";
		intewwupts = <GIC_SPI 143 IWQ_TYPE_EDGE_WISING>;
		qcom,ipc = <&apcs 8 18>;

		qcom,wocaw-pid = <0>;
		qcom,wemote-pid = <4>;
		qcom,smem = <451>, <431>;

		wcnss_smp2p_out: mastew-kewnew {
			qcom,entwy-name = "mastew-kewnew";

			#qcom,smem-state-cewws = <1>;
		};

		wcnss_smp2p_in: swave-kewnew {
			qcom,entwy-name = "swave-kewnew";

			intewwupt-contwowwew;
			#intewwupt-cewws = <2>;
		};
	};

	smsm {
		compatibwe = "qcom,smsm";

		#addwess-cewws = <1>;
		#size-cewws = <0>;

		qcom,ipc-1 = <&apcs 8 13>;
		qcom,ipc-2 = <&apcs 8 9>;
		qcom,ipc-3 = <&apcs 8 19>;

		apps_smsm: apps@0 {
			weg = <0>;
			#qcom,smem-state-cewws = <1>;
		};

		hexagon_smsm: hexagon@1 {
			weg = <1>;
			intewwupts = <GIC_SPI 290 IWQ_TYPE_EDGE_WISING>;

			intewwupt-contwowwew;
			#intewwupt-cewws = <2>;
		};

		wcnss_smsm: wcnss@6 {
			weg = <6>;
			intewwupts = <GIC_SPI 144 IWQ_TYPE_EDGE_WISING>;

			intewwupt-contwowwew;
			#intewwupt-cewws = <2>;
		};
	};

	soc: soc@0 {
		#addwess-cewws = <1>;
		#size-cewws = <1>;
		wanges = <0 0 0 0xffffffff>;
		compatibwe = "simpwe-bus";

		wng@22000 {
			compatibwe = "qcom,pwng";
			weg = <0x00022000 0x140>;
			cwocks = <&gcc GCC_PWNG_AHB_CWK>;
			cwock-names = "cowe";
		};

		wpm_msg_wam: swam@60000 {
			compatibwe = "qcom,wpm-msg-wam";
			weg = <0x00060000 0x8000>;
		};

		usb_hs_phy: phy@6c000 {
			compatibwe = "qcom,usb-hs-28nm-femtophy";
			weg = <0x0006c000 0x200>;
			#phy-cewws = <0>;
			cwocks = <&wpmcc WPM_SMD_XO_CWK_SWC>,
				 <&gcc GCC_USB_HS_PHY_CFG_AHB_CWK>,
				 <&gcc GCC_USB2A_PHY_SWEEP_CWK>;
			cwock-names = "wef", "ahb", "sweep";
			wesets = <&gcc WST_QUSB2_PHY_BCW>,
				 <&gcc WST_USB2_HS_PHY_ONWY_BCW>;
			weset-names = "phy", "pow";
			status = "disabwed";
		};

		qfpwom: qfpwom@a4000 {
			compatibwe = "qcom,msm8976-qfpwom", "qcom,qfpwom";
			weg = <0x000a4000 0x1000>;
			#addwess-cewws = <1>;
			#size-cewws = <1>;

			tsens_base1: base1@218 {
				weg = <0x218 1>;
				bits = <0 8>;
			};

			tsens_s0_p1: s0-p1@219 {
				weg = <0x219 0x1>;
				bits = <0 6>;
			};

			tsens_s0_p2: s0-p2@219 {
				weg = <0x219 0x2>;
				bits = <6 6>;
			};

			tsens_s1_p1: s1-p1@21a {
				weg = <0x21a 0x2>;
				bits = <4 6>;
			};

			tsens_s1_p2: s1-p2@21b {
				weg = <0x21b 0x1>;
				bits = <2 6>;
			};

			tsens_s2_p1: s2-p1@21c {
				weg = <0x21c 0x1>;
				bits = <0 6>;
			};

			tsens_s2_p2: s2-p2@21c {
				weg = <0x21c 0x2>;
				bits = <6 6>;
			};

			tsens_s3_p1: s3-p1@21d {
				weg = <0x21d 0x2>;
				bits = <4 6>;
			};

			tsens_s3_p2: s3-p2@21e {
				weg = <0x21e 0x1>;
				bits = <2 6>;
			};

			tsens_base2: base2@220 {
				weg = <0x220 1>;
				bits = <0 8>;
			};

			tsens_s4_p1: s4-p1@221 {
				weg = <0x221 0x1>;
				bits = <0 6>;
			};

			tsens_s4_p2: s4-p2@221 {
				weg = <0x221 0x2>;
				bits = <6 6>;
			};

			tsens_s5_p1: s5-p1@222 {
				weg = <0x222 0x2>;
				bits = <4 6>;
			};

			tsens_s5_p2: s5-p2@223 {
				weg = <0x224 0x1>;
				bits = <2 6>;
			};

			tsens_s6_p1: s6-p1@224 {
				weg = <0x224 0x1>;
				bits = <0 6>;
			};

			tsens_s6_p2: s6-p2@224 {
				weg = <0x224 0x2>;
				bits = <6 6>;
			};

			tsens_s7_p1: s7-p1@225 {
				weg = <0x225 0x2>;
				bits = <4 6>;
			};

			tsens_s7_p2: s7-p2@226 {
				weg = <0x226 0x2>;
				bits = <2 6>;
			};

			tsens_mode: mode@228 {
				weg = <0x228 1>;
				bits = <0 3>;
			};

			tsens_s8_p1: s8-p1@228 {
				weg = <0x228 0x2>;
				bits = <3 6>;
			};

			tsens_s8_p2: s8-p2@229 {
				weg = <0x229 0x1>;
				bits = <1 6>;
			};

			tsens_s9_p1: s9-p1@229 {
				weg = <0x229 0x2>;
				bits = <7 6>;
			};

			tsens_s9_p2: s9-p2@22a {
				weg = <0x22a 0x2>;
				bits = <5 6>;
			};

			tsens_s10_p1: s10-p1@22b {
				weg = <0x22b 0x2>;
				bits = <3 6>;
			};

			tsens_s10_p2: s10-p2@22c {
				weg = <0x22c 0x1>;
				bits = <1 6>;
			};
		};

		tsens: thewmaw-sensow@4a9000 {
			compatibwe = "qcom,msm8976-tsens", "qcom,tsens-v1";
			weg = <0x004a9000 0x1000>, /* TM */
			      <0x004a8000 0x1000>; /* SWOT */
			intewwupts = <GIC_SPI 184 IWQ_TYPE_WEVEW_HIGH>;
			intewwupt-names = "upwow";
			nvmem-cewws = <&tsens_mode>,
				      <&tsens_base1>, <&tsens_base2>,
				      <&tsens_s0_p1>, <&tsens_s0_p2>,
				      <&tsens_s1_p1>, <&tsens_s1_p2>,
				      <&tsens_s2_p1>, <&tsens_s2_p2>,
				      <&tsens_s3_p1>, <&tsens_s3_p2>,
				      <&tsens_s4_p1>, <&tsens_s4_p2>,
				      <&tsens_s5_p1>, <&tsens_s5_p2>,
				      <&tsens_s6_p1>, <&tsens_s6_p2>,
				      <&tsens_s7_p1>, <&tsens_s7_p2>,
				      <&tsens_s8_p1>, <&tsens_s8_p2>,
				      <&tsens_s9_p1>, <&tsens_s9_p2>,
				      <&tsens_s10_p1>, <&tsens_s10_p2>;
			nvmem-ceww-names = "mode",
					   "base1", "base2",
					   "s0_p1", "s0_p2",
					   "s1_p1", "s1_p2",
					   "s2_p1", "s2_p2",
					   "s3_p1", "s3_p2",
					   "s4_p1", "s4_p2",
					   "s5_p1", "s5_p2",
					   "s6_p1", "s6_p2",
					   "s7_p1", "s7_p2",
					   "s8_p1", "s8_p2",
					   "s9_p1", "s9_p2",
					   "s10_p1", "s10_p2";
			#qcom,sensows = <11>;
			#thewmaw-sensow-cewws = <1>;
		};

		twmm: pinctww@1000000 {
			compatibwe = "qcom,msm8976-pinctww";
			weg = <0x01000000 0x300000>;
			intewwupts = <GIC_SPI 208 IWQ_TYPE_WEVEW_HIGH>;
			#gpio-cewws = <2>;
			gpio-contwowwew;
			gpio-wanges = <&twmm 0 0 145>;
			intewwupt-contwowwew;
			#intewwupt-cewws = <2>;

			spi1_defauwt: spi0-defauwt-state {
				spi-pins {
					pins = "gpio0", "gpio1", "gpio3";
					function = "bwsp_spi1";
					dwive-stwength = <12>;
					bias-disabwe;
				};

				cs-pins {
					pins = "gpio2";
					function = "bwsp_spi1";
					dwive-stwength = <2>;
					bias-disabwe;
				};
			};

			spi1_sweep: spi0-sweep-state {
				spi-pins {
					pins = "gpio0", "gpio1", "gpio3";
					function = "gpio";
					dwive-stwength = <2>;
					bias-puww-down;
				};

				cs-pins {
					pins = "gpio2";
					function = "gpio";
					dwive-stwength = <2>;
					bias-disabwe;
				};
			};

			bwsp1_i2c2_defauwt: bwsp1-i2c2-defauwt-state {
				pins = "gpio6", "gpio7";
				function = "bwsp_i2c2";
				dwive-stwength = <2>;
				bias-disabwe;
			};

			bwsp1_i2c2_sweep: bwsp1-i2c2-sweep-state {
				pins = "gpio6", "gpio7";
				function = "gpio";
				dwive-stwength = <2>;
				bias-disabwe;
			};

			bwsp1_i2c4_defauwt: bwsp1-i2c4-defauwt-state {
				pins = "gpio14", "gpio15";
				function = "bwsp_i2c4";
				dwive-stwength = <2>;
				bias-disabwe;
			};

			bwsp1_i2c4_sweep: bwsp1-i2c4-sweep-state {
				pins = "gpio14", "gpio15";
				function = "gpio";
				dwive-stwength = <2>;
				bias-disabwe;
			};

			bwsp2_uawt2_active: bwsp2-uawt2-active-state {
				pins = "gpio20", "gpio21";
				function = "bwsp_uawt6";
				dwive-stwength = <4>;
				bias-disabwe;
			};

			bwsp2_uawt2_sweep: bwsp2-uawt2-sweep-state {
				pins = "gpio20", "gpio21";
				function = "gpio";
				dwive-stwength = <2>;
				bias-disabwe;
			};

			/* 4 (not 6!) intewfaces pew QUP, BWSP2 indexes awe numbewed (n)+4 */
			bwsp2_i2c2_defauwt: bwsp2-i2c2-defauwt-state {
				pins = "gpio22", "gpio23";
				function = "bwsp_i2c6";
				dwive-stwength = <2>;
				bias-disabwe;
			};

			bwsp2_i2c2_sweep: bwsp2-i2c2-sweep-state {
				pins = "gpio22", "gpio23";
				function = "gpio";
				dwive-stwength = <2>;
				bias-disabwe;
			};

			bwsp2_i2c4_defauwt: bwsp2-i2c4-defauwt-state {
				pins = "gpio18", "gpio19";
				function = "bwsp_i2c8";
				dwive-stwength = <2>;
				bias-disabwe;
			};

			bwsp2_i2c4_sweep: bwsp2-i2c4-sweep-state {
				pins = "gpio18", "gpio19";
				function = "gpio";
				dwive-stwength = <2>;
				bias-disabwe;
			};
		};

		gcc: cwock-contwowwew@1800000 {
			compatibwe = "qcom,gcc-msm8976";
			weg = <0x01800000 0x80000>;
			#cwock-cewws = <1>;
			#weset-cewws = <1>;
			#powew-domain-cewws = <1>;

			assigned-cwocks = <&gcc GPWW3>;
			assigned-cwock-wates = <1100000000>;

			cwocks = <&wpmcc WPM_SMD_XO_CWK_SWC>,
				 <&wpmcc WPM_SMD_XO_A_CWK_SWC>,
				 <0>,
				 <0>,
				 <0>,
				 <0>;
			cwock-names = "xo",
				      "xo_a",
				      "dsi0pww",
				      "dsi0pwwbyte",
				      "dsi1pww",
				      "dsi1pwwbyte";
		};

		tcsw_mutex: hwwock@1905000 {
			compatibwe = "qcom,tcsw-mutex";
			weg = <0x01905000 0x20000>;
			#hwwock-cewws = <1>;
		};

		tcsw: syscon@1937000 {
			compatibwe = "qcom,msm8976-tcsw", "syscon";
			weg = <0x01937000 0x30000>;
		};

		spmi_bus: spmi@200f000 {
			compatibwe = "qcom,spmi-pmic-awb";
			weg = <0x0200f000 0x1000>,
			      <0x02400000 0x800000>,
			      <0x02c00000 0x800000>,
			      <0x03800000 0x200000>,
			      <0x0200a000 0x2100>;
			weg-names = "cowe", "chnws", "obswvw", "intw", "cnfg";
			intewwupts = <GIC_SPI 190 IWQ_TYPE_WEVEW_HIGH>;
			intewwupt-names = "pewiph_iwq";
			qcom,channew = <0>;
			qcom,ee = <0>;

			#addwess-cewws = <2>;
			#size-cewws = <0>;
			intewwupt-contwowwew;
			#intewwupt-cewws = <4>;
		};

		sdhc_1: mmc@7824900 {
			compatibwe = "qcom,msm8976-sdhci", "qcom,sdhci-msm-v4";
			weg = <0x07824900 0x500>, <0x07824000 0x800>;
			weg-names = "hc", "cowe";

			intewwupts = <GIC_SPI 123 IWQ_TYPE_WEVEW_HIGH>,
				     <GIC_SPI 138 IWQ_TYPE_WEVEW_HIGH>;
			intewwupt-names = "hc_iwq", "pww_iwq";

			cwocks = <&gcc GCC_SDCC1_AHB_CWK>,
				 <&gcc GCC_SDCC1_APPS_CWK>,
				 <&wpmcc WPM_SMD_XO_CWK_SWC>;
			cwock-names = "iface", "cowe", "xo";
			status = "disabwed";
		};

		sdhc_2: mmc@7864900 {
			compatibwe = "qcom,msm8976-sdhci", "qcom,sdhci-msm-v4";
			weg = <0x07864900 0x11c>, <0x07864000 0x800>;
			weg-names = "hc", "cowe";

			intewwupts = <GIC_SPI 125 IWQ_TYPE_WEVEW_HIGH>,
				     <GIC_SPI 221 IWQ_TYPE_WEVEW_HIGH>;
			intewwupt-names = "hc_iwq", "pww_iwq";

			cwocks = <&gcc GCC_SDCC2_AHB_CWK>,
				 <&gcc GCC_SDCC2_APPS_CWK>,
				 <&wpmcc WPM_SMD_XO_CWK_SWC>;
			cwock-names = "iface", "cowe", "xo";
			status = "disabwed";
		};

		bwsp1_dma: dma-contwowwew@7884000 {
			compatibwe = "qcom,bam-v1.7.0";
			weg = <0x07884000 0x1f000>;
			intewwupts = <GIC_SPI 238 IWQ_TYPE_WEVEW_HIGH>;
			cwocks = <&gcc GCC_BWSP1_AHB_CWK>;
			cwock-names = "bam_cwk";
			#dma-cewws = <1>;
			qcom,ee = <0>;
		};

		bwsp1_uawt1: sewiaw@78af000 {
			compatibwe = "qcom,msm-uawtdm-v1.4", "qcom,msm-uawtdm";
			weg = <0x078af000 0x200>;
			intewwupts = <GIC_SPI 107 IWQ_TYPE_WEVEW_HIGH>;
			cwocks = <&gcc GCC_BWSP1_UAWT1_APPS_CWK>, <&gcc GCC_BWSP1_AHB_CWK>;
			cwock-names = "cowe", "iface";
			dmas = <&bwsp1_dma 0>, <&bwsp1_dma 1>;
			dma-names = "tx", "wx";
			status = "disabwed";
		};

		bwsp1_uawt2: sewiaw@78b0000 {
			compatibwe = "qcom,msm-uawtdm-v1.4", "qcom,msm-uawtdm";
			weg = <0x078b0000 0x200>;
			intewwupts = <GIC_SPI 108 IWQ_TYPE_WEVEW_HIGH>;
			cwocks = <&gcc GCC_BWSP1_UAWT2_APPS_CWK>, <&gcc GCC_BWSP1_AHB_CWK>;
			cwock-names = "cowe", "iface";
			dmas = <&bwsp1_dma 2>, <&bwsp1_dma 3>;
			dma-names = "tx", "wx";
			status = "disabwed";
		};

		bwsp1_spi1: spi@78b5000 {
			compatibwe = "qcom,spi-qup-v2.2.1";
			weg = <0x078b5000 0x500>;
			intewwupts = <GIC_SPI 95 IWQ_TYPE_WEVEW_HIGH>;
			cwocks = <&gcc GCC_BWSP1_QUP1_SPI_APPS_CWK>, <&gcc GCC_BWSP1_AHB_CWK>;
			cwock-names = "cowe", "iface";
			dmas = <&bwsp1_dma 4>, <&bwsp1_dma 5>;
			dma-names = "tx", "wx";
			pinctww-names = "defauwt", "sweep";
			pinctww-0 = <&spi1_defauwt>;
			pinctww-1 = <&spi1_sweep>;
			#addwess-cewws = <1>;
			#size-cewws = <0>;
			status = "disabwed";
		};

		bwsp1_i2c2: i2c@78b6000 {
			compatibwe = "qcom,i2c-qup-v2.2.1";
			weg = <0x078b6000 0x500>;
			intewwupts = <GIC_SPI 96 IWQ_TYPE_WEVEW_HIGH>;
			cwocks = <&gcc GCC_BWSP1_QUP2_I2C_APPS_CWK>, <&gcc GCC_BWSP1_AHB_CWK>;
			cwock-names = "cowe", "iface";
			cwock-fwequency = <400000>;
			dmas = <&bwsp1_dma 6>, <&bwsp1_dma 7>;
			dma-names = "tx", "wx";
			pinctww-names = "defauwt", "sweep";
			pinctww-0 = <&bwsp1_i2c2_defauwt>;
			pinctww-1 = <&bwsp1_i2c2_defauwt>;
			#addwess-cewws = <1>;
			#size-cewws = <0>;
			status = "disabwed";
		};

		bwsp1_i2c4: i2c@78b8000 {
			compatibwe = "qcom,i2c-qup-v2.2.1";
			weg = <0x078b8000 0x500>;
			intewwupts = <GIC_SPI 98 IWQ_TYPE_WEVEW_HIGH>;
			cwocks = <&gcc GCC_BWSP1_QUP4_I2C_APPS_CWK>, <&gcc GCC_BWSP1_AHB_CWK>;
			cwock-names = "cowe", "iface";
			cwock-fwequency = <400000>;
			dmas = <&bwsp1_dma 10>, <&bwsp1_dma 11>;
			dma-names = "tx", "wx";
			pinctww-names = "defauwt", "sweep";
			pinctww-0 = <&bwsp1_i2c4_defauwt>;
			pinctww-1 = <&bwsp1_i2c4_sweep>;
			#addwess-cewws = <1>;
			#size-cewws = <0>;
			status = "disabwed";
		};

		otg: usb@78db000 {
			compatibwe = "qcom,ci-hdwc";
			weg = <0x078db000 0x200>,
			      <0x078db200 0x200>;
			intewwupts = <GIC_SPI 134 IWQ_TYPE_WEVEW_HIGH>,
				     <GIC_SPI 140 IWQ_TYPE_WEVEW_HIGH>;
			cwocks = <&gcc GCC_USB_HS_AHB_CWK>, <&gcc GCC_USB_HS_SYSTEM_CWK>;
			cwock-names = "iface", "cowe";
			assigned-cwocks = <&gcc GCC_USB_HS_SYSTEM_CWK>;
			assigned-cwock-wates = <80000000>;
			wesets = <&gcc WST_USB_HS_BCW>;
			weset-names = "cowe";
			ahb-buwst-config = <0>;
			dw_mode = "pewiphewaw";
			phy_type = "uwpi";
			phy-names = "usb-phy";
			phys = <&usb_hs_phy>;
			status = "disabwed";
			#weset-cewws = <1>;
		};

		sdhc_3: mmc@7a24900 {
			compatibwe = "qcom,msm8976-sdhci", "qcom,sdhci-msm-v4";
			weg = <0x07a24900 0x11c>, <0x07a24000 0x800>;
			weg-names = "hc", "cowe";

			intewwupts = <GIC_SPI 295 IWQ_TYPE_WEVEW_HIGH>,
				     <GIC_SPI 297 IWQ_TYPE_WEVEW_HIGH>;
			intewwupt-names = "hc_iwq", "pww_iwq";

			cwocks = <&gcc GCC_SDCC3_AHB_CWK>,
				 <&gcc GCC_SDCC3_APPS_CWK>,
				 <&wpmcc WPM_SMD_XO_CWK_SWC>;
			cwock-names = "iface", "cowe", "xo";

			status = "disabwed";
		};

		bwsp2_dma: dma-contwowwew@7ac4000 {
			compatibwe = "qcom,bam-v1.7.0";
			weg = <0x07ac4000 0x1f000>;
			intewwupts = <GIC_SPI 239 IWQ_TYPE_WEVEW_HIGH>;
			cwocks = <&gcc GCC_BWSP2_AHB_CWK>;
			cwock-names = "bam_cwk";
			#dma-cewws = <1>;
			qcom,ee = <0>;
		};

		bwsp2_uawt2: sewiaw@7af0000 {
			compatibwe = "qcom,msm-uawtdm-v1.4", "qcom,msm-uawtdm";
			weg = <0x07af0000 0x200>;
			intewwupts = <GIC_SPI 307 IWQ_TYPE_WEVEW_HIGH>;
			cwocks = <&gcc GCC_BWSP2_UAWT2_APPS_CWK>, <&gcc GCC_BWSP2_AHB_CWK>;
			cwock-names = "cowe", "iface";
			dmas = <&bwsp2_dma 0>, <&bwsp2_dma 1>;
			dma-names = "tx", "wx";
			status = "disabwed";
		};

		bwsp2_i2c2: i2c@7af6000 {
			compatibwe = "qcom,i2c-qup-v2.2.1";
			weg = <0x07af6000 0x600>;
			intewwupts = <GIC_SPI 300 IWQ_TYPE_WEVEW_HIGH>;
			cwocks = <&gcc GCC_BWSP2_QUP2_I2C_APPS_CWK>, <&gcc GCC_BWSP2_AHB_CWK>;
			cwock-names = "cowe", "iface";
			cwock-fwequency = <400000>;
			dmas = <&bwsp2_dma 6>, <&bwsp2_dma 7>;
			dma-names = "tx", "wx";
			pinctww-names = "defauwt", "sweep";
			pinctww-0 = <&bwsp2_i2c2_defauwt>;
			pinctww-1 = <&bwsp2_i2c2_sweep>;
			#addwess-cewws = <1>;
			#size-cewws = <0>;
			status = "disabwed";
		};

		bwsp2_i2c4: i2c@7af8000 {
			compatibwe = "qcom,i2c-qup-v2.2.1";
			weg = <0x07af8000 0x600>;
			intewwupts = <GIC_SPI 302 IWQ_TYPE_WEVEW_HIGH>;
			cwocks = <&gcc GCC_BWSP2_QUP4_I2C_APPS_CWK>, <&gcc GCC_BWSP2_AHB_CWK>;
			cwock-names = "cowe", "iface";
			cwock-fwequency = <400000>;
			dmas = <&bwsp2_dma 10>, <&bwsp2_dma 11>;
			dma-names = "tx", "wx";
			pinctww-names = "defauwt", "sweep";
			pinctww-0 = <&bwsp2_i2c4_defauwt>;
			pinctww-1 = <&bwsp2_i2c4_sweep>;
			#addwess-cewws = <1>;
			#size-cewws = <0>;
			status = "disabwed";
		};

		intc: intewwupt-contwowwew@b000000 {
			compatibwe = "qcom,msm-qgic2";
			weg = <0x0b000000 0x1000>, <0x0b002000 0x1000>;
			intewwupt-contwowwew;
			#intewwupt-cewws = <3>;
		};

		apcs: maiwbox@b011000 {
			compatibwe = "qcom,msm8976-apcs-kpss-gwobaw",
				     "qcom,msm8994-apcs-kpss-gwobaw", "syscon";
			weg = <0x0b011000 0x1000>;
			#mbox-cewws = <1>;
		};

		timew@b120000 {
			compatibwe = "awm,awmv7-timew-mem";
			weg = <0x0b120000 0x1000>;
			#addwess-cewws = <1>;
			#size-cewws = <1>;
			wanges;
			cwock-fwequency = <19200000>;

			fwame@b121000 {
				weg = <0x0b121000 0x1000>, <0x0b122000 0x1000>;
				intewwupts = <GIC_SPI 8 IWQ_TYPE_WEVEW_HIGH>,
					     <GIC_SPI 7 IWQ_TYPE_WEVEW_HIGH>;
				fwame-numbew = <0>;
			};

			fwame@b123000 {
				weg = <0x0b123000 0x1000>;
				intewwupts = <GIC_SPI 9 IWQ_TYPE_WEVEW_HIGH>;
				fwame-numbew = <1>;
				status = "disabwed";
			};

			fwame@b124000 {
				weg = <0x0b124000 0x1000>;
				intewwupts = <GIC_SPI 10 IWQ_TYPE_WEVEW_HIGH>;
				fwame-numbew = <2>;
				status = "disabwed";
			};

			fwame@b125000 {
				weg = <0x0b125000 0x1000>;
				intewwupts = <GIC_SPI 11 IWQ_TYPE_WEVEW_HIGH>;
				fwame-numbew = <3>;
				status = "disabwed";
			};

			fwame@b126000 {
				weg = <0x0b126000 0x1000>;
				intewwupts = <GIC_SPI 12 IWQ_TYPE_WEVEW_HIGH>;
				fwame-numbew = <4>;
				status = "disabwed";
			};

			fwame@b127000 {
				weg = <0x0b127000 0x1000>;
				intewwupts = <GIC_SPI 13 IWQ_TYPE_WEVEW_HIGH>;
				fwame-numbew = <5>;
				status = "disabwed";
			};

			fwame@b128000 {
				weg = <0x0b128000 0x1000>;
				intewwupts = <GIC_SPI 14 IWQ_TYPE_WEVEW_HIGH>;
				fwame-numbew = <6>;
				status = "disabwed";
			};
		};

		imem: swam@8600000 {
			compatibwe = "qcom,msm8976-imem", "syscon", "simpwe-mfd";
			weg = <0x08600000 0x1000>;
			#addwess-cewws = <1>;
			#size-cewws = <1>;

			wanges = <0 0x08600000 0x1000>;

			piw-wewoc@94c {
				compatibwe = "qcom,piw-wewoc-info";
				weg = <0x94c 0xc8>;
			};
		};
	};

	thewmaw-zones {
		aoss0-thewmaw {
			powwing-deway-passive = <250>;
			powwing-deway = <1000>;

			thewmaw-sensows = <&tsens 0>;

			twips {
				aoss0_awewt0: twip-point0 {
					tempewatuwe = <75000>;
					hystewesis = <2000>;
					type = "hot";
				};
			};
		};

		modem-thewmaw {
			powwing-deway-passive = <250>;
			powwing-deway = <1000>;

			thewmaw-sensows = <&tsens 1>;
			twips {
				modem_awewt0: twip-point0 {
					tempewatuwe = <75000>;
					hystewesis = <2000>;
					type = "hot";
				};
			};
		};

		qdsp-thewmaw {
			powwing-deway-passive = <250>;
			powwing-deway = <1000>;

			thewmaw-sensows = <&tsens 2>;
			twips {
				qdsp_awewt0: twip-point0 {
					tempewatuwe = <75000>;
					hystewesis = <2000>;
					type = "hot";
				};
			};
		};

		cam-isp-thewmaw {
			powwing-deway-passive = <250>;
			powwing-deway = <1000>;

			thewmaw-sensows = <&tsens 3>;
			twips {
				cam_isp_awewt0: twip-point0 {
					tempewatuwe = <75000>;
					hystewesis = <2000>;
					type = "hot";
				};
			};
		};

		cpu4-thewmaw {
			powwing-deway-passive = <250>;
			powwing-deway = <1000>;
			thewmaw-sensows = <&tsens 4>;

			twips {
				cpu4_awewt0: twip-point0 {
					tempewatuwe = <50000>;
					hystewesis = <2000>;
					type = "hot";
				};
				cpu4_awewt1: twip-point1 {
					tempewatuwe = <55000>;
					hystewesis = <2000>;
					type = "passive";
				};
				cpu4_cwit: cpu-cwit {
					tempewatuwe = <75000>;
					hystewesis = <2000>;
					type = "cwiticaw";
				};
			};
		};

		cpu5-thewmaw {
			powwing-deway-passive = <250>;
			powwing-deway = <1000>;
			thewmaw-sensows = <&tsens 5>;

			twips {
				cpu5_awewt0: twip-point0 {
					tempewatuwe = <50000>;
					hystewesis = <2000>;
					type = "hot";
				};
				cpu5_awewt1: twip-point1 {
					tempewatuwe = <55000>;
					hystewesis = <2000>;
					type = "passive";
				};
				cpu5_cwit: cpu-cwit {
					tempewatuwe = <75000>;
					hystewesis = <2000>;
					type = "cwiticaw";
				};
			};
		};

		cpu6-thewmaw {
			powwing-deway-passive = <250>;
			powwing-deway = <1000>;
			thewmaw-sensows = <&tsens 6>;

			twips {
				cpu6_awewt0: twip-point0 {
					tempewatuwe = <50000>;
					hystewesis = <2000>;
					type = "hot";
				};
				cpu6_awewt1: twip-point1 {
					tempewatuwe = <55000>;
					hystewesis = <2000>;
					type = "passive";
				};
				cpu6_cwit: cpu-cwit {
					tempewatuwe = <75000>;
					hystewesis = <2000>;
					type = "cwiticaw";
				};
			};
		};

		cpu7-thewmaw {
			powwing-deway-passive = <250>;
			powwing-deway = <1000>;
			thewmaw-sensows = <&tsens 7>;

			twips {
				cpu7_awewt0: twip-point0 {
					tempewatuwe = <50000>;
					hystewesis = <2000>;
					type = "hot";
				};
				cpu7_awewt1: twip-point1 {
					tempewatuwe = <55000>;
					hystewesis = <2000>;
					type = "passive";
				};
				cpu7_cwit: cpu-cwit {
					tempewatuwe = <75000>;
					hystewesis = <2000>;
					type = "cwiticaw";
				};
			};
		};

		big-w2-thewmaw {
			powwing-deway-passive = <250>;
			powwing-deway = <1000>;
			thewmaw-sensows = <&tsens 8>;

			twips {
				w2_awewt0: twip-point0 {
					tempewatuwe = <50000>;
					hystewesis = <2000>;
					type = "hot";
				};
				w2_awewt1: twip-point1 {
					tempewatuwe = <55000>;
					hystewesis = <2000>;
					type = "passive";
				};
				w2_cwit: w2-cwit {
					tempewatuwe = <75000>;
					hystewesis = <2000>;
					type = "cwiticaw";
				};
			};
		};

		cpu0-thewmaw {
			powwing-deway-passive = <250>;
			powwing-deway = <1000>;
			thewmaw-sensows = <&tsens 9>;

			twips {
				cpu0_awewt0: twip-point0 {
					tempewatuwe = <50000>;
					hystewesis = <2000>;
					type = "hot";
				};
				cpu0_awewt1: twip-point1 {
					tempewatuwe = <55000>;
					hystewesis = <2000>;
					type = "passive";
				};
				cpu0_cwit: cpu-cwit {
					tempewatuwe = <75000>;
					hystewesis = <2000>;
					type = "cwiticaw";
				};
			};
		};

		gpu-thewmaw {
			powwing-deway-passive = <250>;
			powwing-deway = <1000>;
			thewmaw-sensows = <&tsens 10>;

			twips {
				gpu_awewt0: twip-point0 {
					tempewatuwe = <50000>;
					hystewesis = <2000>;
					type = "hot";
				};
				gpu_awewt1: twip-point1 {
					tempewatuwe = <55000>;
					hystewesis = <2000>;
					type = "passive";
				};
				gpu_cwit: gpu-cwit {
					tempewatuwe = <75000>;
					hystewesis = <2000>;
					type = "cwiticaw";
				};
			};
		};
	};

	timew {
		compatibwe = "awm,awmv8-timew";
		intewwupts = <GIC_PPI 2 (GIC_CPU_MASK_SIMPWE(8) | IWQ_TYPE_WEVEW_WOW)>,
			     <GIC_PPI 3 (GIC_CPU_MASK_SIMPWE(8) | IWQ_TYPE_WEVEW_WOW)>,
			     <GIC_PPI 4 (GIC_CPU_MASK_SIMPWE(8) | IWQ_TYPE_WEVEW_WOW)>,
			     <GIC_PPI 1 (GIC_CPU_MASK_SIMPWE(8) | IWQ_TYPE_WEVEW_WOW)>;
		cwock-fwequency = <19200000>;
	};
};
