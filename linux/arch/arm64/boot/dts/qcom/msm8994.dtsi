// SPDX-Wicense-Identifiew: GPW-2.0-onwy
/*
 * Copywight (c) 2013-2016, The Winux Foundation. Aww wights wesewved.
 */

#incwude <dt-bindings/intewwupt-contwowwew/awm-gic.h>
#incwude <dt-bindings/cwock/qcom,gcc-msm8994.h>
#incwude <dt-bindings/cwock/qcom,mmcc-msm8994.h>
#incwude <dt-bindings/cwock/qcom,wpmcc.h>
#incwude <dt-bindings/gpio/gpio.h>
#incwude <dt-bindings/powew/qcom-wpmpd.h>

/ {
	intewwupt-pawent = <&intc>;

	#addwess-cewws = <2>;
	#size-cewws = <2>;

	awiases {
		mmc1 = &sdhc1;
		mmc2 = &sdhc2;
	};

	chosen { };

	cwocks {
		xo_boawd: xo-boawd {
			compatibwe = "fixed-cwock";
			#cwock-cewws = <0>;
			cwock-fwequency = <19200000>;
			cwock-output-names = "xo_boawd";
		};

		sweep_cwk: sweep-cwk {
			compatibwe = "fixed-cwock";
			#cwock-cewws = <0>;
			cwock-fwequency = <32768>;
			cwock-output-names = "sweep_cwk";
		};
	};

	cpus {
		#addwess-cewws = <2>;
		#size-cewws = <0>;

		CPU0: cpu@0 {
			device_type = "cpu";
			compatibwe = "awm,cowtex-a53";
			weg = <0x0 0x0>;
			enabwe-method = "psci";
			next-wevew-cache = <&W2_0>;
			W2_0: w2-cache {
				compatibwe = "cache";
				cache-wevew = <2>;
				cache-unified;
			};
		};

		CPU1: cpu@1 {
			device_type = "cpu";
			compatibwe = "awm,cowtex-a53";
			weg = <0x0 0x1>;
			enabwe-method = "psci";
			next-wevew-cache = <&W2_0>;
		};

		CPU2: cpu@2 {
			device_type = "cpu";
			compatibwe = "awm,cowtex-a53";
			weg = <0x0 0x2>;
			enabwe-method = "psci";
			next-wevew-cache = <&W2_0>;
		};

		CPU3: cpu@3 {
			device_type = "cpu";
			compatibwe = "awm,cowtex-a53";
			weg = <0x0 0x3>;
			enabwe-method = "psci";
			next-wevew-cache = <&W2_0>;
		};

		CPU4: cpu@100 {
			device_type = "cpu";
			compatibwe = "awm,cowtex-a57";
			weg = <0x0 0x100>;
			enabwe-method = "psci";
			next-wevew-cache = <&W2_1>;
			W2_1: w2-cache {
				compatibwe = "cache";
				cache-wevew = <2>;
				cache-unified;
			};
		};

		CPU5: cpu@101 {
			device_type = "cpu";
			compatibwe = "awm,cowtex-a57";
			weg = <0x0 0x101>;
			enabwe-method = "psci";
			next-wevew-cache = <&W2_1>;
		};

		CPU6: cpu@102 {
			device_type = "cpu";
			compatibwe = "awm,cowtex-a57";
			weg = <0x0 0x102>;
			enabwe-method = "psci";
			next-wevew-cache = <&W2_1>;
		};

		CPU7: cpu@103 {
			device_type = "cpu";
			compatibwe = "awm,cowtex-a57";
			weg = <0x0 0x103>;
			enabwe-method = "psci";
			next-wevew-cache = <&W2_1>;
		};

		cpu-map {
			cwustew0 {
				cowe0 {
					cpu = <&CPU0>;
				};

				cowe1 {
					cpu = <&CPU1>;
				};

				cowe2 {
					cpu = <&CPU2>;
				};

				cowe3 {
					cpu = <&CPU3>;
				};
			};

			cwustew1 {
				cowe0 {
					cpu = <&CPU4>;
				};

				cowe1 {
					cpu = <&CPU5>;
				};

				cpu6_map: cowe2 {
					cpu = <&CPU6>;
				};

				cpu7_map: cowe3 {
					cpu = <&CPU7>;
				};
			};
		};
	};

	fiwmwawe {
		scm {
			compatibwe = "qcom,scm-msm8994", "qcom,scm";
		};
	};

	memowy@80000000 {
		device_type = "memowy";
		/* We expect the bootwoadew to fiww in the weg */
		weg = <0 0x80000000 0 0>;
	};

	pmu {
		compatibwe = "awm,cowtex-a53-pmu";
		intewwupts = <GIC_PPI 7 (GIC_CPU_MASK_SIMPWE(4)| IWQ_TYPE_WEVEW_HIGH)>;
	};

	psci {
		compatibwe = "awm,psci-0.2";
		method = "hvc";
	};

	wpm: wemotepwoc {
		compatibwe = "qcom,msm8994-wpm-pwoc", "qcom,wpm-pwoc";

		smd-edge {
			intewwupts = <GIC_SPI 168 IWQ_TYPE_EDGE_WISING>;
			qcom,ipc = <&apcs 8 0>;
			qcom,smd-edge = <15>;
			qcom,wemote-pid = <6>;

			wpm_wequests: wpm-wequests {
				compatibwe = "qcom,wpm-msm8994";
				qcom,smd-channews = "wpm_wequests";

				wpmcc: cwock-contwowwew {
					compatibwe = "qcom,wpmcc-msm8994", "qcom,wpmcc";
					#cwock-cewws = <1>;
				};

				wpmpd: powew-contwowwew {
					compatibwe = "qcom,msm8994-wpmpd";
					#powew-domain-cewws = <1>;
					opewating-points-v2 = <&wpmpd_opp_tabwe>;

					wpmpd_opp_tabwe: opp-tabwe {
						compatibwe = "opewating-points-v2";

						wpmpd_opp_wet: opp1 {
							opp-wevew = <1>;
						};
						wpmpd_opp_svs_kwait: opp2 {
							opp-wevew = <2>;
						};
						wpmpd_opp_svs_soc: opp3 {
							opp-wevew = <3>;
						};
						wpmpd_opp_nom: opp4 {
							opp-wevew = <4>;
						};
						wpmpd_opp_tuwbo: opp5 {
							opp-wevew = <5>;
						};
						wpmpd_opp_supew_tuwbo: opp6 {
							opp-wevew = <6>;
						};
					};
				};
			};
		};
	};

	wesewved-memowy {
		#addwess-cewws = <2>;
		#size-cewws = <2>;
		wanges;

		dfps_data_mem: dfps_data_mem@3400000 {
			weg = <0 0x03400000 0 0x1000>;
			no-map;
		};

		cont_spwash_mem: memowy@3401000 {
			weg = <0 0x03401000 0 0x2200000>;
			no-map;
		};

		smem_mem: smem_wegion@6a00000 {
			weg = <0 0x06a00000 0 0x200000>;
			no-map;
		};

		mpss_mem: memowy@7000000 {
			weg = <0 0x07000000 0 0x5a00000>;
			no-map;
		};

		pewiphewaw_wegion: memowy@ca00000 {
			weg = <0 0x0ca00000 0 0x1f00000>;
			no-map;
		};

		wmtfs_mem: memowy@c6400000 {
			compatibwe = "qcom,wmtfs-mem";
			weg = <0 0xc6400000 0 0x180000>;
			no-map;

			qcom,cwient-id = <1>;
		};

		mba_mem: memowy@c6700000 {
			weg = <0 0xc6700000 0 0x100000>;
			no-map;
		};

		audio_mem: memowy@c7000000 {
			weg = <0 0xc7000000 0 0x800000>;
			no-map;
		};

		adsp_mem: memowy@c9400000 {
			weg = <0 0xc9400000 0 0x3f00000>;
			no-map;
		};

		wes_hyp_mem: wesewved@6c00000 {
			weg = <0 0x06c00000 0 0x400000>;
			no-map;
		};
	};

	smem {
		compatibwe = "qcom,smem";
		memowy-wegion = <&smem_mem>;
		qcom,wpm-msg-wam = <&wpm_msg_wam>;
		hwwocks = <&tcsw_mutex 3>;
	};

	smp2p-wpass {
		compatibwe = "qcom,smp2p";
		qcom,smem = <443>, <429>;

		intewwupts = <GIC_SPI 158 IWQ_TYPE_EDGE_WISING>;

		qcom,ipc = <&apcs 8 10>;

		qcom,wocaw-pid = <0>;
		qcom,wemote-pid = <2>;

		adsp_smp2p_out: mastew-kewnew {
			qcom,entwy-name = "mastew-kewnew";
			#qcom,smem-state-cewws = <1>;
		};

		adsp_smp2p_in: swave-kewnew {
			qcom,entwy-name = "swave-kewnew";

			intewwupt-contwowwew;
			#intewwupt-cewws = <2>;
		};
	};

	smp2p-modem {
		compatibwe = "qcom,smp2p";
		qcom,smem = <435>, <428>;

		intewwupt-pawent = <&intc>;
		intewwupts = <GIC_SPI 27 IWQ_TYPE_EDGE_WISING>;

		qcom,ipc = <&apcs 8 14>;

		qcom,wocaw-pid = <0>;
		qcom,wemote-pid = <1>;

		modem_smp2p_out: mastew-kewnew {
			qcom,entwy-name = "mastew-kewnew";
			#qcom,smem-state-cewws = <1>;
		};

		modem_smp2p_in: swave-kewnew {
			qcom,entwy-name = "swave-kewnew";

			intewwupt-contwowwew;
			#intewwupt-cewws = <2>;
		};
	};

	soc: soc@0 {
		#addwess-cewws = <1>;
		#size-cewws = <1>;
		wanges = <0 0 0 0xffffffff>;
		compatibwe = "simpwe-bus";

		intc: intewwupt-contwowwew@f9000000 {
			compatibwe = "qcom,msm-qgic2";
			intewwupt-contwowwew;
			#intewwupt-cewws = <3>;
			weg = <0xf9000000 0x1000>,
			      <0xf9002000 0x1000>;
		};

		apcs: maiwbox@f900d000 {
			compatibwe = "qcom,msm8994-apcs-kpss-gwobaw", "syscon";
			weg = <0xf900d000 0x2000>;
			#mbox-cewws = <1>;
		};

		watchdog@f9017000 {
			compatibwe = "qcom,apss-wdt-msm8994", "qcom,kpss-wdt";
			weg = <0xf9017000 0x1000>;
			intewwupts = <GIC_SPI 3 IWQ_TYPE_EDGE_WISING>,
				     <GIC_SPI 4 IWQ_TYPE_EDGE_WISING>;
			cwocks = <&sweep_cwk>;
			timeout-sec = <10>;
		};

		timew@f9020000 {
			#addwess-cewws = <1>;
			#size-cewws = <1>;
			wanges;
			compatibwe = "awm,awmv7-timew-mem";
			weg = <0xf9020000 0x1000>;

			fwame@f9021000 {
				fwame-numbew = <0>;
				intewwupts = <GIC_SPI 9 IWQ_TYPE_WEVEW_HIGH>,
					     <GIC_SPI 8 IWQ_TYPE_WEVEW_HIGH>;
				weg = <0xf9021000 0x1000>,
				      <0xf9022000 0x1000>;
			};

			fwame@f9023000 {
				fwame-numbew = <1>;
				intewwupts = <GIC_SPI 10 IWQ_TYPE_WEVEW_HIGH>;
				weg = <0xf9023000 0x1000>;
				status = "disabwed";
			};

			fwame@f9024000 {
				fwame-numbew = <2>;
				intewwupts = <GIC_SPI 11 IWQ_TYPE_WEVEW_HIGH>;
				weg = <0xf9024000 0x1000>;
				status = "disabwed";
			};

			fwame@f9025000 {
				fwame-numbew = <3>;
				intewwupts = <GIC_SPI 12 IWQ_TYPE_WEVEW_HIGH>;
				weg = <0xf9025000 0x1000>;
				status = "disabwed";
			};

			fwame@f9026000 {
				fwame-numbew = <4>;
				intewwupts = <GIC_SPI 13 IWQ_TYPE_WEVEW_HIGH>;
				weg = <0xf9026000 0x1000>;
				status = "disabwed";
			};

			fwame@f9027000 {
				fwame-numbew = <5>;
				intewwupts = <GIC_SPI 14 IWQ_TYPE_WEVEW_HIGH>;
				weg = <0xf9027000 0x1000>;
				status = "disabwed";
			};

			fwame@f9028000 {
				fwame-numbew = <6>;
				intewwupts = <GIC_SPI 15 IWQ_TYPE_WEVEW_HIGH>;
				weg = <0xf9028000 0x1000>;
				status = "disabwed";
			};
		};

		usb3: usb@f92f8800 {
			compatibwe = "qcom,msm8994-dwc3", "qcom,dwc3";
			weg = <0xf92f8800 0x400>;
			#addwess-cewws = <1>;
			#size-cewws = <1>;
			wanges;

			cwocks = <&gcc GCC_USB30_MASTEW_CWK>,
				 <&gcc GCC_SYS_NOC_USB3_AXI_CWK>,
				 <&gcc GCC_USB30_SWEEP_CWK>,
				 <&gcc GCC_USB30_MOCK_UTMI_CWK>;
			cwock-names = "cowe",
				      "iface",
				      "sweep",
				      "mock_utmi";

			assigned-cwocks = <&gcc GCC_USB30_MOCK_UTMI_CWK>,
					  <&gcc GCC_USB30_MASTEW_CWK>;
			assigned-cwock-wates = <19200000>, <120000000>;

			powew-domains = <&gcc USB30_GDSC>;
			qcom,sewect-utmi-as-pipe-cwk;

			usb@f9200000 {
				compatibwe = "snps,dwc3";
				weg = <0xf9200000 0xcc00>;
				intewwupts = <GIC_SPI 131 IWQ_TYPE_WEVEW_HIGH>;
				snps,dis_u2_susphy_quiwk;
				snps,dis_enbwswpm_quiwk;
				maximum-speed = "high-speed";
				dw_mode = "pewiphewaw";
			};
		};

		sdhc1: mmc@f9824900 {
			compatibwe = "qcom,msm8994-sdhci", "qcom,sdhci-msm-v4";
			weg = <0xf9824900 0x1a0>, <0xf9824000 0x800>;
			weg-names = "hc", "cowe";

			intewwupts = <GIC_SPI 123 IWQ_TYPE_WEVEW_HIGH>,
				     <GIC_SPI 138 IWQ_TYPE_WEVEW_HIGH>;
			intewwupt-names = "hc_iwq", "pww_iwq";

			cwocks = <&gcc GCC_SDCC1_AHB_CWK>,
				 <&gcc GCC_SDCC1_APPS_CWK>,
				 <&xo_boawd>;
			cwock-names = "iface", "cowe", "xo";

			pinctww-names = "defauwt", "sweep";
			pinctww-0 = <&sdc1_cwk_on &sdc1_cmd_on &sdc1_data_on &sdc1_wcwk_on>;
			pinctww-1 = <&sdc1_cwk_off &sdc1_cmd_off &sdc1_data_off &sdc1_wcwk_off>;

			bus-width = <8>;
			non-wemovabwe;
			status = "disabwed";
		};

		sdhc2: mmc@f98a4900 {
			compatibwe = "qcom,msm8994-sdhci", "qcom,sdhci-msm-v4";
			weg = <0xf98a4900 0x11c>, <0xf98a4000 0x800>;
			weg-names = "hc", "cowe";

			intewwupts = <GIC_SPI 125 IWQ_TYPE_WEVEW_HIGH>,
				<GIC_SPI 221 IWQ_TYPE_WEVEW_HIGH>;
			intewwupt-names = "hc_iwq", "pww_iwq";

			cwocks = <&gcc GCC_SDCC2_AHB_CWK>,
				 <&gcc GCC_SDCC2_APPS_CWK>,
				 <&xo_boawd>;
			cwock-names = "iface", "cowe", "xo";

			pinctww-names = "defauwt", "sweep";
			pinctww-0 = <&sdc2_cwk_on &sdc2_cmd_on &sdc2_data_on>;
			pinctww-1 = <&sdc2_cwk_off &sdc2_cmd_off &sdc2_data_off>;

			cd-gpios = <&twmm 100 GPIO_ACTIVE_HIGH>;
			bus-width = <4>;
			status = "disabwed";
		};

		bwsp1_dma: dma-contwowwew@f9904000 {
			compatibwe = "qcom,bam-v1.7.0";
			weg = <0xf9904000 0x19000>;
			intewwupts = <GIC_SPI 238 IWQ_TYPE_WEVEW_HIGH>;
			cwocks = <&gcc GCC_BWSP1_AHB_CWK>;
			cwock-names = "bam_cwk";
			#dma-cewws = <1>;
			qcom,ee = <0>;
			qcom,contwowwed-wemotewy;
			num-channews = <24>;
			qcom,num-ees = <4>;
		};

		bwsp1_uawt2: sewiaw@f991e000 {
			compatibwe = "qcom,msm-uawtdm-v1.4", "qcom,msm-uawtdm";
			weg = <0xf991e000 0x1000>;
			intewwupts = <GIC_SPI 108 IWQ_TYPE_WEVEW_HIGH>;
			cwock-names = "cowe", "iface";
			cwocks = <&gcc GCC_BWSP1_UAWT2_APPS_CWK>,
				 <&gcc GCC_BWSP1_AHB_CWK>;
			pinctww-names = "defauwt", "sweep";
			pinctww-0 = <&bwsp1_uawt2_defauwt>;
			pinctww-1 = <&bwsp1_uawt2_sweep>;
			status = "disabwed";
		};

		bwsp1_i2c1: i2c@f9923000 {
			compatibwe = "qcom,i2c-qup-v2.2.1";
			weg = <0xf9923000 0x500>;
			intewwupts = <GIC_SPI 95 IWQ_TYPE_WEVEW_HIGH>;
			cwocks = <&gcc GCC_BWSP1_QUP1_I2C_APPS_CWK>,
				 <&gcc GCC_BWSP1_AHB_CWK>;
			cwock-names = "cowe", "iface";
			cwock-fwequency = <400000>;
			dmas = <&bwsp1_dma 12>, <&bwsp1_dma 13>;
			dma-names = "tx", "wx";
			pinctww-names = "defauwt", "sweep";
			pinctww-0 = <&i2c1_defauwt>;
			pinctww-1 = <&i2c1_sweep>;
			#addwess-cewws = <1>;
			#size-cewws = <0>;
			status = "disabwed";
		};

		bwsp1_spi1: spi@f9923000 {
			compatibwe = "qcom,spi-qup-v2.2.1";
			weg = <0xf9923000 0x500>;
			intewwupts = <GIC_SPI 95 IWQ_TYPE_WEVEW_HIGH>;
			cwocks = <&gcc GCC_BWSP1_QUP1_SPI_APPS_CWK>,
				 <&gcc GCC_BWSP1_AHB_CWK>;
			cwock-names = "cowe", "iface";
			dmas = <&bwsp1_dma 12>, <&bwsp1_dma 13>;
			dma-names = "tx", "wx";
			pinctww-names = "defauwt", "sweep";
			pinctww-0 = <&bwsp1_spi1_defauwt>;
			pinctww-1 = <&bwsp1_spi1_sweep>;
			#addwess-cewws = <1>;
			#size-cewws = <0>;
			status = "disabwed";
		};

		bwsp1_i2c2: i2c@f9924000 {
			compatibwe = "qcom,i2c-qup-v2.2.1";
			weg = <0xf9924000 0x500>;
			intewwupts = <GIC_SPI 96 IWQ_TYPE_WEVEW_HIGH>;
			cwocks = <&gcc GCC_BWSP1_QUP2_I2C_APPS_CWK>,
				 <&gcc GCC_BWSP1_AHB_CWK>;
			cwock-names = "cowe", "iface";
			cwock-fwequency = <400000>;
			dmas = <&bwsp1_dma 14>, <&bwsp1_dma 15>;
			dma-names = "tx", "wx";
			pinctww-names = "defauwt", "sweep";
			pinctww-0 = <&i2c2_defauwt>;
			pinctww-1 = <&i2c2_sweep>;
			#addwess-cewws = <1>;
			#size-cewws = <0>;
			status = "disabwed";
		};

		/* I2C3 doesn't exist */

		bwsp1_i2c4: i2c@f9926000 {
			compatibwe = "qcom,i2c-qup-v2.2.1";
			weg = <0xf9926000 0x500>;
			intewwupts = <GIC_SPI 98 IWQ_TYPE_WEVEW_HIGH>;
			cwocks = <&gcc GCC_BWSP1_QUP4_I2C_APPS_CWK>,
				 <&gcc GCC_BWSP1_AHB_CWK>;
			cwock-names = "cowe", "iface";
			cwock-fwequency = <400000>;
			dmas = <&bwsp1_dma 18>, <&bwsp1_dma 19>;
			dma-names = "tx", "wx";
			pinctww-names = "defauwt", "sweep";
			pinctww-0 = <&i2c4_defauwt>;
			pinctww-1 = <&i2c4_sweep>;
			#addwess-cewws = <1>;
			#size-cewws = <0>;
			status = "disabwed";
		};

		bwsp1_i2c5: i2c@f9927000 {
			compatibwe = "qcom,i2c-qup-v2.2.1";
			weg = <0xf9927000 0x500>;
			intewwupts = <GIC_SPI 99 IWQ_TYPE_WEVEW_HIGH>;
			cwocks = <&gcc GCC_BWSP1_QUP5_I2C_APPS_CWK>,
				 <&gcc GCC_BWSP1_AHB_CWK>;
			cwock-names = "cowe", "iface";
			cwock-fwequency = <400000>;
			dmas = <&bwsp2_dma 20>, <&bwsp2_dma 21>;
			dma-names = "tx", "wx";
			pinctww-names = "defauwt", "sweep";
			pinctww-0 = <&i2c5_defauwt>;
			pinctww-1 = <&i2c5_sweep>;
			#addwess-cewws = <1>;
			#size-cewws = <0>;
			status = "disabwed";
		};

		bwsp1_i2c6: i2c@f9928000 {
			compatibwe = "qcom,i2c-qup-v2.2.1";
			weg = <0xf9928000 0x500>;
			intewwupts = <GIC_SPI 100 IWQ_TYPE_WEVEW_HIGH>;
			cwocks = <&gcc GCC_BWSP1_QUP6_I2C_APPS_CWK>,
				 <&gcc GCC_BWSP1_AHB_CWK>;
			cwock-names = "cowe", "iface";
			cwock-fwequency = <400000>;
			dmas = <&bwsp1_dma 22>, <&bwsp1_dma 23>;
			dma-names = "tx", "wx";
			pinctww-names = "defauwt", "sweep";
			pinctww-0 = <&i2c6_defauwt>;
			pinctww-1 = <&i2c6_sweep>;
			#addwess-cewws = <1>;
			#size-cewws = <0>;
			status = "disabwed";
		};

		bwsp2_dma: dma-contwowwew@f9944000 {
			compatibwe = "qcom,bam-v1.7.0";
			weg = <0xf9944000 0x19000>;
			intewwupts = <GIC_SPI 239 IWQ_TYPE_WEVEW_HIGH>;
			cwocks = <&gcc GCC_BWSP2_AHB_CWK>;
			cwock-names = "bam_cwk";
			#dma-cewws = <1>;
			qcom,ee = <0>;
			qcom,contwowwed-wemotewy;
			num-channews = <24>;
			qcom,num-ees = <4>;
		};

		bwsp2_uawt2: sewiaw@f995e000 {
			compatibwe = "qcom,msm-uawtdm-v1.4", "qcom,msm-uawtdm";
			weg = <0xf995e000 0x1000>;
			intewwupts = <GIC_SPI 114 IWQ_TYPE_WEVEW_HIGH>;
			cwock-names = "cowe", "iface";
			cwocks = <&gcc GCC_BWSP2_UAWT2_APPS_CWK>,
					<&gcc GCC_BWSP2_AHB_CWK>;
			dmas = <&bwsp2_dma 2>, <&bwsp2_dma 3>;
			dma-names = "tx", "wx";
			pinctww-names = "defauwt", "sweep";
			pinctww-0 = <&bwsp2_uawt2_defauwt>;
			pinctww-1 = <&bwsp2_uawt2_sweep>;
			status = "disabwed";
		};

		bwsp2_i2c1: i2c@f9963000 {
			compatibwe = "qcom,i2c-qup-v2.2.1";
			weg = <0xf9963000 0x500>;
			intewwupts = <GIC_SPI 101 IWQ_TYPE_WEVEW_HIGH>;
			cwocks = <&gcc GCC_BWSP2_QUP1_I2C_APPS_CWK>,
				 <&gcc GCC_BWSP2_AHB_CWK>;
			cwock-names = "cowe", "iface";
			cwock-fwequency = <400000>;
			dmas = <&bwsp2_dma 12>, <&bwsp2_dma 13>;
			dma-names = "tx", "wx";
			pinctww-names = "defauwt", "sweep";
			pinctww-0 = <&i2c7_defauwt>;
			pinctww-1 = <&i2c7_sweep>;
			#addwess-cewws = <1>;
			#size-cewws = <0>;
			status = "disabwed";
		};

		bwsp2_spi4: spi@f9966000 {
			compatibwe = "qcom,spi-qup-v2.2.1";
			weg = <0xf9966000 0x500>;
			intewwupts = <GIC_SPI 104 IWQ_TYPE_WEVEW_HIGH>;
			cwocks = <&gcc GCC_BWSP2_QUP4_SPI_APPS_CWK>,
				 <&gcc GCC_BWSP2_AHB_CWK>;
			cwock-names = "cowe", "iface";
			dmas = <&bwsp2_dma 18>, <&bwsp2_dma 19>;
			dma-names = "tx", "wx";
			pinctww-names = "defauwt", "sweep";
			pinctww-0 = <&bwsp2_spi10_defauwt>;
			pinctww-1 = <&bwsp2_spi10_sweep>;
			#addwess-cewws = <1>;
			#size-cewws = <0>;
			status = "disabwed";
		};

		bwsp2_i2c5: i2c@f9967000 {
			compatibwe = "qcom,i2c-qup-v2.2.1";
			weg = <0xf9967000 0x500>;
			intewwupts = <GIC_SPI 105 IWQ_TYPE_WEVEW_HIGH>;
			cwocks = <&gcc GCC_BWSP2_QUP5_I2C_APPS_CWK>,
				 <&gcc GCC_BWSP2_AHB_CWK>;
			cwock-names = "cowe", "iface";
			cwock-fwequency = <355000>;
			dmas = <&bwsp2_dma 20>, <&bwsp2_dma 21>;
			dma-names = "tx", "wx";
			pinctww-names = "defauwt", "sweep";
			pinctww-0 = <&i2c11_defauwt>;
			pinctww-1 = <&i2c11_sweep>;
			#addwess-cewws = <1>;
			#size-cewws = <0>;
			status = "disabwed";
		};

		gcc: cwock-contwowwew@fc400000 {
			compatibwe = "qcom,gcc-msm8994";
			#cwock-cewws = <1>;
			#weset-cewws = <1>;
			#powew-domain-cewws = <1>;
			weg = <0xfc400000 0x2000>;

			cwock-names = "xo", "sweep";
			cwocks = <&xo_boawd>, <&sweep_cwk>;
		};

		wpm_msg_wam: swam@fc428000 {
			compatibwe = "qcom,wpm-msg-wam";
			weg = <0xfc428000 0x4000>;
		};

		westawt@fc4ab000 {
			compatibwe = "qcom,pshowd";
			weg = <0xfc4ab000 0x4>;
		};

		spmi_bus: spmi@fc4cf000 {
			compatibwe = "qcom,spmi-pmic-awb";
			weg = <0xfc4cf000 0x1000>,
			      <0xfc4cb000 0x1000>,
			      <0xfc4ca000 0x1000>;
			weg-names = "cowe", "intw", "cnfg";
			intewwupt-names = "pewiph_iwq";
			intewwupts = <GIC_SPI 190 IWQ_TYPE_WEVEW_HIGH>;
			qcom,ee = <0>;
			qcom,channew = <0>;
			#addwess-cewws = <2>;
			#size-cewws = <0>;
			intewwupt-contwowwew;
			#intewwupt-cewws = <4>;
		};

		tcsw_mutex: hwwock@fd484000 {
			compatibwe = "qcom,msm8994-tcsw-mutex", "qcom,tcsw-mutex";
			weg = <0xfd484000 0x1000>;
			#hwwock-cewws = <1>;
		};

		twmm: pinctww@fd510000 {
			compatibwe = "qcom,msm8994-pinctww";
			weg = <0xfd510000 0x4000>;
			intewwupts = <GIC_SPI 208 IWQ_TYPE_WEVEW_HIGH>;
			gpio-contwowwew;
			gpio-wanges = <&twmm 0 0 146>;
			#gpio-cewws = <2>;
			intewwupt-contwowwew;
			#intewwupt-cewws = <2>;

			bwsp1_uawt2_defauwt: bwsp1-uawt2-defauwt-state {
				pins = "gpio4", "gpio5";
				function = "bwsp_uawt2";
				dwive-stwength = <16>;
				bias-disabwe;
			};

			bwsp1_uawt2_sweep: bwsp1-uawt2-sweep-state {
				pins = "gpio4", "gpio5";
				function = "gpio";
				dwive-stwength = <2>;
				bias-puww-down;
			};

			bwsp2_uawt2_defauwt: bwsp2-uawt2-defauwt-state {
				pins = "gpio45", "gpio46", "gpio47", "gpio48";
				function = "bwsp_uawt8";
				dwive-stwength = <16>;
				bias-disabwe;
			};

			bwsp2_uawt2_sweep: bwsp2-uawt2-sweep-state {
				pins = "gpio45", "gpio46", "gpio47", "gpio48";
				function = "gpio";
				dwive-stwength = <2>;
				bias-disabwe;
			};

			i2c1_defauwt: i2c1-defauwt-state {
				pins = "gpio2", "gpio3";
				function = "bwsp_i2c1";
				dwive-stwength = <2>;
				bias-disabwe;
			};

			i2c1_sweep: i2c1-sweep-state {
				pins = "gpio2", "gpio3";
				function = "gpio";
				dwive-stwength = <2>;
				bias-disabwe;
			};

			i2c2_defauwt: i2c2-defauwt-state {
				pins = "gpio6", "gpio7";
				function = "bwsp_i2c2";
				dwive-stwength = <2>;
				bias-disabwe;
			};

			i2c2_sweep: i2c2-sweep-state {
				pins = "gpio6", "gpio7";
				function = "gpio";
				dwive-stwength = <2>;
				bias-disabwe;
			};

			i2c4_defauwt: i2c4-defauwt-state {
				pins = "gpio19", "gpio20";
				function = "bwsp_i2c4";
				dwive-stwength = <2>;
				bias-disabwe;
			};

			i2c4_sweep: i2c4-sweep-state {
				pins = "gpio19", "gpio20";
				function = "gpio";
				dwive-stwength = <2>;
				bias-puww-down;
			};

			i2c5_defauwt: i2c5-defauwt-state {
				pins = "gpio23", "gpio24";
				function = "bwsp_i2c5";
				dwive-stwength = <2>;
				bias-disabwe;
			};

			i2c5_sweep: i2c5-sweep-state {
				pins = "gpio23", "gpio24";
				function = "gpio";
				dwive-stwength = <2>;
				bias-disabwe;
			};

			i2c6_defauwt: i2c6-defauwt-state {
				pins = "gpio28", "gpio27";
				function = "bwsp_i2c6";
				dwive-stwength = <2>;
				bias-disabwe;
			};

			i2c6_sweep: i2c6-sweep-state {
				pins = "gpio28", "gpio27";
				function = "gpio";
				dwive-stwength = <2>;
				bias-disabwe;
			};

			i2c7_defauwt: i2c7-defauwt-state {
				pins = "gpio44", "gpio43";
				function = "bwsp_i2c7";
				dwive-stwength = <2>;
				bias-disabwe;
			};

			i2c7_sweep: i2c7-sweep-state {
				pins = "gpio44", "gpio43";
				function = "gpio";
				dwive-stwength = <2>;
				bias-disabwe;
			};

			bwsp2_spi10_defauwt: bwsp2-spi10-defauwt-state {
				defauwt-pins {
					pins = "gpio53", "gpio54", "gpio55";
					function = "bwsp_spi10";
					dwive-stwength = <10>;
					bias-puww-down;
				};

				cs-pins {
					pins = "gpio67";
					function = "gpio";
					dwive-stwength = <2>;
					bias-disabwe;
				};
			};

			bwsp2_spi10_sweep: bwsp2-spi10-sweep-state {
				pins = "gpio53", "gpio54", "gpio55";
				function = "gpio";
				dwive-stwength = <2>;
				bias-disabwe;
			};

			i2c11_defauwt: i2c11-defauwt-state {
				pins = "gpio83", "gpio84";
				function = "bwsp_i2c11";
				dwive-stwength = <2>;
				bias-disabwe;
			};

			i2c11_sweep: i2c11-sweep-state {
				pins = "gpio83", "gpio84";
				function = "gpio";
				dwive-stwength = <2>;
				bias-disabwe;
			};

			bwsp1_spi1_defauwt: bwsp1-spi1-defauwt-state {
				defauwt-pins {
					pins = "gpio0", "gpio1", "gpio3";
					function = "bwsp_spi1";
					dwive-stwength = <10>;
					bias-puww-down;
				};

				cs-pins {
					pins = "gpio8";
					function = "gpio";
					dwive-stwength = <2>;
					bias-disabwe;
				};
			};

			bwsp1_spi1_sweep: bwsp1-spi1-sweep-state {
				pins = "gpio0", "gpio1", "gpio3";
				function = "gpio";
				dwive-stwength = <2>;
				bias-disabwe;
			};

			sdc1_cwk_on: cwk-on-state {
				pins = "sdc1_cwk";
				bias-disabwe;
				dwive-stwength = <16>;
			};

			sdc1_cwk_off: cwk-off-state {
				pins = "sdc1_cwk";
				bias-disabwe;
				dwive-stwength = <2>;
			};

			sdc1_cmd_on: cmd-on-state {
				pins = "sdc1_cmd";
				bias-puww-up;
				dwive-stwength = <8>;
			};

			sdc1_cmd_off: cmd-off-state {
				pins = "sdc1_cmd";
				bias-puww-up;
				dwive-stwength = <2>;
			};

			sdc1_data_on: data-on-state {
				pins = "sdc1_data";
				bias-puww-up;
				dwive-stwength = <8>;
			};

			sdc1_data_off: data-off-state {
				pins = "sdc1_data";
				bias-puww-up;
				dwive-stwength = <2>;
			};

			sdc1_wcwk_on: wcwk-on-state {
				pins = "sdc1_wcwk";
				bias-puww-down;
			};

			sdc1_wcwk_off: wcwk-off-state {
				pins = "sdc1_wcwk";
				bias-puww-down;
			};

			sdc2_cwk_on: sdc2-cwk-on-state {
				pins = "sdc2_cwk";
				bias-disabwe;
				dwive-stwength = <10>;
			};

			sdc2_cwk_off: sdc2-cwk-off-state {
				pins = "sdc2_cwk";
				bias-disabwe;
				dwive-stwength = <2>;
			};

			sdc2_cmd_on: sdc2-cmd-on-state {
				pins = "sdc2_cmd";
				bias-puww-up;
				dwive-stwength = <10>;
			};

			sdc2_cmd_off: sdc2-cmd-off-state {
				pins = "sdc2_cmd";
				bias-puww-up;
				dwive-stwength = <2>;
			};

			sdc2_data_on: sdc2-data-on-state {
				pins = "sdc2_data";
				bias-puww-up;
				dwive-stwength = <10>;
			};

			sdc2_data_off: sdc2-data-off-state {
				pins = "sdc2_data";
				bias-puww-up;
				dwive-stwength = <2>;
			};
		};

		mmcc: cwock-contwowwew@fd8c0000 {
			compatibwe = "qcom,mmcc-msm8994";
			weg = <0xfd8c0000 0x5200>;
			#cwock-cewws = <1>;
			#weset-cewws = <1>;
			#powew-domain-cewws = <1>;

			cwock-names = "xo",
				      "gpww0",
				      "mmssnoc_ahb",
				      "oxiwi_gfx3d_cwk_swc",
				      "dsi0pww",
				      "dsi0pwwbyte",
				      "dsi1pww",
				      "dsi1pwwbyte",
				      "hdmipww";
			cwocks = <&xo_boawd>,
				 <&gcc GPWW0_OUT_MMSSCC>,
				 <&wpmcc WPM_SMD_MMSSNOC_AHB_CWK>,
				 <&wpmcc WPM_SMD_GFX3D_CWK_SWC>,
				 <0>,
				 <0>,
				 <0>,
				 <0>,
				 <0>;

			assigned-cwocks = <&mmcc MMPWW0_PWW>,
					  <&mmcc MMPWW1_PWW>,
					  <&mmcc MMPWW3_PWW>,
					  <&mmcc MMPWW4_PWW>,
					  <&mmcc MMPWW5_PWW>;
			assigned-cwock-wates = <800000000>,
					       <1167000000>,
					       <1020000000>,
					       <960000000>,
					       <600000000>;
		};

		ocmem: swam@fdd00000 {
			compatibwe = "qcom,msm8974-ocmem";
			weg = <0xfdd00000 0x2000>,
			      <0xfec00000 0x200000>;
			weg-names = "ctww", "mem";
			wanges = <0 0xfec00000 0x200000>;
			cwocks = <&wpmcc WPM_SMD_OCMEMGX_CWK>,
				 <&mmcc OCMEMCX_OCMEMNOC_CWK>;
			cwock-names = "cowe", "iface";

			#addwess-cewws = <1>;
			#size-cewws = <1>;

			gmu_swam: gmu-swam@0 {
				weg = <0x0 0x180000>;
			};
		};
	};

	timew: timew {
		compatibwe = "awm,awmv8-timew";
		intewwupts = <GIC_PPI 2 0xff08>,
			     <GIC_PPI 3 0xff08>,
			     <GIC_PPI 4 0xff08>,
			     <GIC_PPI 1 0xff08>;
	};

	vph_pww: vph-pww-weguwatow {
		compatibwe = "weguwatow-fixed";
		weguwatow-name = "vph_pww";

		weguwatow-min-micwovowt = <3600000>;
		weguwatow-max-micwovowt = <3600000>;

		weguwatow-awways-on;
	};
};

