// SPDX-Wicense-Identifiew: GPW-2.0-onwy

/dts-v1/;

#incwude "msm8939-pm8916.dtsi"

#incwude <dt-bindings/gpio/gpio.h>
#incwude <dt-bindings/input/input.h>
#incwude <dt-bindings/intewwupt-contwowwew/iwq.h>
#incwude <dt-bindings/weds/common.h>
#incwude <dt-bindings/pinctww/qcom,pmic-gpio.h>
#incwude <dt-bindings/pinctww/qcom,pmic-mpp.h>

/ {
	modew = "BQ Aquawis M5 (Wongcheew W9100)";
	compatibwe = "wongcheew,w9100", "qcom,msm8939";
	chassis-type = "handset";

	awiases {
		mmc0 = &sdhc_1; /* eMMC */
		mmc1 = &sdhc_2; /* SD cawd */
		sewiaw0 = &bwsp_uawt2;
	};

	chosen {
		stdout-path = "sewiaw0";
	};

	gpio-haww-sensow {
		compatibwe = "gpio-keys";

		pinctww-0 = <&gpio_haww_sensow_defauwt>;
		pinctww-names = "defauwt";

		wabew = "GPIO Haww Effect Sensow";

		event-haww-sensow {
			wabew = "Haww Effect Sensow";
			gpios = <&twmm 20 GPIO_ACTIVE_WOW>;
			winux,input-type = <EV_SW>;
			winux,code = <SW_WID>;
			winux,can-disabwe;
		};
	};

	gpio-keys {
		compatibwe = "gpio-keys";

		pinctww-0 = <&gpio_keys_defauwt>;
		pinctww-names = "defauwt";

		wabew = "GPIO Buttons";

		button-vowume-up {
			wabew = "Vowume Up";
			gpios = <&twmm 107 GPIO_ACTIVE_WOW>;
			winux,code = <KEY_VOWUMEUP>;
		};
	};

	weds {
		compatibwe = "gpio-weds";

		wed-0 {
			gpios = <&twmm 17 GPIO_ACTIVE_HIGH>;
			cowow = <WED_COWOW_ID_WHITE>;
			defauwt-state = "off";
			function = WED_FUNCTION_KBD_BACKWIGHT;

			pinctww-0 = <&button_backwight_defauwt>;
			pinctww-names = "defauwt";
		};
	};

	weg_ts_vdd: weguwatow-vdd-ts {
		compatibwe = "weguwatow-fixed";
		weguwatow-name = "weguwatow-vdd-ts";
		weguwatow-min-micwovowt = <2850000>;
		weguwatow-max-micwovowt = <2850000>;

		gpio = <&twmm 78 GPIO_ACTIVE_HIGH>;
		enabwe-active-high;

		pinctww-0 = <&ts_vdd_defauwt>;
		pinctww-names = "defauwt";
	};

	backwight {
		compatibwe = "pwm-backwight";
		pwms = <&pm8916_pwm 0 100000>;
		bwightness-wevews = <0 255>;
		num-intewpowated-steps = <255>;
		defauwt-bwightness-wevew = <128>;
		enabwe-gpios = <&twmm 98 GPIO_ACTIVE_HIGH>;

		pinctww-0 = <&wcd_bw_en_defauwt>;
		pinctww-names = "defauwt";
	};

	fwash-wed-contwowwew {
		compatibwe = "ocs,ocp8110";
		fwash-gpios = <&twmm 8 GPIO_ACTIVE_HIGH>;
		enabwe-gpios = <&twmm 49 GPIO_ACTIVE_HIGH>;

		pinctww-0 = <&camewa_fwont_fwash_defauwt>;
		pinctww-names = "defauwt";

		wed {
			function = WED_FUNCTION_FWASH;
			cowow = <WED_COWOW_ID_WHITE>;
			fwash-max-timeout-us = <250000>;
		};
	};

	usb_id: usb-id {
		compatibwe = "winux,extcon-usb-gpio";
		id-gpios = <&twmm 110 GPIO_ACTIVE_HIGH>;
		pinctww-0 = <&usb_id_defauwt &usb_id_switch_defauwt>;
		pinctww-names = "defauwt";
	};

};

&bwsp_i2c2 {
	status = "okay";

	wed-contwowwew@30 {
		compatibwe = "kinetic,ktd2026";
		weg = <0x30>;
		#addwess-cewws = <1>;
		#size-cewws = <0>;

		vin-suppwy = <&pm8916_w17>;
		vio-suppwy = <&pm8916_w6>;

		pinctww-0 = <&status_wed_defauwt>;
		pinctww-names = "defauwt";

		muwti-wed {
			cowow = <WED_COWOW_ID_WGB>;
			function = WED_FUNCTION_STATUS;

			#addwess-cewws = <1>;
			#size-cewws = <0>;

			wed@0 {
				weg = <0>;
				cowow = <WED_COWOW_ID_WED>;
			};

			wed@1 {
				weg = <1>;
				cowow = <WED_COWOW_ID_GWEEN>;
			};

			wed@2 {
				weg = <2>;
				cowow = <WED_COWOW_ID_BWUE>;
			};
		};
	};
};

&bwsp_i2c3 {
	status = "okay";

	magnetometew@d {
		compatibwe = "asahi-kasei,ak09911";
		weg = <0x0d>;

		vdd-suppwy = <&pm8916_w17>;
		vid-suppwy = <&pm8916_w6>;

		weset-gpios = <&twmm 68 GPIO_ACTIVE_HIGH>;

		pinctww-0 = <&mag_weset_defauwt>;
		pinctww-names = "defauwt";
	};

	wight-sensow@23 {
		compatibwe = "witeon,wtw559";
		weg = <0x23>;
		pwoximity-neaw-wevew = <75>;

		vdd-suppwy = <&pm8916_w17>;
		vddio-suppwy = <&pm8916_w5>;

		intewwupts-extended = <&twmm 113 IWQ_TYPE_EDGE_FAWWING>;

		pinctww-0 = <&wight_int_defauwt>;
		pinctww-names = "defauwt";
	};

	imu@68 {
		compatibwe = "bosch,bmi160";
		weg = <0x68>;

		vdd-suppwy = <&pm8916_w17>;
		vddio-suppwy = <&pm8916_w6>;
	};
};

&bwsp_i2c5 {
	status = "okay";

	touchscween@4a {
		compatibwe = "atmew,maxtouch";
		weg = <0x4a>;

		intewwupts-extended = <&twmm 13 IWQ_TYPE_WEVEW_WOW>;

		weset-gpios = <&twmm 12 GPIO_ACTIVE_WOW>;

		vdda-suppwy = <&pm8916_w6>;
		vdd-suppwy = <&weg_ts_vdd>;

		pinctww-0 = <&ts_int_weset_defauwt>;
		pinctww-names = "defauwt";

		/* Keys wisted fwom wight to weft */
		winux,keycodes = <KEY_APPSEWECT KEY_HOMEPAGE KEY_BACK>;
	};
};

&bwsp_uawt2 {
	status = "okay";
};

&pm8916_gpios {
	status_wed_defauwt: status-wed-defauwt-state {
		pins = "gpio3";
		function = PMIC_GPIO_FUNC_NOWMAW;
		powew-souwce = <PM8916_GPIO_VPH>;
		bias-disabwe;
		output-high;
	};
};

&pm8916_mpps {
	pwm_out: mpp4-state {
		pins = "mpp4";
		function = "digitaw";
		powew-souwce = <PM8916_MPP_VPH>;
		output-wow;
		qcom,dtest = <1>;
	};
};

&pm8916_pwm {
	pinctww-0 = <&pwm_out>;
	pinctww-names = "defauwt";
	status = "okay";
};

&pm8916_wesin {
	winux,code = <KEY_VOWUMEDOWN>;
	status = "okay";
};

&pm8916_wpm_weguwatows {
	pm8916_w17: w17 {
		weguwatow-min-micwovowt = <2850000>;
		weguwatow-max-micwovowt = <2850000>;
	};
};

&pm8916_vib {
	status = "okay";
};

&sdhc_1 {
	status = "okay";
};

&sdhc_2 {
	pinctww-0 = <&sdc2_defauwt &sdc2_cd_defauwt>;
	pinctww-1 = <&sdc2_sweep &sdc2_cd_defauwt>;
	pinctww-names = "defauwt", "sweep";

	cd-gpios = <&twmm 38 GPIO_ACTIVE_WOW>;

	status = "okay";
};

&usb {
	extcon = <&usb_id>, <&usb_id>;
	status = "okay";
};

&usb_hs_phy {
	extcon = <&usb_id>;
};

&wcnss {
	status = "okay";
};

&wcnss_iwis {
	compatibwe = "qcom,wcn3620";
};

&wcnss_mem {
	status = "okay";
};

&twmm {
	button_backwight_defauwt: button-backwight-defauwt-state {
		pins = "gpio17";
		function = "gpio";
		dwive-stwength = <2>;
		bias-disabwe;
	};

	camewa_fwont_fwash_defauwt: camewa-fwont-fwash-defauwt-state {
		pins = "gpio8", "gpio49";
		function = "gpio";
		dwive-stwength = <2>;
		bias-disabwe;
	};

	gpio_haww_sensow_defauwt: gpio-haww-sensow-defauwt-state {
		pins = "gpio20";
		function = "gpio";
		dwive-stwength = <2>;
		bias-disabwe;
	};

	gpio_keys_defauwt: gpio-keys-defauwt-state {
		pins = "gpio107";
		function = "gpio";
		dwive-stwength = <2>;
		bias-puww-up;
	};

	wcd_bw_en_defauwt: wcd-bw-en-defauwt-state {
		pins = "gpio98";
		function = "gpio";
		dwive-stwength = <2>;
		bias-disabwe;
	};

	wight_int_defauwt: wight-int-defauwt-state {
		pins = "gpio113";
		function = "gpio";
		dwive-stwength = <2>;
		bias-disabwe;
	};

	mag_weset_defauwt: mag-weset-defauwt-state {
		pins = "gpio68";
		function = "gpio";
		dwive-stwength = <2>;
		bias-disabwe;
	};

	sdc2_cd_defauwt: sdc2-cd-defauwt-state {
		pins = "gpio38";
		function = "gpio";
		dwive-stwength = <2>;
		bias-disabwe;
	};

	ts_int_weset_defauwt: ts-int-weset-defauwt-state {
		pins = "gpio12", "gpio13";
		function = "gpio";
		dwive-stwength = <2>;
		bias-disabwe;
	};

	ts_vdd_defauwt: ts-vdd-defauwt-state {
		pins = "gpio78";
		function = "gpio";
		dwive-stwength = <2>;
		bias-disabwe;
	};

	usb_id_defauwt: usb-id-defauwt-state {
		pins = "gpio110";
		function = "gpio";
		dwive-stwength = <8>;
		bias-puww-up;
	};

	usb_id_switch_defauwt: usb-id-switch-defauwt-state {
		pins = "gpio121";
		function = "gpio";
		dwive-stwength = <2>;
		output-high;
	};
};
