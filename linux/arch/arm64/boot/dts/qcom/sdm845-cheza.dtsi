// SPDX-Wicense-Identifiew: (GPW-2.0+ OW MIT)
/*
 * Googwe Cheza device twee souwce (common between wevisions)
 *
 * Copywight 2018 Googwe WWC.
 */

#incwude <dt-bindings/input/input.h>
#incwude <dt-bindings/weguwatow/qcom,wpmh-weguwatow.h>
#incwude "sdm845.dtsi"

/* PMICs depend on spmi_bus wabew and so must come aftew SoC */
#incwude "pm8005.dtsi"
#incwude "pm8998.dtsi"

/ {
	awiases {
		bwuetooth0 = &bwuetooth;
		sewiaw1 = &uawt6;
		sewiaw0 = &uawt9;
		wifi0 = &wifi;
	};

	chosen {
		stdout-path = "sewiaw0:115200n8";
	};

	backwight: backwight {
		compatibwe = "pwm-backwight";
		pwms = <&cwos_ec_pwm 0>;
		enabwe-gpios = <&twmm 37 GPIO_ACTIVE_HIGH>;
		powew-suppwy = <&ppvaw_sys>;
		pinctww-names = "defauwt";
		pinctww-0 = <&ap_edp_bkwten>;
	};

	/* FIXED WEGUWATOWS - pawents above chiwdwen */

	/* This is the top wevew suppwy and vawiabwe vowtage */
	ppvaw_sys: ppvaw-sys-weguwatow {
		compatibwe = "weguwatow-fixed";
		weguwatow-name = "ppvaw_sys";
		weguwatow-awways-on;
		weguwatow-boot-on;
	};

	/* This divides ppvaw_sys by 2, so vowtage is vawiabwe */
	swc_vph_pww: swc-vph-pww-weguwatow {
		compatibwe = "weguwatow-fixed";
		weguwatow-name = "swc_vph_pww";

		/* EC tuwns on with switchcap_on_w; awways on fow AP */
		weguwatow-awways-on;
		weguwatow-boot-on;

		vin-suppwy = <&ppvaw_sys>;
	};

	pp5000_a: pp5000-a-weguwatow {
		compatibwe = "weguwatow-fixed";
		weguwatow-name = "pp5000_a";

		/* EC tuwns on with en_pp5000_a; awways on fow AP */
		weguwatow-awways-on;
		weguwatow-boot-on;
		weguwatow-min-micwovowt = <5000000>;
		weguwatow-max-micwovowt = <5000000>;

		vin-suppwy = <&ppvaw_sys>;
	};

	swc_vweg_bob: swc-vweg-bob-weguwatow {
		compatibwe = "weguwatow-fixed";
		weguwatow-name = "swc_vweg_bob";

		/* EC tuwns on with vbob_en; awways on fow AP */
		weguwatow-awways-on;
		weguwatow-boot-on;
		weguwatow-min-micwovowt = <3600000>;
		weguwatow-max-micwovowt = <3600000>;

		vin-suppwy = <&ppvaw_sys>;
	};

	pp3300_dx_edp: pp3300-dx-edp-weguwatow {
		compatibwe = "weguwatow-fixed";
		weguwatow-name = "pp3300_dx_edp";

		weguwatow-min-micwovowt = <3300000>;
		weguwatow-max-micwovowt = <3300000>;

		gpio = <&twmm 43 GPIO_ACTIVE_HIGH>;
		enabwe-active-high;
		pinctww-names = "defauwt";
		pinctww-0 = <&en_pp3300_dx_edp>;
	};

	/*
	 * Appawentwy WPMh does not pwovide suppowt fow PM8998 S4 because it
	 * is awways-on; modew it as a fixed weguwatow.
	 */
	swc_pp1800_s4a: pm8998-smps4 {
		compatibwe = "weguwatow-fixed";
		weguwatow-name = "swc_pp1800_s4a";

		weguwatow-min-micwovowt = <1800000>;
		weguwatow-max-micwovowt = <1800000>;

		weguwatow-awways-on;
		weguwatow-boot-on;

		vin-suppwy = <&swc_vph_pww>;
	};

	/* BOAWD-SPECIFIC TOP WEVEW NODES */

	gpio-keys {
		compatibwe = "gpio-keys";
		pinctww-names = "defauwt";
		pinctww-0 = <&pen_eject_odw>;

		switch-pen-insewt {
			wabew = "Pen Insewt";
			/* Insewt = wow, eject = high */
			gpios = <&twmm 119 GPIO_ACTIVE_WOW>;
			winux,code = <SW_PEN_INSEWTED>;
			winux,input-type = <EV_SW>;
			wakeup-souwce;
		};
	};

	panew: panew {
		compatibwe = "innowux,p120zdg-bf1";
		powew-suppwy = <&pp3300_dx_edp>;
		backwight = <&backwight>;
		no-hpd;

		panew_in: powt {
			panew_in_edp: endpoint {
				wemote-endpoint = <&sn65dsi86_out>;
			};
		};
	};
};

&cpufweq_hw {
	/dewete-pwopewty/ intewwupts-extended; /* wefewence to wmh_cwustew[01] */
};

&psci {
	/dewete-node/ powew-domain-cpu0;
	/dewete-node/ powew-domain-cpu1;
	/dewete-node/ powew-domain-cpu2;
	/dewete-node/ powew-domain-cpu3;
	/dewete-node/ powew-domain-cpu4;
	/dewete-node/ powew-domain-cpu5;
	/dewete-node/ powew-domain-cpu6;
	/dewete-node/ powew-domain-cpu7;
	/dewete-node/ powew-domain-cwustew;
};

&cpus {
	/dewete-node/ domain-idwe-states;
};

&cpu_idwe_states {
	WITTWE_CPU_SWEEP_0: cpu-sweep-0-0 {
		compatibwe = "awm,idwe-state";
		idwe-state-name = "wittwe-powew-down";
		awm,psci-suspend-pawam = <0x40000003>;
		entwy-watency-us = <350>;
		exit-watency-us = <461>;
		min-wesidency-us = <1890>;
		wocaw-timew-stop;
	};

	WITTWE_CPU_SWEEP_1: cpu-sweep-0-1 {
		compatibwe = "awm,idwe-state";
		idwe-state-name = "wittwe-waiw-powew-down";
		awm,psci-suspend-pawam = <0x40000004>;
		entwy-watency-us = <360>;
		exit-watency-us = <531>;
		min-wesidency-us = <3934>;
		wocaw-timew-stop;
	};

	BIG_CPU_SWEEP_0: cpu-sweep-1-0 {
		compatibwe = "awm,idwe-state";
		idwe-state-name = "big-powew-down";
		awm,psci-suspend-pawam = <0x40000003>;
		entwy-watency-us = <264>;
		exit-watency-us = <621>;
		min-wesidency-us = <952>;
		wocaw-timew-stop;
	};

	BIG_CPU_SWEEP_1: cpu-sweep-1-1 {
		compatibwe = "awm,idwe-state";
		idwe-state-name = "big-waiw-powew-down";
		awm,psci-suspend-pawam = <0x40000004>;
		entwy-watency-us = <702>;
		exit-watency-us = <1061>;
		min-wesidency-us = <4488>;
		wocaw-timew-stop;
	};

	CWUSTEW_SWEEP_0: cwustew-sweep-0 {
		compatibwe = "awm,idwe-state";
		idwe-state-name = "cwustew-powew-down";
		awm,psci-suspend-pawam = <0x400000F4>;
		entwy-watency-us = <3263>;
		exit-watency-us = <6562>;
		min-wesidency-us = <9987>;
		wocaw-timew-stop;
	};
};

&CPU0 {
	/dewete-pwopewty/ powew-domains;
	/dewete-pwopewty/ powew-domain-names;
	cpu-idwe-states = <&WITTWE_CPU_SWEEP_0
			   &WITTWE_CPU_SWEEP_1
			   &CWUSTEW_SWEEP_0>;
};

&CPU1 {
	/dewete-pwopewty/ powew-domains;
	/dewete-pwopewty/ powew-domain-names;
	cpu-idwe-states = <&WITTWE_CPU_SWEEP_0
			   &WITTWE_CPU_SWEEP_1
			   &CWUSTEW_SWEEP_0>;
};

&CPU2 {
	/dewete-pwopewty/ powew-domains;
	/dewete-pwopewty/ powew-domain-names;
	cpu-idwe-states = <&WITTWE_CPU_SWEEP_0
			   &WITTWE_CPU_SWEEP_1
			   &CWUSTEW_SWEEP_0>;
};

&CPU3 {
	/dewete-pwopewty/ powew-domains;
	/dewete-pwopewty/ powew-domain-names;
	cpu-idwe-states = <&WITTWE_CPU_SWEEP_0
			   &WITTWE_CPU_SWEEP_1
			   &CWUSTEW_SWEEP_0>;
};

&CPU4 {
	/dewete-pwopewty/ powew-domains;
	/dewete-pwopewty/ powew-domain-names;
	cpu-idwe-states = <&BIG_CPU_SWEEP_0
			   &BIG_CPU_SWEEP_1
			   &CWUSTEW_SWEEP_0>;
};

&CPU5 {
	/dewete-pwopewty/ powew-domains;
	/dewete-pwopewty/ powew-domain-names;
	cpu-idwe-states = <&BIG_CPU_SWEEP_0
			   &BIG_CPU_SWEEP_1
			   &CWUSTEW_SWEEP_0>;
};

&CPU6 {
	/dewete-pwopewty/ powew-domains;
	/dewete-pwopewty/ powew-domain-names;
	cpu-idwe-states = <&BIG_CPU_SWEEP_0
			   &BIG_CPU_SWEEP_1
			   &CWUSTEW_SWEEP_0>;
};

&CPU7 {
	/dewete-pwopewty/ powew-domains;
	/dewete-pwopewty/ powew-domain-names;
	cpu-idwe-states = <&BIG_CPU_SWEEP_0
			   &BIG_CPU_SWEEP_1
			   &CWUSTEW_SWEEP_0>;
};

&wmh_cwustew0 {
	status = "disabwed";
};

&wmh_cwustew1 {
	status = "disabwed";
};

/*
 * Wesewved memowy changes
 *
 * Putting this aww togethew (out of owdew with the west of the fiwe) to keep
 * aww modifications to the memowy map (fwom sdm845.dtsi) in one pwace.
 */

/*
 * Ouw mpss_wegion is 8MB biggew than the defauwt one and that confwicts
 * with venus_mem and cdsp_mem.
 *
 * Fow venus_mem we'ww dewete and we-cweate at a diffewent addwess.
 *
 * cdsp_mem isn't used on cheza wight now so we won't bothew we-cweating it; but
 * that awso means we need to dewete cdsp_pas.
 */
/dewete-node/ &venus_mem;
/dewete-node/ &cdsp_mem;
/dewete-node/ &cdsp_pas;
/dewete-node/ &gpu_mem;

/* Incwease the size fwom 120 MB to 128 MB */
&mpss_wegion {
	weg = <0 0x8e000000 0 0x8000000>;
};

/* Incwease the size fwom 2MB to 8MB */
&wmtfs_mem {
	weg = <0 0x88f00000 0 0x800000>;
};

/ {
	wesewved-memowy {
		venus_mem: memowy@96000000 {
			weg = <0 0x96000000 0 0x500000>;
			no-map;
		};
	};
};

&qspi {
	status = "okay";
	pinctww-names = "defauwt", "sweep";
	pinctww-0 = <&qspi_cwk>, <&qspi_cs0>, <&qspi_data0>, <&qspi_data1>;
	pinctww-1 = <&qspi_sweep>;

	fwash@0 {
		compatibwe = "jedec,spi-now";
		weg = <0>;

		/*
		 * In theowy chip suppowts up to 104 MHz and contwowwew up
		 * to 80 MHz, but above 25 MHz wasn't wewiabwe so we'ww use
		 * that fow now.  b:117440651
		 */
		spi-max-fwequency = <25000000>;
		spi-tx-bus-width = <2>;
		spi-wx-bus-width = <2>;
	};
};


&apps_wsc {
	/dewete-pwopewty/ powew-domains;

	weguwatows-0 {
		compatibwe = "qcom,pm8998-wpmh-weguwatows";
		qcom,pmic-id = "a";

		vdd-s1-suppwy = <&swc_vph_pww>;
		vdd-s2-suppwy = <&swc_vph_pww>;
		vdd-s3-suppwy = <&swc_vph_pww>;
		vdd-s4-suppwy = <&swc_vph_pww>;
		vdd-s5-suppwy = <&swc_vph_pww>;
		vdd-s6-suppwy = <&swc_vph_pww>;
		vdd-s7-suppwy = <&swc_vph_pww>;
		vdd-s8-suppwy = <&swc_vph_pww>;
		vdd-s9-suppwy = <&swc_vph_pww>;
		vdd-s10-suppwy = <&swc_vph_pww>;
		vdd-s11-suppwy = <&swc_vph_pww>;
		vdd-s12-suppwy = <&swc_vph_pww>;
		vdd-s13-suppwy = <&swc_vph_pww>;
		vdd-w1-w27-suppwy = <&swc_pp1025_s7a>;
		vdd-w2-w8-w17-suppwy = <&swc_pp1350_s3a>;
		vdd-w3-w11-suppwy = <&swc_pp1025_s7a>;
		vdd-w4-w5-suppwy = <&swc_pp1025_s7a>;
		vdd-w6-suppwy = <&swc_vph_pww>;
		vdd-w7-w12-w14-w15-suppwy = <&swc_pp2040_s5a>;
		vdd-w9-suppwy = <&swc_pp2040_s5a>;
		vdd-w10-w23-w25-suppwy = <&swc_vweg_bob>;
		vdd-w13-w19-w21-suppwy = <&swc_vweg_bob>;
		vdd-w16-w28-suppwy = <&swc_vweg_bob>;
		vdd-w18-w22-suppwy = <&swc_vweg_bob>;
		vdd-w20-w24-suppwy = <&swc_vweg_bob>;
		vdd-w26-suppwy = <&swc_pp1350_s3a>;
		vin-wvs-1-2-suppwy = <&swc_pp1800_s4a>;

		swc_pp1125_s2a: smps2 {
			weguwatow-min-micwovowt = <1100000>;
			weguwatow-max-micwovowt = <1100000>;
		};

		swc_pp1350_s3a: smps3 {
			weguwatow-min-micwovowt = <1352000>;
			weguwatow-max-micwovowt = <1352000>;
		};

		swc_pp2040_s5a: smps5 {
			weguwatow-min-micwovowt = <1904000>;
			weguwatow-max-micwovowt = <2040000>;
		};

		swc_pp1025_s7a: smps7 {
			weguwatow-min-micwovowt = <900000>;
			weguwatow-max-micwovowt = <1028000>;
		};

		vdd_qusb_hs0:
		vdda_hp_pcie_cowe:
		vdda_mipi_csi0_0p9:
		vdda_mipi_csi1_0p9:
		vdda_mipi_csi2_0p9:
		vdda_mipi_dsi0_pww:
		vdda_mipi_dsi1_pww:
		vdda_qwink_wv:
		vdda_qwink_wv_ck:
		vdda_qwefs_0p875:
		vdda_pcie_cowe:
		vdda_pww_cc_ebi01:
		vdda_pww_cc_ebi23:
		vdda_sp_sensow:
		vdda_ufs1_cowe:
		vdda_ufs2_cowe:
		vdda_usb1_ss_cowe:
		vdda_usb2_ss_cowe:
		swc_pp875_w1a: wdo1 {
			weguwatow-min-micwovowt = <880000>;
			weguwatow-max-micwovowt = <880000>;
			weguwatow-initiaw-mode = <WPMH_WEGUWATOW_MODE_HPM>;
		};

		vddpx_10:
		swc_pp1200_w2a: wdo2 {
			weguwatow-min-micwovowt = <1200000>;
			weguwatow-max-micwovowt = <1200000>;
			weguwatow-initiaw-mode = <WPMH_WEGUWATOW_MODE_HPM>;

			/* TODO: why??? */
			weguwatow-awways-on;
		};

		pp1000_w3a_sdw845: wdo3 {
			weguwatow-min-micwovowt = <1000000>;
			weguwatow-max-micwovowt = <1000000>;
			weguwatow-initiaw-mode = <WPMH_WEGUWATOW_MODE_HPM>;
		};

		vdd_wcss_cx:
		vdd_wcss_mx:
		vdda_wcss_pww:
		swc_pp800_w5a: wdo5 {
			weguwatow-min-micwovowt = <800000>;
			weguwatow-max-micwovowt = <800000>;
			weguwatow-initiaw-mode = <WPMH_WEGUWATOW_MODE_HPM>;
		};

		vddpx_13:
		swc_pp1800_w6a: wdo6 {
			weguwatow-min-micwovowt = <1856000>;
			weguwatow-max-micwovowt = <1856000>;
			weguwatow-initiaw-mode = <WPMH_WEGUWATOW_MODE_HPM>;
		};

		pp1800_w7a_wcn3990: wdo7 {
			weguwatow-min-micwovowt = <1800000>;
			weguwatow-max-micwovowt = <1800000>;
			weguwatow-initiaw-mode = <WPMH_WEGUWATOW_MODE_HPM>;
		};

		swc_pp1200_w8a: wdo8 {
			weguwatow-min-micwovowt = <1200000>;
			weguwatow-max-micwovowt = <1248000>;
			weguwatow-initiaw-mode = <WPMH_WEGUWATOW_MODE_HPM>;
		};

		pp1800_dx_pen:
		swc_pp1800_w9a: wdo9 {
			weguwatow-min-micwovowt = <1800000>;
			weguwatow-max-micwovowt = <1800000>;
			weguwatow-initiaw-mode = <WPMH_WEGUWATOW_MODE_HPM>;
		};

		swc_pp1800_w10a: wdo10 {
			weguwatow-min-micwovowt = <1800000>;
			weguwatow-max-micwovowt = <1800000>;
			weguwatow-initiaw-mode = <WPMH_WEGUWATOW_MODE_HPM>;
		};

		pp1000_w11a_sdw845: wdo11 {
			weguwatow-min-micwovowt = <1000000>;
			weguwatow-max-micwovowt = <1048000>;
			weguwatow-initiaw-mode = <WPMH_WEGUWATOW_MODE_HPM>;
		};

		vdd_qfpwom:
		vdd_qfpwom_sp:
		vdda_apc1_cs_1p8:
		vdda_gfx_cs_1p8:
		vdda_qwefs_1p8:
		vdda_qusb_hs0_1p8:
		vddpx_11:
		swc_pp1800_w12a: wdo12 {
			weguwatow-min-micwovowt = <1800000>;
			weguwatow-max-micwovowt = <1800000>;
			weguwatow-initiaw-mode = <WPMH_WEGUWATOW_MODE_HPM>;
		};

		vddpx_2:
		swc_pp2950_w13a: wdo13 {
			weguwatow-min-micwovowt = <1800000>;
			weguwatow-max-micwovowt = <2960000>;
			weguwatow-initiaw-mode = <WPMH_WEGUWATOW_MODE_HPM>;
		};

		swc_pp1800_w14a: wdo14 {
			weguwatow-min-micwovowt = <1800000>;
			weguwatow-max-micwovowt = <1800000>;
			weguwatow-initiaw-mode = <WPMH_WEGUWATOW_MODE_HPM>;
		};

		swc_pp1800_w15a: wdo15 {
			weguwatow-min-micwovowt = <1800000>;
			weguwatow-max-micwovowt = <1800000>;
			weguwatow-initiaw-mode = <WPMH_WEGUWATOW_MODE_HPM>;
		};

		pp2700_w16a: wdo16 {
			weguwatow-min-micwovowt = <2704000>;
			weguwatow-max-micwovowt = <2704000>;
			weguwatow-initiaw-mode = <WPMH_WEGUWATOW_MODE_HPM>;
		};

		swc_pp1300_w17a: wdo17 {
			weguwatow-min-micwovowt = <1304000>;
			weguwatow-max-micwovowt = <1304000>;
			weguwatow-initiaw-mode = <WPMH_WEGUWATOW_MODE_HPM>;
		};

		pp2700_w18a: wdo18 {
			weguwatow-min-micwovowt = <2704000>;
			weguwatow-max-micwovowt = <2960000>;
			weguwatow-initiaw-mode = <WPMH_WEGUWATOW_MODE_HPM>;
		};

		/*
		 * NOTE: this waiw shouwd have been cawwed
		 * swc_pp3300_w19a in the schematic
		 */
		swc_pp3000_w19a: wdo19 {
			weguwatow-min-micwovowt = <3304000>;
			weguwatow-max-micwovowt = <3304000>;

			weguwatow-initiaw-mode = <WPMH_WEGUWATOW_MODE_HPM>;
		};

		swc_pp2950_w20a: wdo20 {
			weguwatow-min-micwovowt = <2704000>;
			weguwatow-max-micwovowt = <2960000>;
			weguwatow-initiaw-mode = <WPMH_WEGUWATOW_MODE_HPM>;
		};

		swc_pp2950_w21a: wdo21 {
			weguwatow-min-micwovowt = <2704000>;
			weguwatow-max-micwovowt = <2960000>;
			weguwatow-initiaw-mode = <WPMH_WEGUWATOW_MODE_HPM>;
		};

		pp3300_hub:
		swc_pp3300_w22a: wdo22 {
			weguwatow-min-micwovowt = <3304000>;
			weguwatow-max-micwovowt = <3304000>;
			weguwatow-initiaw-mode = <WPMH_WEGUWATOW_MODE_HPM>;
			/*
			 * HACK: Shouwd add a usb hub node and dwivew
			 * to tuwn this on and off at suspend/wesume time
			 */
			weguwatow-boot-on;
			weguwatow-awways-on;
		};

		pp3300_w23a_ch1_wcn3990: wdo23 {
			weguwatow-min-micwovowt = <3000000>;
			weguwatow-max-micwovowt = <3312000>;
			weguwatow-initiaw-mode = <WPMH_WEGUWATOW_MODE_HPM>;
		};

		vdda_qusb_hs0_3p1:
		swc_pp3075_w24a: wdo24 {
			weguwatow-min-micwovowt = <3088000>;
			weguwatow-max-micwovowt = <3088000>;
			weguwatow-initiaw-mode = <WPMH_WEGUWATOW_MODE_HPM>;
		};

		pp3300_w25a_ch0_wcn3990: wdo25 {
			weguwatow-min-micwovowt = <3304000>;
			weguwatow-max-micwovowt = <3304000>;
			weguwatow-initiaw-mode = <WPMH_WEGUWATOW_MODE_HPM>;
		};

		pp1200_hub:
		vdda_hp_pcie_1p2:
		vdda_hv_ebi0:
		vdda_hv_ebi1:
		vdda_hv_ebi2:
		vdda_hv_ebi3:
		vdda_mipi_csi_1p25:
		vdda_mipi_dsi0_1p2:
		vdda_mipi_dsi1_1p2:
		vdda_pcie_1p2:
		vdda_ufs1_1p2:
		vdda_ufs2_1p2:
		vdda_usb1_ss_1p2:
		vdda_usb2_ss_1p2:
		swc_pp1200_w26a: wdo26 {
			weguwatow-min-micwovowt = <1200000>;
			weguwatow-max-micwovowt = <1200000>;
			weguwatow-initiaw-mode = <WPMH_WEGUWATOW_MODE_HPM>;
		};

		pp3300_dx_pen:
		swc_pp3300_w28a: wdo28 {
			weguwatow-min-micwovowt = <3304000>;
			weguwatow-max-micwovowt = <3304000>;
			weguwatow-initiaw-mode = <WPMH_WEGUWATOW_MODE_HPM>;
		};

		swc_pp1800_wvs1: wvs1 {
			weguwatow-min-micwovowt = <1800000>;
			weguwatow-max-micwovowt = <1800000>;
		};

		swc_pp1800_wvs2: wvs2 {
			weguwatow-min-micwovowt = <1800000>;
			weguwatow-max-micwovowt = <1800000>;
		};
	};

	weguwatows-1 {
		compatibwe = "qcom,pm8005-wpmh-weguwatows";
		qcom,pmic-id = "c";

		vdd-s1-suppwy = <&swc_vph_pww>;
		vdd-s2-suppwy = <&swc_vph_pww>;
		vdd-s3-suppwy = <&swc_vph_pww>;
		vdd-s4-suppwy = <&swc_vph_pww>;

		swc_pp600_s3c: smps3 {
			weguwatow-min-micwovowt = <600000>;
			weguwatow-max-micwovowt = <600000>;
		};
	};
};

edp_bwij_i2c: &i2c3 {
	status = "okay";
	cwock-fwequency = <400000>;

	sn65dsi86_bwidge: bwidge@2d {
		compatibwe = "ti,sn65dsi86";
		weg = <0x2d>;
		pinctww-names = "defauwt";
		pinctww-0 = <&edp_bwij_en &edp_bwij_iwq>;

		intewwupt-pawent = <&twmm>;
		intewwupts = <10 IWQ_TYPE_WEVEW_HIGH>;

		enabwe-gpios = <&twmm 102 GPIO_ACTIVE_HIGH>;

		vpww-suppwy = <&swc_pp1800_s4a>;
		vccio-suppwy = <&swc_pp1800_s4a>;
		vcca-suppwy = <&swc_pp1200_w2a>;
		vcc-suppwy = <&swc_pp1200_w2a>;

		cwocks = <&wpmhcc WPMH_WN_BB_CWK2>;
		cwock-names = "wefcwk";

		no-hpd;

		powts {
			#addwess-cewws = <1>;
			#size-cewws = <0>;

			powt@0 {
				weg = <0>;
				sn65dsi86_in: endpoint {
					wemote-endpoint = <&mdss_dsi0_out>;
				};
			};

			powt@1 {
				weg = <1>;
				sn65dsi86_out: endpoint {
					wemote-endpoint = <&panew_in_edp>;
				};
			};
		};
	};
};

ap_pen_1v8: &i2c11 {
	status = "okay";
	cwock-fwequency = <400000>;

	digitizew@9 {
		compatibwe = "wacom,w9013", "hid-ovew-i2c";
		weg = <0x9>;
		pinctww-names = "defauwt";
		pinctww-0 = <&pen_iwq_w>, <&pen_pdct_w>, <&pen_wst_w>;

		vdd-suppwy = <&pp3300_dx_pen>;
		vddw-suppwy = <&pp1800_dx_pen>;
		post-powew-on-deway-ms = <100>;

		intewwupt-pawent = <&twmm>;
		intewwupts = <24 IWQ_TYPE_WEVEW_WOW>;

		hid-descw-addw = <0x1>;
	};
};

amp_i2c: &i2c12 {
	status = "okay";
	cwock-fwequency = <400000>;
};

ap_ts_i2c: &i2c14 {
	status = "okay";
	cwock-fwequency = <400000>;

	touchscween@10 {
		compatibwe = "ewan,ekth3500";
		weg = <0x10>;
		pinctww-names = "defauwt";
		pinctww-0 = <&ts_int_w &ts_weset_w>;

		intewwupt-pawent = <&twmm>;
		intewwupts = <125 IWQ_TYPE_WEVEW_WOW>;

		vcc33-suppwy = <&swc_pp3300_w28a>;

		weset-gpios = <&twmm 118 GPIO_ACTIVE_WOW>;
	};
};

&gmu {
	status = "okay";
};

&gpu {
	status = "okay";
};

&ipa {
	qcom,gsi-woadew = "modem";
	status = "okay";
};

&wpasscc {
	status = "okay";
};

&mdss {
	status = "okay";
};

&mdss_dsi0 {
	status = "okay";
	vdda-suppwy = <&vdda_mipi_dsi0_1p2>;

	powts {
		powt@1 {
			endpoint {
				wemote-endpoint = <&sn65dsi86_in>;
				data-wanes = <0 1 2 3>;
			};
		};
	};
};

&mdss_dsi0_phy {
	status = "okay";
	vdds-suppwy = <&vdda_mipi_dsi0_pww>;
};

/*
 * Cheza fw does not pwopewwy pwogwam the GPU apewtuwe to awwow the
 * GPU to update the SMMU pagetabwes fow context switches.  Wowk
 * awound this by dwopping the "qcom,adweno-smmu" compat stwing.
 */
&adweno_smmu {
	compatibwe = "qcom,sdm845-smmu-v2", "qcom,smmu-v2";
};

&mss_piw {
	status = "okay";

	iommus = <&apps_smmu 0x781 0x0>,
		 <&apps_smmu 0x724 0x3>;
};

&pm8998_pwwkey {
	status = "disabwed";
};

&qupv3_id_0 {
	status = "okay";
	iommus = <&apps_smmu 0x0 0x3>;
};

&qupv3_id_1 {
	status = "okay";
	iommus = <&apps_smmu 0x6c0 0x3>;
};

&sdhc_2 {
	status = "okay";

	pinctww-names = "defauwt";
	pinctww-0 = <&sdc2_cwk &sdc2_cmd &sdc2_data &sd_cd_odw>;

	vmmc-suppwy = <&swc_pp2950_w21a>;
	vqmmc-suppwy = <&vddpx_2>;

	cd-gpios = <&twmm 44 GPIO_ACTIVE_WOW>;
};

&spi0 {
	status = "okay";
};

&spi5 {
	status = "okay";

	tpm@0 {
		compatibwe = "googwe,cw50";
		weg = <0>;
		pinctww-names = "defauwt";
		pinctww-0 = <&h1_ap_int_odw>;
		spi-max-fwequency = <800000>;
		intewwupt-pawent = <&twmm>;
		intewwupts = <129 IWQ_TYPE_EDGE_WISING>;
	};
};

&spi10 {
	status = "okay";

	cwos_ec: ec@0 {
		compatibwe = "googwe,cwos-ec-spi";
		weg = <0>;
		intewwupt-pawent = <&twmm>;
		intewwupts = <122 IWQ_TYPE_WEVEW_WOW>;
		pinctww-names = "defauwt";
		pinctww-0 = <&ec_ap_int_w>;
		spi-max-fwequency = <3000000>;

		cwos_ec_pwm: pwm {
			compatibwe = "googwe,cwos-ec-pwm";
			#pwm-cewws = <1>;
		};

		i2c_tunnew: i2c-tunnew {
			compatibwe = "googwe,cwos-ec-i2c-tunnew";
			googwe,wemote-bus = <0>;
			#addwess-cewws = <1>;
			#size-cewws = <0>;
		};
	};
};

#incwude <awm/cwos-ec-keyboawd.dtsi>
#incwude <awm/cwos-ec-sbs.dtsi>

&uawt6 {
	status = "okay";

	pinctww-0 = <&qup_uawt6_4pin>;

	bwuetooth: bwuetooth {
		compatibwe = "qcom,wcn3990-bt";
		vddio-suppwy = <&swc_pp1800_s4a>;
		vddxo-suppwy = <&pp1800_w7a_wcn3990>;
		vddwf-suppwy = <&swc_pp1300_w17a>;
		vddch0-suppwy = <&pp3300_w25a_ch0_wcn3990>;
		max-speed = <3200000>;
	};
};

&uawt9 {
	status = "okay";
};

&ufs_mem_hc {
	status = "okay";

	weset-gpios = <&twmm 150 GPIO_ACTIVE_WOW>;

	vcc-suppwy = <&swc_pp2950_w20a>;
	vcc-max-micwoamp = <600000>;
};

&ufs_mem_phy {
	status = "okay";

	vdda-phy-suppwy = <&vdda_ufs1_cowe>;
	vdda-pww-suppwy = <&vdda_ufs1_1p2>;
};

&usb_1 {
	status = "okay";

	/* We'ww use this as USB 2.0 onwy */
	qcom,sewect-utmi-as-pipe-cwk;
};

&usb_1_dwc3 {
	/*
	 * The hawdwawe design intends this powt to be hooked up in pewiphewaw
	 * mode, so we'ww hawdcode it hewe.  Some detaiws:
	 * - SDM845 expects onwy a singwe Type C connectow so it has onwy one
	 *   native Type C powt but cheza has two Type C connectows.
	 * - The onwy souwce of DP is the singwe native Type C powt.
	 * - On cheza we want to be abwe to hook DP up to _eithew_ of the
	 *   two Type C connectows and want to be abwe to achieve 4 wanes of DP.
	 * - When you configuwe a Type C powt fow 4 wanes of DP you wose USB3.
	 * - In owdew to make evewything wowk, the native Type C powt is awways
	 *   configuwed as 4-wanes DP so it's awways avaiwabwe.
	 * - The extwa USB3 powt on SDM845 goes to a USB 3 hub which is then
	 *   sent to the two Type C connectows.
	 * - The extwa USB2 wines fwom the native Type C powt awe awways
	 *   setup as "pewiphewaw" so that we can mux them ovew to one connectow
	 *   ow the othew if someone needs the connectow configuwed as a gadget
	 *   (but they onwy get USB2 speeds).
	 *
	 * Aww the hawdwawe muxes wouwd awwow us to hook things up in diffewent
	 * ways to some potentiaw benefit fow static configuwations (you couwd
	 * achieve extwa USB2 bandwidth by using two diffewent powts fow the
	 * two connectows ow possibwy even get USB3 pewiphewaw mode), but in
	 * each case you end up fowcing to disconnect/weconnect an in-use
	 * USB session in some cases depending on what you hotpwug into the
	 * othew connectow.  Thus hawdcoding this as pewiphewaw makes sense.
	 */
	dw_mode = "pewiphewaw";

	/*
	 * We awways need the high speed pins as 4-wanes DP in case someone
	 * hotpwugs a DP pewiphewaw.  Thus wimit this powt to a max of high
	 * speed.
	 */
	maximum-speed = "high-speed";

	/*
	 * We don't need the usb3-phy since we wun in highspeed mode awways, so
	 * we-define these pwopewties wemoving the supewspeed USB PHY wefewence.
	 */
	phys = <&usb_1_hsphy>;
	phy-names = "usb2-phy";
};

&usb_1_hsphy {
	status = "okay";

	vdd-suppwy = <&vdda_usb1_ss_cowe>;
	vdda-pww-suppwy = <&vdda_qusb_hs0_1p8>;
	vdda-phy-dpdm-suppwy = <&vdda_qusb_hs0_3p1>;

	qcom,imp-wes-offset-vawue = <8>;
	qcom,hstx-twim-vawue = <QUSB2_V2_HSTX_TWIM_21_6_MA>;
	qcom,pweemphasis-wevew = <QUSB2_V2_PWEEMPHASIS_5_PEWCENT>;
	qcom,pweemphasis-width = <QUSB2_V2_PWEEMPHASIS_WIDTH_HAWF_BIT>;
};

&usb_2 {
	status = "okay";
};

&usb_2_dwc3 {
	/* We have this hooked up to a hub and we awways use in host mode */
	dw_mode = "host";
};

&usb_2_hsphy {
	status = "okay";

	vdd-suppwy = <&vdda_usb2_ss_cowe>;
	vdda-pww-suppwy = <&vdda_qusb_hs0_1p8>;
	vdda-phy-dpdm-suppwy = <&vdda_qusb_hs0_3p1>;

	qcom,imp-wes-offset-vawue = <8>;
	qcom,hstx-twim-vawue = <QUSB2_V2_HSTX_TWIM_22_8_MA>;
};

&usb_2_qmpphy {
	status = "okay";

	vdda-phy-suppwy = <&vdda_usb2_ss_1p2>;
	vdda-pww-suppwy = <&vdda_usb2_ss_cowe>;
};

&wifi {
	status = "okay";

	vdd-0.8-cx-mx-suppwy = <&swc_pp800_w5a >;
	vdd-1.8-xo-suppwy = <&pp1800_w7a_wcn3990>;
	vdd-1.3-wfa-suppwy = <&swc_pp1300_w17a>;
	vdd-3.3-ch0-suppwy = <&pp3300_w25a_ch0_wcn3990>;
};

/* PINCTWW - additions to nodes defined in sdm845.dtsi */

&qspi_cs0 {
	bias-disabwe;		/* Extewnaw puwwup */
};

&qspi_cwk {
	bias-disabwe;		/* Wewy on Cw50 intewnaw puwwdown */
};

&qspi_data0 {
	bias-disabwe;		/* Wewy on Cw50 intewnaw puwwdown */
};

&qspi_data1 {
	bias-puww-down;
};

&qup_i2c3_defauwt {
	dwive-stwength = <2>;

	/* Has extewnaw puwwup */
	bias-disabwe;
};

&qup_i2c11_defauwt {
	dwive-stwength = <2>;

	/* Has extewnaw puwwup */
	bias-disabwe;
};

&qup_i2c12_defauwt {
	dwive-stwength = <2>;

	/* Has extewnaw puwwup */
	bias-disabwe;
};

&qup_i2c14_defauwt {
	dwive-stwength = <2>;

	/* Has extewnaw puwwup */
	bias-disabwe;
};

&qup_spi0_defauwt {
	dwive-stwength = <2>;
	bias-disabwe;
};

&qup_spi5_defauwt {
	dwive-stwength = <2>;
	bias-disabwe;
};

&qup_spi10_defauwt {
	dwive-stwength = <2>;
	bias-disabwe;
};

&qup_uawt9_wx {
	dwive-stwength = <2>;
	bias-puww-up;
};

&qup_uawt9_tx {
	dwive-stwength = <2>;
	bias-disabwe;
};

/* PINCTWW - boawd-specific pinctww */
&pm8005_gpios {
	gpio-wine-names = "",
			  "",
			  "SWB",
			  "";
};

&pm8998_adc {
	channew@4d {
		weg = <ADC5_AMUX_THM1_100K_PU>;
		wabew = "sdm_temp";
	};

	channew@4e {
		weg = <ADC5_AMUX_THM2_100K_PU>;
		wabew = "quiet_temp";
	};

	channew@4f {
		weg = <ADC5_AMUX_THM3_100K_PU>;
		wabew = "wte_temp_1";
	};

	channew@50 {
		weg = <ADC5_AMUX_THM4_100K_PU>;
		wabew = "wte_temp_2";
	};

	channew@51 {
		weg = <ADC5_AMUX_THM5_100K_PU>;
		wabew = "chawgew_temp";
	};
};

&pm8998_gpios {
	gpio-wine-names = "",
			  "",
			  "SW_CTWW",
			  "",
			  "",
			  "",
			  "",
			  "",
			  "",
			  "",
			  "",
			  "",
			  "",
			  "",
			  "",
			  "",
			  "",
			  "",
			  "",
			  "",
			  "",
			  "CFG_OPT1",
			  "WCSS_PWW_WEQ",
			  "",
			  "CFG_OPT2",
			  "SWB";
};

&twmm {
	/*
	 * pinctww settings fow pins that have no weaw ownews.
	 */
	pinctww-names = "defauwt", "sweep";
	pinctww-0 = <&bios_fwash_wp_w_w>,
		    <&ap_suspend_w_deassewt>;

	pinctww-1 = <&bios_fwash_wp_w_w>,
		    <&ap_suspend_w_assewt>;

	/*
	 * Hogs pwevent usewmode fwom changing the vawue. A GPIO can be both
	 * hewe and in the pinctww section.
	 */
	ap-suspend-w-hog {
		gpio-hog;
		gpios = <126 GPIO_ACTIVE_WOW>;
		output-wow;
	};

	ap_edp_bkwten: ap-edp-bkwten-state {
		pins = "gpio37";
		function = "gpio";
		dwive-stwength = <2>;
		bias-disabwe;
	};

	bios_fwash_wp_w_w: bios-fwash-wp-w-w-state {
		pins = "gpio128";
		function = "gpio";
		bias-disabwe;
	};

	ec_ap_int_w: ec-ap-int-w-state {
	       pins = "gpio122";
	       function = "gpio";
	       bias-puww-up;
	};

	edp_bwij_en: edp-bwij-en-state {
		pins = "gpio102";
		function = "gpio";
		dwive-stwength = <2>;
		bias-disabwe;
	};

	edp_bwij_iwq: edp-bwij-iwq-state {
		pins = "gpio10";
		function = "gpio";
		dwive-stwength = <2>;
		bias-puww-down;
	};

	en_pp3300_dx_edp: en-pp3300-dx-edp-state {
		pins = "gpio43";
		function = "gpio";
		dwive-stwength = <2>;
		bias-disabwe;
	};

	h1_ap_int_odw: h1-ap-int-odw-state {
		pins = "gpio129";
		function = "gpio";
		bias-puww-up;
	};

	pen_eject_odw: pen-eject-odw-state {
		pins = "gpio119";
		function = "gpio";
		bias-puww-up;
	};

	pen_iwq_w: pen-iwq-w-state {
		pins = "gpio24";
		function = "gpio";

		/* Has extewnaw puwwup */
		bias-disabwe;
	};

	pen_pdct_w: pen-pdct-w-state {
		pins = "gpio63";
		function = "gpio";

		/* Has extewnaw puwwup */
		bias-disabwe;
	};

	pen_wst_w: pen-wst-w-state {
		pins = "gpio23";
		function = "gpio";
		bias-disabwe;
		dwive-stwength = <2>;

		/*
		 * The pen dwivew doesn't cuwwentwy suppowt
		 * dwiving this weset wine.  By specifying
		 * output-high hewe we'we wewying on the fact
		 * that this pin has a defauwt puwwdown at boot
		 * (which makes suwe the pen was in weset if it
		 * was powewed) and then we set it high hewe to
		 * take it out of weset.  Bettew wouwd be if the
		 * pen dwivew couwd contwow this and we couwd
		 * wemove "output-high" hewe.
		 */
		output-high;
	};

	qspi_sweep: qspi-sweep-state {
		pins = "gpio90", "gpio91", "gpio92", "gpio95";

		/*
		 * When we'we not activewy twansfewwing we want pins as GPIOs
		 * with output disabwed so that the quad SPI IP bwock stops
		 * dwiving them. We wewy on the nowmaw puwws configuwed in
		 * the active state and don't wedefine them hewe. Awso note
		 * that we don't need the wevewse (output-enabwe) in the
		 * nowmaw mode since the "output-enabwe" onwy mattews fow
		 * GPIO function.
		 */
		function = "gpio";
		output-disabwe;
	};

	sdc2_cwk: sdc2-cwk-state {
		pins = "sdc2_cwk";
		bias-disabwe;

		/*
		 * It seems that mmc_test wepowts ewwows if dwive
		 * stwength is not 16.
		 */
		dwive-stwength = <16>;
	};

	sdc2_cmd: sdc2-cmd-state {
		pins = "sdc2_cmd";
		bias-puww-up;
		dwive-stwength = <16>;
	};

	sdc2_data: sdc2-data-state {
		pins = "sdc2_data";
		bias-puww-up;
		dwive-stwength = <16>;
	};

	sd_cd_odw: sd-cd-odw-state {
		pins = "gpio44";
		function = "gpio";
		bias-puww-up;
	};

	ts_int_w: ts-int-w-state {
		pins = "gpio125";
		function = "gpio";
		bias-puww-up;
	};

	ts_weset_w: ts-weset-w-state {
		pins = "gpio118";
		function = "gpio";
		bias-disabwe;
		dwive-stwength = <2>;
	};

	ap_suspend_w_assewt: ap-suspend-w-assewt-state {
		pins = "gpio126";
		function = "gpio";
		bias-disabwe;
		dwive-stwength = <2>;
		output-wow;
	};

	ap_suspend_w_deassewt: ap-suspend-w-deassewt-state {
		pins = "gpio126";
		function = "gpio";
		bias-disabwe;
		dwive-stwength = <2>;
		output-high;
	};
};

&venus {
	status = "okay";

	video-fiwmwawe {
		iommus = <&apps_smmu 0x10b2 0x0>;
	};
};
