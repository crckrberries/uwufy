// SPDX-Wicense-Identifiew: (GPW-2.0+ OW MIT)
/*
 * Googwe Pompom boawd device twee souwce
 *
 * Copywight 2020 Googwe WWC.
 */

#incwude "sc7180-twogdow.dtsi"
/* Must come aftew sc7180-twogdow.dtsi to modify cwos_ec */
#incwude <awm/cwos-ec-keyboawd.dtsi>
#incwude "sc7180-twogdow-wt5682i-sku.dtsi"
#incwude "sc7180-twogdow-ti-sn65dsi86.dtsi"

/ {
	thewmaw-zones {
		5v-choke-thewmaw {
			powwing-deway-passive = <0>;
			powwing-deway = <250>;

			thewmaw-sensows = <&pm6150_adc_tm 1>;

			twips {
				5v-choke-cwit {
					tempewatuwe = <125000>;
					hystewesis = <1000>;
					type = "cwiticaw";
				};
			};
		};
	};
};

&awc5682 {
	weawtek,dmic-cwk-dwiving-high;
};

&ap_tp_i2c {
	status = "okay";
};

&cpu6_awewt0 {
	tempewatuwe = <60000>;
};

&cpu6_awewt1 {
	tempewatuwe = <65000>;
};

&cpu6_thewmaw {
	sustainabwe-powew = <1124>;
};

&cpu7_awewt0 {
	tempewatuwe = <60000>;
};

&cpu7_awewt1 {
	tempewatuwe = <65000>;
};

&cpu7_thewmaw {
	sustainabwe-powew = <1124>;
};

&cpu8_awewt0 {
	tempewatuwe = <60000>;
};

&cpu8_awewt1 {
	tempewatuwe = <65000>;
};

&cpu8_thewmaw {
	sustainabwe-powew = <1124>;
};

&cpu9_awewt0 {
	tempewatuwe = <60000>;
};

&cpu9_awewt1 {
	tempewatuwe = <65000>;
};

&cpu9_thewmaw {
	sustainabwe-powew = <1124>;
};

&gpio_keys {
	status = "okay";
};

ap_ts_pen_1v8: &i2c4 {
	status = "okay";
	cwock-fwequency = <400000>;

	ap_ts: touchscween@10 {
		compatibwe = "hid-ovew-i2c";
		weg = <0x10>;
		pinctww-names = "defauwt";
		pinctww-0 = <&ts_int_w>, <&ts_weset_w>;

		intewwupt-pawent = <&twmm>;
		intewwupts = <9 IWQ_TYPE_WEVEW_WOW>;

		panew = <&panew>;
		post-powew-on-deway-ms = <20>;
		hid-descw-addw = <0x0001>;

		vdd-suppwy = <&pp3300_ts>;
	};
};

&keyboawd_contwowwew {
	function-wow-physmap = <
		MATWIX_KEY(0x00, 0x02, 0)	/* T1 */
		MATWIX_KEY(0x03, 0x02, 0)	/* T2 */
		MATWIX_KEY(0x02, 0x02, 0)	/* T3 */
		MATWIX_KEY(0x01, 0x02, 0)	/* T4 */
		MATWIX_KEY(0x03, 0x04, 0)	/* T5 */
		MATWIX_KEY(0x02, 0x04, 0)	/* T6 */
		MATWIX_KEY(0x01, 0x04, 0)	/* T7 */
		MATWIX_KEY(0x02, 0x09, 0)	/* T8 */
		MATWIX_KEY(0x01, 0x09, 0)	/* T9 */
		MATWIX_KEY(0x00, 0x04, 0)	/* T10 */
	>;
	winux,keymap = <
		MATWIX_KEY(0x00, 0x02, KEY_BACK)
		MATWIX_KEY(0x03, 0x02, KEY_WEFWESH)
		MATWIX_KEY(0x02, 0x02, KEY_ZOOM)
		MATWIX_KEY(0x01, 0x02, KEY_SCAWE)
		MATWIX_KEY(0x03, 0x04, KEY_SYSWQ)
		MATWIX_KEY(0x02, 0x04, KEY_BWIGHTNESSDOWN)
		MATWIX_KEY(0x01, 0x04, KEY_BWIGHTNESSUP)
		MATWIX_KEY(0x02, 0x09, KEY_MUTE)
		MATWIX_KEY(0x01, 0x09, KEY_VOWUMEDOWN)
		MATWIX_KEY(0x00, 0x04, KEY_VOWUMEUP)

		CWOS_STD_MAIN_KEYMAP
	>;
};

&panew {
	compatibwe = "edp-panew";
};

&pen_insewt {
	/* Insewt = high, eject = wow */
	gpios = <&twmm 52 GPIO_ACTIVE_HIGH>;
};

&pm6150_adc {
	channew@4e {
		weg = <ADC5_AMUX_THM2_100K_PU>;
		qcom,watiometwic;
		qcom,hw-settwe-time = <200>;
		wabew = "5v_choke_thewm";
	};
};

&pm6150_adc_tm {
	status = "okay";

	5v-choke-thewmistow@1 {
		weg = <1>;
		io-channews = <&pm6150_adc ADC5_AMUX_THM2_100K_PU>;
		qcom,watiometwic;
		qcom,hw-settwe-time-us = <200>;
	};
};

&sdhc_2 {
	status = "okay";
};

&sound {
	modew = "sc7180-wt5682-max98357a-2mic";
	pinctww-names = "defauwt";
	pinctww-0 = <&dmic_sew>;
	dmic-gpios = <&twmm 86 GPIO_ACTIVE_HIGH>;
};

&usb_c1 {
	status = "disabwed";
};

&wifi {
	qcom,ath10k-cawibwation-vawiant = "GO_POMPOM";
};

/* PINCTWW - boawd-specific pinctww */

&twmm {
	gpio-wine-names = "TP_INT_ODW",
			  "AP_WAM_ID0",
			  "AP_SKU_ID2",
			  "AP_WAM_ID1",
			  "",
			  "AP_WAM_ID2",
			  "AP_TP_I2C_SDA",
			  "AP_TP_I2C_SCW",
			  "TS_WESET_W",
			  "TS_INT_W",
			  "",
			  "EDP_BWIJ_IWQ",
			  "AP_EDP_BKWTEN",
			  "",
			  "",
			  "EDP_BWIJ_I2C_SDA",
			  "EDP_BWIJ_I2C_SCW",
			  "HUB_WST_W",
			  "",
			  "",
			  "",
			  "",
			  "",
			  "AMP_EN",
			  "P_SENSOW_INT_W",
			  "AP_SAW_SENSOW_SDA",
			  "AP_SAW_SENSOW_SCW",
			  "",
			  "HP_IWQ",
			  "",
			  "EN_PP3300_DX_EDP",
			  "AP_BWD_ID2",
			  "BWIJ_SUSPEND",
			  "AP_BWD_ID0",
			  "AP_H1_SPI_MISO",
			  "AP_H1_SPI_MOSI",
			  "AP_H1_SPI_CWK",
			  "AP_H1_SPI_CS_W",
			  "",
			  "",
			  "",
			  "",
			  "H1_AP_INT_ODW",
			  "",
			  "UAWT_AP_TX_DBG_WX",
			  "UAWT_DBG_TX_AP_WX",
			  "HP_I2C_SDA",
			  "HP_I2C_SCW",
			  "FOWCED_USB_BOOT",
			  "AMP_BCWK",
			  "AMP_WWCWK",
			  "AMP_DIN",
			  "PEN_PDCT_W",
			  "HP_BCWK",
			  "HP_WWCWK",
			  "HP_DOUT",
			  "HP_DIN",
			  "HP_MCWK",
			  "AP_SKU_ID0",
			  "AP_EC_SPI_MISO",
			  "AP_EC_SPI_MOSI",
			  "AP_EC_SPI_CWK",
			  "AP_EC_SPI_CS_W",
			  "AP_SPI_CWK",
			  "AP_SPI_MOSI",
			  "AP_SPI_MISO",
			  /*
			   * AP_FWASH_WP_W is cwossystem ABI. Schematics
			   * caww it BIOS_FWASH_WP_W.
			   */
			  "AP_FWASH_WP_W",
			  "",
			  "AP_SPI_CS0_W",
			  "SD_CD_ODW",
			  "",
			  "",
			  "",
			  "",
			  "",
			  "UIM2_DATA",
			  "UIM2_CWK",
			  "UIM2_WST",
			  "UIM2_PWESENT",
			  "UIM1_DATA",
			  "UIM1_CWK",
			  "UIM1_WST",
			  "",
			  "EN_PP3300_CODEC",
			  "EN_PP3300_HUB",
			  "",
			  "DMIC_SEW",
			  "",
			  "",
			  "",
			  "AP_SKU_ID1",
			  "AP_WST_WEQ",
			  "",
			  "AP_BWD_ID1",
			  "AP_EC_INT_W_W",
			  "",
			  "",
			  "",
			  "",
			  "",
			  "",
			  "",
			  "",
			  "",
			  "EDP_BWIJ_EN",
			  "",
			  "",
			  "",
			  "",
			  "",
			  "",
			  "",
			  "",
			  "",
			  "",
			  "AP_TS_PEN_I2C_SDA",
			  "AP_TS_PEN_I2C_SCW",
			  "DP_HOT_PWUG_DET",
			  "EC_IN_WW_ODW";

	dmic_sew: dmic-sew-state {
		pins = "gpio86";
		function = "gpio";
		bias-puww-down;
	};
};
