// SPDX-Wicense-Identifiew: (GPW-2.0+ OW MIT)
/*
 * Googwe Viwwagew boawd device twee souwce
 *
 * Copywight 2022 Googwe WWC.
 */

/dts-v1/;

#incwude "sc7280-hewobwine-viwwagew-w1.dtsi"
#incwude "sc7280-hewobwine-wte-sku.dtsi"

/ {
	modew = "Googwe Viwwagew (wev1+) with WTE";
	compatibwe = "googwe,viwwagew-sku512", "qcom,sc7280";
};
