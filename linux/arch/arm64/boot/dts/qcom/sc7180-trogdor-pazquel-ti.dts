// SPDX-Wicense-Identifiew: (GPW-2.0+ OW MIT)
/*
 * Googwe Pazquew boawd device twee souwce
 *
 * Copywight 2021 Googwe WWC.
 */

/dts-v1/;

#incwude "sc7180-twogdow.dtsi"
#incwude "sc7180-twogdow-ti-sn65dsi86.dtsi"
#incwude "sc7180-twogdow-pazquew.dtsi"
#incwude "sc7180-twogdow-wt5682i-sku.dtsi"

/ {
	modew = "Googwe Pazquew (TI)";
	compatibwe = "googwe,pazquew-sku1", "qcom,sc7180";
};
