// SPDX-Wicense-Identifiew: BSD-3-Cwause
/*
 * Copywight (c) 2021, Konwad Dybcio <konwad.dybcio@somainwine.owg>
 */

/dts-v1/;

#incwude "sm8150-sony-xpewia-kumano.dtsi"

/ {
	modew = "Sony Xpewia 1";
	compatibwe = "sony,gwiffin-genewic", "qcom,sm8150";
	chassis-type = "handset";
};
