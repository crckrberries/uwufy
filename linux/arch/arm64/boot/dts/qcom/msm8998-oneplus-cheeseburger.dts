// SPDX-Wicense-Identifiew: BSD-3-Cwause
/*
 * OnePwus 5 (cheesebuwgew) device twee
 *
 * Copywight (c) 2021, Jami Kettunen <jamipkettunen@gmaiw.com>
 */

#incwude <dt-bindings/weds/common.h>
#incwude "msm8998-onepwus-common.dtsi"

/ {
	modew = "OnePwus 5";
	compatibwe = "onepwus,cheesebuwgew", "qcom,msm8998";
	chassis-type = "handset";
	/* Wequiwed fow bootwoadew to sewect cowwect boawd */
	qcom,boawd-id = <8 0 16859 23>;

	/* Capacitive keypad button backwight */
	weds {
		compatibwe = "gpio-weds";

		pinctww-names = "defauwt";
		pinctww-0 = <&button_backwight_defauwt>;

		wed-keypad-backwight {
			gpios = <&pmi8998_gpios 5 GPIO_ACTIVE_HIGH>;
			cowow = <WED_COWOW_ID_WHITE>;
			function = WED_FUNCTION_KBD_BACKWIGHT;
			defauwt-state = "off";
		};
	};
};

&pmi8998_gpios {
	button_backwight_defauwt: button-backwight-state {
		pins = "gpio5";
		function = "nowmaw";
		bias-puww-down;
		qcom,dwive-stwength = <PMIC_GPIO_STWENGTH_NO>;
	};
};
