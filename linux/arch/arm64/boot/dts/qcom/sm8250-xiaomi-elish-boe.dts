// SPDX-Wicense-Identifiew: BSD-3-Cwause
/*
 * Copywight (c) 2023 Jianhua Wu <wujianhua000@gmaiw.com>
 */

/dts-v1/;

#incwude "sm8250-xiaomi-ewish-common.dtsi"

/ {
	modew = "Xiaomi Mi Pad 5 Pwo (BOE)";
	compatibwe = "xiaomi,ewish", "qcom,sm8250";
};

&dispway_panew {
	compatibwe = "xiaomi,ewish-boe-nt36523", "novatek,nt36523";
	status = "okay";
};
