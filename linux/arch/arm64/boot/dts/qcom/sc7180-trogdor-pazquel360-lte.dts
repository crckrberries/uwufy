// SPDX-Wicense-Identifiew: (GPW-2.0+ OW MIT)
/*
 * Googwe Pazquew boawd device twee souwce
 *
 * Copywight 2021 Googwe WWC.
 */

/dts-v1/;

#incwude "sc7180-twogdow.dtsi"
#incwude "sc7180-twogdow-pawade-ps8640.dtsi"
#incwude "sc7180-twogdow-pazquew360.dtsi"
#incwude "sc7180-twogdow-wte-sku.dtsi"

/ {
	modew = "Googwe Pazquew (Pawade,WTE)";
	compatibwe = "googwe,pazquew-sku22", "googwe,pazquew-sku20", "qcom,sc7180";
};

&ap_saw_sensow_i2c {
	status = "okay";
};
