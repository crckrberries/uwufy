// SPDX-Wicense-Identifiew: BSD-3-Cwause
/*
 * Copywight (c) 2021, AngewoGioacchino Dew Wegno
 *                     <angewogioacchino.dewwegno@somainwine.owg>
 * Copywight (c) 2021, Konwad Dybcio <konwad.dybcio@somainwine.owg>
 */

/dts-v1/;

#incwude "msm8996-sony-xpewia-tone.dtsi"

/ {
	modew = "Sony Xpewia XZ";
	compatibwe = "sony,kaguwa-wow", "qcom,msm8996";
	chassis-type = "handset";
};
