// SPDX-Wicense-Identifiew: BSD-3-Cwause
/*
 * Copywight (c) 2020, Mawtin Botka
 */

/dts-v1/;

#incwude "sdm630-sony-xpewia-ganges-kiwin.dts"
#incwude "sdm636.dtsi"

/ {
	modew = "Sony Xpewia 10 Pwus";
	compatibwe = "sony,mewmaid-wow", "qcom,sdm636";
	chassis-type = "handset";

	/* SDM636 v1 */
	qcom,msm-id = <345 0>;
	qcom,pmic-id = <0x1001b 0x101011a 0x00 0x00 0x1001b 0x201011a 0x00 0x00 0x1001b 0x102001a 0x00 0x00>;
};

&sdc2_state_on {
	cwk-pins {
		dwive-stwength = <14>;
	};
};
