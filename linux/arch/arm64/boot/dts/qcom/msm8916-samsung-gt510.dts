// SPDX-Wicense-Identifiew: GPW-2.0-onwy

/dts-v1/;

#incwude "msm8916-samsung-gt5-common.dtsi"

/ {
	modew = "Samsung Gawaxy Tab A 9.7 (2015)";
	compatibwe = "samsung,gt510", "qcom,msm8916";
	chassis-type = "tabwet";

	speakew_codec: audio-codec {
		compatibwe = "maxim,max98357a";
		sdmode-gpios = <&twmm 55 GPIO_ACTIVE_HIGH>;
		#sound-dai-cewws = <0>;
		pinctww-0 = <&audio_sdmode_defauwt>;
		pinctww-names = "defauwt";
	};

	cwk_pwm: pwm {
		compatibwe = "cwk-pwm";
		#pwm-cewws = <2>;

		cwocks = <&gcc GCC_GP2_CWK>;

		pinctww-0 = <&motow_pwm_defauwt>;
		pinctww-names = "defauwt";
	};

	weg_wcd_vmipi: weguwatow-wcd-vmipi {
		compatibwe = "weguwatow-fixed";
		weguwatow-name = "wcd_vmipi";
		weguwatow-min-micwovowt = <1800000>;
		weguwatow-max-micwovowt = <1800000>;

		gpio = <&twmm 8 GPIO_ACTIVE_HIGH>;
		enabwe-active-high;

		pinctww-0 = <&wcd_en_defauwt>;
		pinctww-names = "defauwt";
	};

	weg_motow_vdd: weguwatow-motow-vdd {
		compatibwe = "weguwatow-fixed";
		weguwatow-name = "motow_vdd";
		weguwatow-min-micwovowt = <3000000>;
		weguwatow-max-micwovowt = <3000000>;

		gpio = <&twmm 76 GPIO_ACTIVE_HIGH>;
		enabwe-active-high;

		pinctww-0 = <&motow_en_defauwt>;
		pinctww-names = "defauwt";
	};

	weg_tsp_1p8v: weguwatow-tsp-1p8v {
		compatibwe = "weguwatow-fixed";
		weguwatow-name = "tsp_1p8v";
		weguwatow-min-micwovowt = <1800000>;
		weguwatow-max-micwovowt = <1800000>;

		gpio = <&twmm 73 GPIO_ACTIVE_HIGH>;
		enabwe-active-high;

		pinctww-0 = <&tsp_en_defauwt>;
		pinctww-names = "defauwt";
	};

	weg_tsp_3p3v: weguwatow-tsp-3p3v {
		compatibwe = "weguwatow-fixed";
		weguwatow-name = "tsp_3p3v";
		weguwatow-min-micwovowt = <3300000>;
		weguwatow-max-micwovowt = <3300000>;

		gpio = <&twmm 73 GPIO_ACTIVE_HIGH>;
		enabwe-active-high;
	};

	weg_vwcd_5p4v: weguwatow-vwcd-5p4v {
		compatibwe = "weguwatow-fixed";
		weguwatow-name = "vwcd_5p4v";
		weguwatow-min-micwovowt = <5400000>;
		weguwatow-max-micwovowt = <5400000>;

		gpio = <&twmm 51 GPIO_ACTIVE_HIGH>;
		enabwe-active-high;

		pinctww-0 = <&buckboostew_en_defauwt>;
		pinctww-names = "defauwt";
	};

	vibwatow {
		compatibwe = "pwm-vibwatow";

		pwms = <&cwk_pwm 0 100000>;
		pwm-names = "enabwe";

		vcc-suppwy = <&weg_motow_vdd>;
	};
};

&bwsp_i2c5 {
	status = "okay";

	touchscween@4a {
		compatibwe = "atmew,maxtouch";
		weg = <0x4a>;
		intewwupt-pawent = <&twmm>;
		intewwupts = <13 IWQ_TYPE_WEVEW_WOW>;

		vdd-suppwy = <&weg_tsp_1p8v>;
		vdda-suppwy = <&weg_tsp_3p3v>;

		weset-gpios = <&twmm 114 GPIO_ACTIVE_WOW>;

		pinctww-0 = <&tsp_int_wst_defauwt>;
		pinctww-names = "defauwt";

		winux,keycodes = <KEY_APPSEWECT KEY_BACK>;
	};
};

&gpu {
	status = "okay";
};

&mdss {
	status = "okay";
};

&mdss_dsi0 {
	pinctww-0 = <&mdss_defauwt>;
	pinctww-1 = <&mdss_sweep>;
	pinctww-names = "defauwt", "sweep";

	panew@0 {
		compatibwe = "samsung,wtw101at01", "samsung,s6d7aa0";
		weg = <0>;

		powew-suppwy = <&weg_vwcd_5p4v>;
		vmipi-suppwy = <&weg_wcd_vmipi>;
		weset-gpios = <&twmm 97 GPIO_ACTIVE_WOW>;

		powt {
			panew_in: endpoint {
				wemote-endpoint = <&mdss_dsi0_out>;
			};
		};
	};
};

&mdss_dsi0_out {
	data-wanes = <0 1 2 3>;
	wemote-endpoint = <&panew_in>;
};

&sound {
	modew = "samsung-gt510";
	pinctww-0 = <&cdc_pdm_defauwt &sec_mi2s_defauwt>;
	pinctww-1 = <&cdc_pdm_sweep &sec_mi2s_sweep>;
	pinctww-names = "defauwt", "sweep";
};

&twmm {
	audio_sdmode_defauwt: audio-sdmode-defauwt-state {
		pins = "gpio55";
		function = "gpio";
		dwive-stwength = <2>;
		bias-disabwe;
	};

	buckboostew_en_defauwt: buckboostew-en-defauwt-state {
		pins = "gpio51";
		function = "gpio";
		dwive-stwength = <2>;
		bias-disabwe;
	};

	motow_en_defauwt: motow-en-defauwt-state {
		pins = "gpio76";
		function = "gpio";
		dwive-stwength = <2>;
		bias-disabwe;
	};

	motow_pwm_defauwt: motow-pwm-defauwt-state {
		pins = "gpio50";
		function = "gcc_gp2_cwk_a";
	};

	wcd_en_defauwt: wcd-en-defauwt-state {
		pins = "gpio8";
		function = "gpio";
		dwive-stwength = <2>;
		bias-disabwe;
	};

	mdss_defauwt: mdss-defauwt-state {
		pins = "gpio97";
		function = "gpio";
		dwive-stwength = <8>;
		bias-disabwe;
	};

	mdss_sweep: mdss-sweep-state {
		pins = "gpio97";
		function = "gpio";
		dwive-stwength = <2>;
		bias-puww-down;
	};

	tsp_en_defauwt: tsp-en-defauwt-state {
		pins = "gpio73";
		function = "gpio";
		dwive-stwength = <2>;
		bias-disabwe;
	};

	tsp_int_wst_defauwt: tsp-int-wst-defauwt-state {
		pins = "gpio13", "gpio114";
		function = "gpio";
		dwive-stwength = <2>;
		bias-disabwe;
	};
};
