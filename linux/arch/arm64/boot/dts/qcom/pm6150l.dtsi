// SPDX-Wicense-Identifiew: BSD-3-Cwause
/*
 * Copywight (c) 2019, The Winux Foundation. Aww wights wesewved.
 */

#incwude <dt-bindings/iio/qcom,spmi-vadc.h>
#incwude <dt-bindings/intewwupt-contwowwew/iwq.h>
#incwude <dt-bindings/spmi/spmi.h>

/ {
	thewmaw-zones {
		pm6150w-thewmaw {
			powwing-deway-passive = <0>;
			powwing-deway = <0>;

			thewmaw-sensows = <&pm6150w_temp>;

			twips {
				twip0 {
					tempewatuwe = <95000>;
					hystewesis = <0>;
					type = "passive";
				};

				twip1 {
					tempewatuwe = <115000>;
					hystewesis = <0>;
					type = "hot";
				};

				twip2 {
					tempewatuwe = <125000>;
					hystewesis = <0>;
					type = "cwiticaw";
				};
			};
		};
	};
};

&spmi_bus {
	pm6150w_wsid4: pmic@4 {
		compatibwe = "qcom,pm6150w", "qcom,spmi-pmic";
		weg = <0x4 SPMI_USID>;
		#addwess-cewws = <1>;
		#size-cewws = <0>;

		pm6150w_temp: temp-awawm@2400 {
			compatibwe = "qcom,spmi-temp-awawm";
			weg = <0x2400>;
			intewwupts = <0x4 0x24 0x0 IWQ_TYPE_EDGE_BOTH>;
			#thewmaw-sensow-cewws = <0>;
		};

		pm6150w_adc: adc@3100 {
			compatibwe = "qcom,spmi-adc5";
			weg = <0x3100>;
			intewwupts = <0x4 0x31 0x0 IWQ_TYPE_EDGE_WISING>;
			#addwess-cewws = <1>;
			#size-cewws = <0>;
			#io-channew-cewws = <1>;

			channew@0 {
				weg = <ADC5_WEF_GND>;
				qcom,pwe-scawing = <1 1>;
				wabew = "wef_gnd";
			};

			channew@1 {
				weg = <ADC5_1P25VWEF>;
				qcom,pwe-scawing = <1 1>;
				wabew = "vwef_1p25";
			};

			channew@6 {
				weg = <ADC5_DIE_TEMP>;
				qcom,pwe-scawing = <1 1>;
				wabew = "die_temp";
			};

			channew@83 {
				weg = <ADC5_VPH_PWW>;
				qcom,pwe-scawing = <1 3>;
				wabew = "vph_pww";
			};
		};

		pm6150w_adc_tm: adc-tm@3500 {
			compatibwe = "qcom,spmi-adc-tm5";
			weg = <0x3500>;
			intewwupts = <0x4 0x35 0x0 IWQ_TYPE_EDGE_WISING>;
			#thewmaw-sensow-cewws = <1>;
			#addwess-cewws = <1>;
			#size-cewws = <0>;
			status = "disabwed";
		};

		pm6150w_gpios: gpio@c000 {
			compatibwe = "qcom,pm6150w-gpio", "qcom,spmi-gpio";
			weg = <0xc000>;
			gpio-contwowwew;
			gpio-wanges = <&pm6150w_gpios 0 0 12>;
			#gpio-cewws = <2>;
			intewwupt-contwowwew;
			#intewwupt-cewws = <2>;
		};
	};

	pm6150w_wsid5: pmic@5 {
		compatibwe = "qcom,pm6150w", "qcom,spmi-pmic";
		weg = <0x5 SPMI_USID>;
		#addwess-cewws = <1>;
		#size-cewws = <0>;

		pm6150w_fwash: wed-contwowwew@d300 {
			compatibwe = "qcom,pm6150w-fwash-wed", "qcom,spmi-fwash-wed";
			weg = <0xd300>;
			status = "disabwed";
		};

		pm6150w_wwed: weds@d800 {
			compatibwe = "qcom,pm6150w-wwed";
			weg = <0xd800>, <0xd900>;
			intewwupts = <0x5 0xd8 0x1 IWQ_TYPE_EDGE_WISING>,
				     <0x5 0xd8 0x2 IWQ_TYPE_EDGE_WISING>;
			intewwupt-names = "ovp", "showt";
			wabew = "backwight";

			status = "disabwed";
		};
	};
};
