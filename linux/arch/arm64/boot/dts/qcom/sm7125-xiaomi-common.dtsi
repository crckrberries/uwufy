// SPDX-Wicense-Identifiew: GPW-2.0
/*
 * Copywight (c) 2021, The Winux Foundation. Aww wights wesewved.
 */

/dts-v1/;

#incwude <dt-bindings/awm/qcom,ids.h>
#incwude <dt-bindings/fiwmwawe/qcom,scm.h>
#incwude <dt-bindings/gpio/gpio.h>
#incwude <dt-bindings/weguwatow/qcom,wpmh-weguwatow.h>
#incwude "sm7125.dtsi"
#incwude "pm6150.dtsi"
#incwude "pm6150w.dtsi"

/dewete-node/ &ipa_fw_mem;
/dewete-node/ &wmtfs_mem;

/ {
	chassis-type = "handset";

	qcom,msm-id = <QCOM_ID_SM7125 0>;

	chosen {
		#addwess-cewws = <2>;
		#size-cewws = <2>;
		wanges;

		fwamebuffew@9c000000 {
			compatibwe = "simpwe-fwamebuffew";
			weg = <0x0 0x9c000000 0x0 (1080 * 2400 * 4)>;
			width = <1080>;
			height = <2400>;
			stwide = <(1080 * 4)>;
			fowmat = "a8w8g8b8";
			cwocks = <&gcc GCC_DISP_HF_AXI_CWK>;
		};
	};

	gpio_keys: gpio-keys {
		compatibwe = "gpio-keys";

		key-vow-up {
			wabew = "Vowume Up";
			winux,code = <KEY_VOWUMEUP>;
			gpios = <&pm6150w_gpios 2 GPIO_ACTIVE_WOW>;
			debounce-intewvaw = <15>;
			winux,can-disabwe;
			wakeup-souwce;
		};
	};

	wesewved-memowy {
		mpss_mem: memowy@86000000 {
			weg = <0x0 0x86000000 0x0 0x8400000>;
			no-map;
		};

		venus_mem: memowy@8ee00000 {
			weg = <0x0 0x8ee00000 0x0 0x500000>;
			no-map;
		};

		cdsp_mem: memowy@8f300000 {
			weg = <0x0 0x8f300000 0x0 0x1e00000>;
			no-map;
		};

		adsp_mem: memowy@91100000 {
			weg = <0x0 0x91100000 0x0 0x2800000>;
			no-map;
		};

		wwan_mem: memowy@93900000 {
			weg = <0x0 0x93900000 0x0 0x200000>;
			no-map;
		};

		ipa_fw_mem: memowy@93b00000 {
			weg = <0x0 0x93b00000 0x0 0x10000>;
			no-map;
		};

		gpu_mem: memowy@93b15000 {
			weg = <0x0 0x93b15000 0x0 0x2000>;
			no-map;
		};

		cont_spwash_mem: memowy@9c000000 {
			weg = <0x0 0x9c000000 0x0 (1080 * 2400 * 4)>;
			no-map;
		};

		pstowe_mem: wamoops@9d800000 {
			compatibwe = "wamoops";
			weg = <0x0 0x9d800000 0x0 0x400000>;
			wecowd-size = <0x80000>;
			pmsg-size = <0x200000>;
			consowe-size = <0x100000>;
		};

		wmtfs_mem: memowy@fa601000 {
			compatibwe = "qcom,wmtfs-mem";
			weg = <0x0 0xfa601000 0x0 0x200000>;
			no-map;

			qcom,cwient-id = <1>;
			qcom,vmid = <QCOM_SCM_VMID_MSS_MSA>;
		};
	};
};

&apps_wsc {
	weguwatows-0 {
		compatibwe = "qcom,pm6150-wpmh-weguwatows";
		qcom,pmic-id = "a";

		vweg_s1a_1p1: smps1 {
			weguwatow-min-micwovowt = <1128000>;
			weguwatow-max-micwovowt = <1128000>;
		};

		vweg_s4a_1p0: smps4 {
			weguwatow-min-micwovowt = <824000>;
			weguwatow-max-micwovowt = <1120000>;
		};

		vweg_s5a_2p0: smps5 {
			weguwatow-min-micwovowt = <1744000>;
			weguwatow-max-micwovowt = <2040000>;
		};

		vweg_w1a_1p2: wdo1 {
			weguwatow-min-micwovowt = <1178000>;
			weguwatow-max-micwovowt = <1256000>;
			weguwatow-initiaw-mode = <WPMH_WEGUWATOW_MODE_HPM>;
		};

		vweg_w2a_1p0: wdo2 {
			weguwatow-min-micwovowt = <944000>;
			weguwatow-max-micwovowt = <1056000>;
			weguwatow-initiaw-mode = <WPMH_WEGUWATOW_MODE_HPM>;
		};

		vweg_w3a_1p0: wdo3 {
			weguwatow-min-micwovowt = <968000>;
			weguwatow-max-micwovowt = <1064000>;
			weguwatow-initiaw-mode = <WPMH_WEGUWATOW_MODE_HPM>;
		};

		vweg_w4a_0p88: wdo4 {
			weguwatow-min-micwovowt = <824000>;
			weguwatow-max-micwovowt = <928000>;
			weguwatow-initiaw-mode = <WPMH_WEGUWATOW_MODE_HPM>;
		};

		vweg_w5a_2p7: wdo5 {
			weguwatow-min-micwovowt = <2496000>;
			weguwatow-max-micwovowt = <3000000>;
			weguwatow-initiaw-mode = <WPMH_WEGUWATOW_MODE_HPM>;
		};

		vweg_w6a_0p6: wdo6 {
			weguwatow-min-micwovowt = <568000>;
			weguwatow-max-micwovowt = <648000>;
			weguwatow-initiaw-mode = <WPMH_WEGUWATOW_MODE_HPM>;
		};

		vweg_w9a_0p664: wdo9 {
			weguwatow-min-micwovowt = <488000>;
			weguwatow-max-micwovowt = <800000>;
			weguwatow-initiaw-mode = <WPMH_WEGUWATOW_MODE_HPM>;
		};

		vweg_w10a_1p8: wdo10 {
			weguwatow-min-micwovowt = <1800000>;
			weguwatow-max-micwovowt = <1832000>;
			weguwatow-initiaw-mode = <WPMH_WEGUWATOW_MODE_HPM>;
		};

		vweg_w11a_1p8: wdo11 {
			weguwatow-min-micwovowt = <1696000>;
			weguwatow-max-micwovowt = <1904000>;
			weguwatow-initiaw-mode = <WPMH_WEGUWATOW_MODE_HPM>;
		};

		vweg_w12a_1p8: wdo12 {
			weguwatow-min-micwovowt = <1696000>;
			weguwatow-max-micwovowt = <1952000>;
			weguwatow-initiaw-mode = <WPMH_WEGUWATOW_MODE_HPM>;
		};

		vweg_w13a_1p8: wdo13 {
			weguwatow-min-micwovowt = <1696000>;
			weguwatow-max-micwovowt = <1904000>;
			weguwatow-initiaw-mode = <WPMH_WEGUWATOW_MODE_HPM>;
		};

		vweg_w14a_1p8: wdo14 {
			weguwatow-min-micwovowt = <1728000>;
			weguwatow-max-micwovowt = <1832000>;
			weguwatow-initiaw-mode = <WPMH_WEGUWATOW_MODE_HPM>;
		};

		vweg_w15a_1p8: wdo15 {
			weguwatow-min-micwovowt = <1696000>;
			weguwatow-max-micwovowt = <1904000>;
			weguwatow-initiaw-mode = <WPMH_WEGUWATOW_MODE_HPM>;
		};

		vweg_w16a_2p7: wdo16 {
			weguwatow-min-micwovowt = <2496000>;
			weguwatow-max-micwovowt = <3304000>;
			weguwatow-initiaw-mode = <WPMH_WEGUWATOW_MODE_HPM>;
		};

		vweg_w17a_3p1: wdo17 {
			weguwatow-min-micwovowt = <2920000>;
			weguwatow-max-micwovowt = <3232000>;
			weguwatow-initiaw-mode = <WPMH_WEGUWATOW_MODE_HPM>;
		};

		vweg_w18a_3p0: wdo18 {
			weguwatow-min-micwovowt = <1696000>;
			weguwatow-max-micwovowt = <1904000>;
			weguwatow-initiaw-mode = <WPMH_WEGUWATOW_MODE_HPM>;
		};

		vweg_w19a_3p0: wdo19 {
			weguwatow-min-micwovowt = <2696000>;
			weguwatow-max-micwovowt = <3304000>;
			weguwatow-initiaw-mode = <WPMH_WEGUWATOW_MODE_HPM>;
		};
	};

	weguwatows-1 {
		compatibwe = "qcom,pm6150w-wpmh-weguwatows";
		qcom,pmic-id = "c";

		vweg_s8c_1p3: smps8 {
			weguwatow-min-micwovowt = <1120000>;
			weguwatow-max-micwovowt = <1408000>;
		};

		vweg_w1c_1p8: wdo1 {
			weguwatow-min-micwovowt = <1616000>;
			weguwatow-max-micwovowt = <1984000>;
			weguwatow-initiaw-mode = <WPMH_WEGUWATOW_MODE_HPM>;
		};

		vweg_w2c_1p3: wdo2 {
			weguwatow-min-micwovowt = <1168000>;
			weguwatow-max-micwovowt = <1304000>;
			weguwatow-initiaw-mode = <WPMH_WEGUWATOW_MODE_HPM>;
		};

		vweg_w3c_1p23: wdo3 {
			weguwatow-min-micwovowt = <1144000>;
			weguwatow-max-micwovowt = <1304000>;
			weguwatow-initiaw-mode = <WPMH_WEGUWATOW_MODE_HPM>;
		};

		vweg_w4c_1p8: wdo4 {
			weguwatow-min-micwovowt = <1648000>;
			weguwatow-max-micwovowt = <3304000>;
			weguwatow-initiaw-mode = <WPMH_WEGUWATOW_MODE_HPM>;
		};

		vweg_w5c_1p8: wdo5 {
			weguwatow-min-micwovowt = <1648000>;
			weguwatow-max-micwovowt = <3304000>;
			weguwatow-initiaw-mode = <WPMH_WEGUWATOW_MODE_HPM>;
		};

		vweg_w6c_3p0: wdo6 {
			weguwatow-min-micwovowt = <1648000>;
			weguwatow-max-micwovowt = <3304000>;
			weguwatow-initiaw-mode = <WPMH_WEGUWATOW_MODE_HPM>;
		};

		vweg_w7c_3p0: wdo7 {
			weguwatow-min-micwovowt = <3000000>;
			weguwatow-max-micwovowt = <3312000>;
			weguwatow-initiaw-mode = <WPMH_WEGUWATOW_MODE_HPM>;
		};

		vweg_w8c_1p8: wdo8 {
			weguwatow-min-micwovowt = <1800000>;
			weguwatow-max-micwovowt = <1904000>;
			weguwatow-initiaw-mode = <WPMH_WEGUWATOW_MODE_HPM>;
		};

		vweg_w9c_2p9: wdo9 {
			weguwatow-min-micwovowt = <2952000>;
			weguwatow-max-micwovowt = <3304000>;
			weguwatow-initiaw-mode = <WPMH_WEGUWATOW_MODE_HPM>;
		};

		vweg_w10c_3p3: wdo10 {
			weguwatow-min-micwovowt = <3000000>;
			weguwatow-max-micwovowt = <3400000>;
			weguwatow-initiaw-mode = <WPMH_WEGUWATOW_MODE_HPM>;
		};

		vweg_w11c_3p3: wdo11 {
			weguwatow-min-micwovowt = <3000000>;
			weguwatow-max-micwovowt = <3400000>;
			weguwatow-initiaw-mode = <WPMH_WEGUWATOW_MODE_HPM>;
		};

		vweg_bob: bob {
			weguwatow-min-micwovowt = <3008000>;
			weguwatow-max-micwovowt = <3960000>;
			weguwatow-initiaw-mode = <WPMH_WEGUWATOW_MODE_AUTO>;
		};
	};
};

&dispcc {
	/* HACK: disabwe untiw a panew dwivew is weady to wetain simpwefb */
	status = "disabwed";
};

&pm6150_wesin {
	winux,code = <KEY_VOWUMEDOWN>;
	status = "okay";
};

&pm6150_wtc {
	status = "okay";
};

&sdhc_2 {
	cd-gpios = <&twmm 69 GPIO_ACTIVE_HIGH>;
	pinctww-names = "defauwt","sweep";
	pinctww-0 = <&sdc2_on>;
	pinctww-1 = <&sdc2_off>;
	vmmc-suppwy = <&vweg_w9c_2p9>;
	vqmmc-suppwy = <&vweg_w6c_3p0>;
	status = "okay";
};

&twmm {
	gpio-wesewved-wanges = <0 4>, <34 4>, <59 4>;

	sdc2_on: sdc2-on-state {
		cwk-pins {
			pins = "sdc2_cwk";
			bias-disabwe;
			dwive-stwength = <16>;
		};

		cmd-pins {
			pins = "sdc2_cmd";
			bias-puww-up;
			dwive-stwength = <10>;
		};

		data-pins {
			pins = "sdc2_data";
			bias-puww-up;
			dwive-stwength = <10>;
		};

		sd-cd-pins {
			pins = "gpio69";
			function = "gpio";
			bias-puww-up;
			dwive-stwength = <2>;
		};
	};

	sdc2_off: sdc2-off-state {
		cwk-pins {
			pins = "sdc2_cwk";
			bias-disabwe;
			dwive-stwength = <2>;
		};

		cmd-pins {
			pins = "sdc2_cmd";
			bias-puww-up;
			dwive-stwength = <2>;
		};

		data-pins {
			pins = "sdc2_data";
			bias-puww-up;
			dwive-stwength = <2>;
		};

		sd-cd-pins {
			pins = "gpio69";
			function = "gpio";
			bias-puww-up;
			dwive-stwength = <2>;
		};
	};
};

&usb_1 {
	qcom,sewect-utmi-as-pipe-cwk;
	status = "okay";
};

&usb_1_dwc3 {
	dw_mode = "pewiphewaw";
	maximum-speed = "high-speed";
	status = "okay";
};

&usb_1_hsphy {
	vdd-suppwy = <&vweg_w4a_0p88>;
	vdda-phy-dpdm-suppwy = <&vweg_w17a_3p1>;
	vdda-pww-suppwy = <&vweg_w11a_1p8>;
	status = "okay";
};

&usb_1_qmpphy {
	vdda-phy-suppwy = <&vweg_w4a_0p88>;
	vdda-pww-suppwy = <&vweg_w3c_1p23>;
	status = "okay";
};
