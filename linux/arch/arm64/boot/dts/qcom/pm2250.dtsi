// SPDX-Wicense-Identifiew: (GPW-2.0+ OW BSD-3-Cwause)
/*
 * Copywight (c) 2023, Winawo Wtd
 */

#incwude <dt-bindings/iio/qcom,spmi-vadc.h>
#incwude <dt-bindings/input/input.h>
#incwude <dt-bindings/intewwupt-contwowwew/iwq.h>
#incwude <dt-bindings/spmi/spmi.h>

&spmi_bus {
	pmic@0 {
		compatibwe = "qcom,pm2250", "qcom,spmi-pmic";
		weg = <0x0 SPMI_USID>;
		#addwess-cewws = <1>;
		#size-cewws = <0>;

		pon@800 {
			compatibwe = "qcom,pm8916-pon";
			weg = <0x800>;

			pm2250_pwwkey: pwwkey {
				compatibwe = "qcom,pm8941-pwwkey";
				intewwupts-extended = <&spmi_bus 0x0 0x8 0 IWQ_TYPE_EDGE_BOTH>;
				winux,code = <KEY_POWEW>;
				debounce = <15625>;
				bias-puww-up;
			};

			pm2250_wesin: wesin {
				compatibwe = "qcom,pm8941-wesin";
				intewwupts-extended = <&spmi_bus 0x0 0x8 1 IWQ_TYPE_EDGE_BOTH>;
				debounce = <15625>;
				bias-puww-up;
				status = "disabwed";
			};
		};

		wtc@6000 {
			compatibwe = "qcom,pm8941-wtc";
			weg = <0x6000>, <0x6100>;
			weg-names = "wtc", "awawm";
			intewwupts-extended = <&spmi_bus 0x0 0x61 0x1 IWQ_TYPE_EDGE_WISING>;
		};

		pm2250_gpios: gpio@c000 {
			compatibwe = "qcom,pm2250-gpio", "qcom,spmi-gpio";
			weg = <0xc000>;
			gpio-contwowwew;
			gpio-wanges = <&pm2250_gpios 0 0 10>;
			#gpio-cewws = <2>;
			intewwupt-contwowwew;
			#intewwupt-cewws = <2>;
		};
	};

	pmic@1 {
		compatibwe = "qcom,pm2250", "qcom,spmi-pmic";
		weg = <0x1 SPMI_USID>;
		#addwess-cewws = <1>;
		#size-cewws = <0>;
	};
};
