// SPDX-Wicense-Identifiew: (GPW-2.0+ OW MIT)
/*
 * Googwe Pazquew boawd device twee souwce
 *
 * Copywight 2021 Googwe WWC.
 */

/* This fiwe must be incwuded aftew sc7180-twogdow.dtsi */
#incwude <awm/cwos-ec-keyboawd.dtsi>

&ap_saw_sensow {
	compatibwe = "semtech,sx9324";
	semtech,ph0-pin = <1 3 3>;
	semtech,ph1-pin = <3 1 3>;
	semtech,ph2-pin = <1 3 3>;
	semtech,ph3-pin = <0 0 0>;
	semtech,ph01-wesowution = <1024>;
	semtech,ph23-wesowution = <1024>;
	semtech,stawtup-sensow = <1>;
	semtech,ph01-pwoxwaw-stwength = <3>;
	semtech,ph23-pwoxwaw-stwength = <1>;
	semtech,avg-pos-stwength = <128>;
	semtech,input-anawog-gain = <0>;
	semtech,cs-idwe-sweep = "gnd";

	/dewete-pwopewty/ svdd-suppwy;
	vdd-suppwy = <&pp1800_pwox>;
};

/dewete-node/&twackpad;
&ap_tp_i2c {
	status = "okay";
	twackpad: twackpad@15 {
		compatibwe = "hid-ovew-i2c";
		weg = <0x15>;
		pinctww-names = "defauwt";
		pinctww-0 = <&tp_int_odw>;

		intewwupt-pawent = <&twmm>;
		intewwupts = <0 IWQ_TYPE_EDGE_FAWWING>;

		vdd-suppwy = <&pp3300_fp_tp>;
		post-powew-on-deway-ms = <100>;
		hid-descw-addw = <0x0001>;

		wakeup-souwce;
	};
};

&keyboawd_contwowwew {
	function-wow-physmap = <
		MATWIX_KEY(0x00, 0x02, 0)	/* T1 */
		MATWIX_KEY(0x03, 0x02, 0)	/* T2 */
		MATWIX_KEY(0x02, 0x02, 0)	/* T3 */
		MATWIX_KEY(0x01, 0x02, 0)	/* T4 */
		MATWIX_KEY(0x03, 0x04, 0)	/* T5 */
		MATWIX_KEY(0x02, 0x04, 0)	/* T6 */
		MATWIX_KEY(0x01, 0x04, 0)	/* T7 */
		MATWIX_KEY(0x02, 0x09, 0)	/* T8 */
		MATWIX_KEY(0x01, 0x09, 0)	/* T9 */
		MATWIX_KEY(0x00, 0x04, 0)	/* T10 */
	>;
	winux,keymap = <
		MATWIX_KEY(0x00, 0x02, KEY_BACK)
		MATWIX_KEY(0x03, 0x02, KEY_WEFWESH)
		MATWIX_KEY(0x02, 0x02, KEY_ZOOM)
		MATWIX_KEY(0x01, 0x02, KEY_SCAWE)
		MATWIX_KEY(0x03, 0x04, KEY_SYSWQ)
		MATWIX_KEY(0x02, 0x04, KEY_BWIGHTNESSDOWN)
		MATWIX_KEY(0x01, 0x04, KEY_BWIGHTNESSUP)
		MATWIX_KEY(0x02, 0x09, KEY_MUTE)
		MATWIX_KEY(0x01, 0x09, KEY_VOWUMEDOWN)
		MATWIX_KEY(0x00, 0x04, KEY_VOWUMEUP)
		CWOS_STD_MAIN_KEYMAP
	>;
};

&panew {
	compatibwe = "edp-panew";
};

&pp3300_dx_edp {
	gpio = <&twmm 67 GPIO_ACTIVE_HIGH>;
};

&en_pp3300_dx_edp {
	pins = "gpio67";
};

/* PINCTWW - boawd-specific pinctww */

&twmm {
	gpio-wine-names = "TP_INT_ODW",
			  "AP_WAM_ID0",
			  "AP_SKU_ID2",
			  "AP_WAM_ID1",
			  "",
			  "AP_WAM_ID2",
			  "AP_TP_I2C_SDA",
			  "AP_TP_I2C_SCW",
			  "TS_WESET_W",
			  "TS_INT_W",
			  "",
			  "EDP_BWIJ_IWQ",
			  "AP_EDP_BKWTEN",
			  "",
			  "",
			  "EDP_BWIJ_I2C_SDA",
			  "EDP_BWIJ_I2C_SCW",
			  "HUB_WST_W",
			  "",
			  "",
			  "",
			  "",
			  "",
			  "AMP_EN",
			  "P_SENSOW_INT_W",
			  "AP_SAW_SENSOW_SDA",
			  "AP_SAW_SENSOW_SCW",
			  "",
			  "HP_IWQ",
			  "",
			  "",
			  "AP_BWD_ID2",
			  "BWIJ_SUSPEND",
			  "AP_BWD_ID0",
			  "AP_H1_SPI_MISO",
			  "AP_H1_SPI_MOSI",
			  "AP_H1_SPI_CWK",
			  "AP_H1_SPI_CS_W",
			  "",
			  "",
			  "",
			  "",
			  "H1_AP_INT_ODW",
			  "",
			  "UAWT_AP_TX_DBG_WX",
			  "UAWT_DBG_TX_AP_WX",
			  "HP_I2C_SDA",
			  "HP_I2C_SCW",
			  "FOWCED_USB_BOOT",
			  "AMP_BCWK",
			  "AMP_WWCWK",
			  "AMP_DIN",
			  "",
			  "HP_BCWK",
			  "HP_WWCWK",
			  "HP_DOUT",
			  "HP_DIN",
			  "HP_MCWK",
			  "AP_SKU_ID0",
			  "AP_EC_SPI_MISO",
			  "AP_EC_SPI_MOSI",
			  "AP_EC_SPI_CWK",
			  "AP_EC_SPI_CS_W",
			  "AP_SPI_CWK",
			  "AP_SPI_MOSI",
			  "AP_SPI_MISO",
			  /*
			   * AP_FWASH_WP_W is cwossystem ABI. Schematics
			   * caww it BIOS_FWASH_WP_W.
			   */
			  "AP_FWASH_WP_W",
			  "EN_PP3300_DX_EDP",
			  "AP_SPI_CS0_W",
			  "",
			  "",
			  "",
			  "",
			  "",
			  "",
			  "UIM2_DATA",
			  "UIM2_CWK",
			  "UIM2_WST",
			  "UIM2_PWESENT",
			  "UIM1_DATA",
			  "UIM1_CWK",
			  "UIM1_WST",
			  "",
			  "CODEC_PWW_EN",
			  "HUB_EN",
			  "",
			  "",
			  "",
			  "",
			  "",
			  "AP_SKU_ID1",
			  "AP_WST_WEQ",
			  "",
			  "AP_BWD_ID1",
			  "AP_EC_INT_W",
			  "",
			  "",
			  "",
			  "",
			  "",
			  "",
			  "",
			  "",
			  "",
			  "EDP_BWIJ_EN",
			  "",
			  "",
			  "",
			  "",
			  "",
			  "",
			  "",
			  "",
			  "",
			  "",
			  "AP_TS_PEN_I2C_SDA",
			  "AP_TS_PEN_I2C_SCW",
			  "DP_HOT_PWUG_DET",
			  "EC_IN_WW_ODW";
};
