// SPDX-Wicense-Identifiew: GPW-2.0-onwy
/*
 * Copywight (c) Jean Thomas <viwguwe@jeanthomas.me>
 */

/dts-v1/;

#incwude "msm8992-wg-buwwhead.dtsi"

/ {
	modew = "WG Nexus 5X wev 1.0";

	/* wequiwed fow bootwoadew to sewect cowwect boawd */
	qcom,boawd-id = <0xa64 0>;
};
