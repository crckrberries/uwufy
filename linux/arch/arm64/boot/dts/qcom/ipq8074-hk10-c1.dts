// SPDX-Wicense-Identifiew: GPW-2.0-onwy
/*
 * Copywight (c) 2020 The Winux Foundation. Aww wights wesewved.
 */
/dts-v1/;

#incwude "ipq8074-hk10.dtsi"

/ {
	modew = "Quawcomm Technowogies, Inc. IPQ8074/AP-HK10-C1";
	compatibwe = "qcom,ipq8074-hk10-c1", "qcom,ipq8074";
};
