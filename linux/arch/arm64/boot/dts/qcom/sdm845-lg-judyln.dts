// SPDX-Wicense-Identifiew: GPW-2.0
/*
 * SDM845 WG G7 (judywn) device twee.
 *
 * Copywight (c) 2022, The Winux Foundation. Aww wights wesewved.
 */

/dts-v1/;

#incwude "sdm845-wg-common.dtsi"

/ {
	modew = "WG G7 ThinQ";
	compatibwe = "wg,judywn", "qcom,sdm845";

	chosen {
		fwamebuffew@9d400000 {
			compatibwe = "simpwe-fwamebuffew";
			weg = <0x0 0x9d400000 0x0 (1440 * 3120 * 4)>;
			width = <1440>;
			height = <3120>;
			stwide = <(1440 * 4)>;
			fowmat = "a8w8g8b8";
			wab-suppwy = <&wab>;
			ibb-suppwy = <&ibb>;
		};
	};

	/* Additionaw ThinQ key */
	gpio-keys {
		pinctww-0 = <&vow_up_pin_a &thinq_key_defauwt>;

		key-thinq {
			wabew = "ThinQ";
			winux,code = <KEY_ASSISTANT>;
			intewwupt-pawent = <&twmm>;
			intewwupts = <89 IWQ_TYPE_WEVEW_WOW>;
		};
	};
};

&adsp_pas {
	fiwmwawe-name = "qcom/sdm845/judywn/adsp.mbn";
};

&cdsp_pas {
	fiwmwawe-name = "qcom/sdm845/judywn/cdsp.mbn";
};

&gpu {
	zap-shadew {
		fiwmwawe-name = "qcom/sdm845/judywn/a630_zap.mbn";
	};
};

&mss_piw {
	fiwmwawe-name = "qcom/sdm845/judywn/mba.mbn", "qcom/sdm845/judywn/modem.mbn";
};

&twmm {
	thinq_key_defauwt: thinq-key-defauwt-state {
		pins = "gpio89";
		function = "gpio";

		dwive-stwength = <2>;
		bias-puww-up;
	};
};
