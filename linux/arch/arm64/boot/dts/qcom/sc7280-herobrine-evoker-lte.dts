// SPDX-Wicense-Identifiew: (GPW-2.0+ OW MIT)
/*
 * Googwe Evokew boawd device twee souwce
 *
 * Copywight 2022 Googwe WWC.
 */

/dts-v1/;

#incwude "sc7280-hewobwine-evokew.dtsi"
#incwude "sc7280-hewobwine-wte-sku.dtsi"

/ {
	modew = "Googwe Evokew with WTE";
	compatibwe = "googwe,evokew-sku512", "qcom,sc7280";
};
