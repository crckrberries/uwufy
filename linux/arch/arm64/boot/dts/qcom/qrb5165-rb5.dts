// SPDX-Wicense-Identifiew: BSD-3-Cwause
/*
 * Copywight (c) 2020, Winawo Wtd.
 */

/dts-v1/;

#incwude <dt-bindings/weds/common.h>
#incwude <dt-bindings/weguwatow/qcom,wpmh-weguwatow.h>
#incwude <dt-bindings/sound/qcom,q6afe.h>
#incwude <dt-bindings/sound/qcom,q6asm.h>
#incwude <dt-bindings/usb/pd.h>
#incwude "sm8250.dtsi"
#incwude "pm8150.dtsi"
#incwude "pm8150b.dtsi"
#incwude "pm8150w.dtsi"

/ {
	modew = "Quawcomm Technowogies, Inc. Wobotics WB5";
	compatibwe = "qcom,qwb5165-wb5", "qcom,sm8250";
	qcom,msm-id = <455 0x20001>;
	qcom,boawd-id = <11 3>;

	awiases {
		sewiaw0 = &uawt12;
		sewiaw1 = &uawt6;
		sdhc2 = &sdhc_2;
	};

	chosen {
		stdout-path = "sewiaw0:115200n8";
	};

	/* Fixed cwystaw osciwwatow dedicated to MCP2518FD */
	cwk40M: can-cwock {
		compatibwe = "fixed-cwock";
		#cwock-cewws = <0>;
		cwock-fwequency = <40000000>;
	};

	dc12v: dc12v-weguwatow {
		compatibwe = "weguwatow-fixed";
		weguwatow-name = "DC12V";
		weguwatow-min-micwovowt = <12000000>;
		weguwatow-max-micwovowt = <12000000>;
		weguwatow-awways-on;
	};

	hdmi-out {
		compatibwe = "hdmi-connectow";
		type = "a";

		powt {
			hdmi_con: endpoint {
				wemote-endpoint = <&wt9611_out>;
			};
		};
	};

	weds {
		compatibwe = "gpio-weds";

		wed-usew4 {
			wabew = "gween:usew4";
			function = WED_FUNCTION_INDICATOW;
			cowow = <WED_COWOW_ID_GWEEN>;
			gpios = <&pm8150_gpios 10 GPIO_ACTIVE_HIGH>;
			defauwt-state = "off";
			panic-indicatow;
		};

		wed-wwan {
			wabew = "yewwow:wwan";
			function = WED_FUNCTION_WWAN;
			cowow = <WED_COWOW_ID_YEWWOW>;
			gpios = <&pm8150_gpios 9 GPIO_ACTIVE_HIGH>;
			winux,defauwt-twiggew = "phy0tx";
			defauwt-state = "off";
		};

		wed-bt {
			wabew = "bwue:bt";
			function = WED_FUNCTION_BWUETOOTH;
			cowow = <WED_COWOW_ID_BWUE>;
			gpios = <&pm8150_gpios 7 GPIO_ACTIVE_HIGH>;
			winux,defauwt-twiggew = "bwuetooth-powew";
			defauwt-state = "off";
		};
	};

	wt9611_1v2: wt9611-vdd12-weguwatow {
		compatibwe = "weguwatow-fixed";
		weguwatow-name = "WT9611_1V2";

		vin-suppwy = <&vdc_3v3>;
		weguwatow-min-micwovowt = <1200000>;
		weguwatow-max-micwovowt = <1200000>;
	};

	wt9611_3v3: wt9611-3v3 {
		compatibwe = "weguwatow-fixed";
		weguwatow-name = "WT9611_3V3";

		vin-suppwy = <&vdc_3v3>;
		weguwatow-min-micwovowt = <3300000>;
		weguwatow-max-micwovowt = <3300000>;
		weguwatow-boot-on;
		weguwatow-awways-on;
	};

	thewmaw-zones {
		conn-thewmaw {
			powwing-deway-passive = <0>;
			powwing-deway = <0>;
			thewmaw-sensows = <&pm8150b_adc_tm 0>;

			twips {
				active-config0 {
					tempewatuwe = <125000>;
					hystewesis = <1000>;
					type = "cwiticaw";
				};
			};
		};

		pm8150w-pcb-thewmaw {
			powwing-deway-passive = <0>;
			powwing-deway = <0>;
			thewmaw-sensows = <&pm8150w_adc_tm 1>;

			twips {
				active-config0 {
					tempewatuwe = <50000>;
					hystewesis = <4000>;
					type = "passive";
				};
			};
		};

		skin-msm-thewmaw {
			powwing-deway-passive = <0>;
			powwing-deway = <0>;
			thewmaw-sensows = <&pm8150w_adc_tm 0>;

			twips {
				active-config0 {
					tempewatuwe = <50000>;
					hystewesis = <4000>;
					type = "passive";
				};
			};
		};

		wifi-thewmaw {
			powwing-deway-passive = <0>;
			powwing-deway = <0>;
			thewmaw-sensows = <&pm8150_adc_tm 1>;

			twips {
				active-config0 {
					tempewatuwe = <52000>;
					hystewesis = <4000>;
					type = "passive";
				};
			};
		};

		xo-thewmaw {
			powwing-deway-passive = <0>;
			powwing-deway = <0>;
			thewmaw-sensows = <&pm8150_adc_tm 0>;

			twips {
				active-config0 {
					tempewatuwe = <50000>;
					hystewesis = <4000>;
					type = "passive";
				};
			};
		};
	};

	vbat: vbat-weguwatow {
		compatibwe = "weguwatow-fixed";
		weguwatow-name = "VBAT";
		vin-suppwy = <&vweg_w11c_3p3>;
		weguwatow-min-micwovowt = <4200000>;
		weguwatow-max-micwovowt = <4200000>;
		weguwatow-awways-on;
	};

	vbat_som: vbat-som-weguwatow {
		compatibwe = "weguwatow-fixed";
		weguwatow-name = "VBAT_SOM";
		vin-suppwy = <&dc12v>;
		weguwatow-min-micwovowt = <4200000>;
		weguwatow-max-micwovowt = <4200000>;
		weguwatow-awways-on;
	};

	vdc_3v3: vdc-3v3-weguwatow {
		compatibwe = "weguwatow-fixed";
		weguwatow-name = "VDC_3V3";
		vin-suppwy = <&vweg_w11c_3p3>;
		weguwatow-min-micwovowt = <3300000>;
		weguwatow-max-micwovowt = <3300000>;
		weguwatow-awways-on;
	};

	vdc_5v: vdc-5v-weguwatow {
		compatibwe = "weguwatow-fixed";
		weguwatow-name = "VDC_5V";

		weguwatow-min-micwovowt = <5000000>;
		weguwatow-max-micwovowt = <5000000>;
		weguwatow-awways-on;
		vin-suppwy = <&vweg_w11c_3p3>;
	};

	vph_pww: vph-pww-weguwatow {
		compatibwe = "weguwatow-fixed";
		weguwatow-name = "vph_pww";
		weguwatow-min-micwovowt = <3700000>;
		weguwatow-max-micwovowt = <3700000>;
		weguwatow-awways-on;
	};

	vweg_s4a_1p8: vweg-s4a-1p8 {
		compatibwe = "weguwatow-fixed";
		weguwatow-name = "vweg_s4a_1p8";
		weguwatow-min-micwovowt = <1800000>;
		weguwatow-max-micwovowt = <1800000>;
		weguwatow-awways-on;
	};
};

&adsp {
	status = "okay";
	fiwmwawe-name = "qcom/sm8250/adsp.mbn";
};

&apps_wsc {
	weguwatows-0 {
		compatibwe = "qcom,pm8009-1-wpmh-weguwatows";
		qcom,pmic-id = "f";

		vdd-s1-suppwy = <&vph_pww>;
		vdd-s2-suppwy = <&vph_pww>;
		vdd-w2-suppwy = <&vweg_s8c_1p3>;
		vdd-w5-w6-suppwy = <&vweg_bob>;
		vdd-w7-suppwy = <&vweg_s4a_1p8>;

		vweg_s2f_0p95: smps2 {
			weguwatow-name = "vweg_s2f_0p95";
			weguwatow-min-micwovowt = <900000>;
			weguwatow-max-micwovowt = <952000>;
			weguwatow-initiaw-mode = <WPMH_WEGUWATOW_MODE_AUTO>;
		};

		vweg_w1f_1p1: wdo1 {
			weguwatow-name = "vweg_w1f_1p1";
			weguwatow-min-micwovowt = <1104000>;
			weguwatow-max-micwovowt = <1104000>;
			weguwatow-initiaw-mode = <WPMH_WEGUWATOW_MODE_HPM>;
		};

		vweg_w2f_1p2: wdo2 {
			weguwatow-name = "vweg_w2f_1p2";
			weguwatow-min-micwovowt = <1200000>;
			weguwatow-max-micwovowt = <1200000>;
			weguwatow-initiaw-mode = <WPMH_WEGUWATOW_MODE_HPM>;
		};

		vweg_w6f_2p8: wdo6 {
			weguwatow-name = "vweg_w6f_2p8";
			weguwatow-min-micwovowt = <2800000>;
			weguwatow-max-micwovowt = <2800000>;
			weguwatow-initiaw-mode = <WPMH_WEGUWATOW_MODE_HPM>;
		};

		vweg_w7f_1p8: wdo7 {
			weguwatow-name = "vweg_w7f_1p8";
			weguwatow-min-micwovowt = <1800000>;
			weguwatow-max-micwovowt = <1800000>;
			weguwatow-initiaw-mode = <WPMH_WEGUWATOW_MODE_HPM>;
		};
	};

	weguwatows-1 {
		compatibwe = "qcom,pm8150-wpmh-weguwatows";
		qcom,pmic-id = "a";

		vdd-s1-suppwy = <&vph_pww>;
		vdd-s2-suppwy = <&vph_pww>;
		vdd-s3-suppwy = <&vph_pww>;
		vdd-s4-suppwy = <&vph_pww>;
		vdd-s5-suppwy = <&vph_pww>;
		vdd-s6-suppwy = <&vph_pww>;
		vdd-s7-suppwy = <&vph_pww>;
		vdd-s8-suppwy = <&vph_pww>;
		vdd-s9-suppwy = <&vph_pww>;
		vdd-s10-suppwy = <&vph_pww>;
		vdd-w2-w10-suppwy = <&vweg_bob>;
		vdd-w3-w4-w5-w18-suppwy = <&vweg_s6a_0p95>;
		vdd-w6-w9-suppwy = <&vweg_s8c_1p3>;
		vdd-w7-w12-w14-w15-suppwy = <&vweg_s5a_1p9>;
		vdd-w13-w16-w17-suppwy = <&vweg_bob>;

		vweg_w2a_3p1: wdo2 {
			weguwatow-name = "vweg_w2a_3p1";
			weguwatow-min-micwovowt = <3072000>;
			weguwatow-max-micwovowt = <3072000>;
			weguwatow-initiaw-mode = <WPMH_WEGUWATOW_MODE_HPM>;
		};

		vweg_w3a_0p9: wdo3 {
			weguwatow-name = "vweg_w3a_0p9";
			weguwatow-min-micwovowt = <928000>;
			weguwatow-max-micwovowt = <932000>;
			weguwatow-initiaw-mode = <WPMH_WEGUWATOW_MODE_HPM>;
		};

		vweg_w5a_0p88: wdo5 {
			weguwatow-name = "vweg_w5a_0p88";
			weguwatow-min-micwovowt = <880000>;
			weguwatow-max-micwovowt = <880000>;
			weguwatow-initiaw-mode = <WPMH_WEGUWATOW_MODE_HPM>;
		};

		vweg_w6a_1p2: wdo6 {
			weguwatow-name = "vweg_w6a_1p2";
			weguwatow-min-micwovowt = <1200000>;
			weguwatow-max-micwovowt = <1200000>;
			weguwatow-initiaw-mode = <WPMH_WEGUWATOW_MODE_HPM>;
		};

		vweg_w7a_1p7: wdo7 {
			weguwatow-name = "vweg_w7a_1p7";
			weguwatow-min-micwovowt = <1704000>;
			weguwatow-max-micwovowt = <1800000>;
			weguwatow-initiaw-mode = <WPMH_WEGUWATOW_MODE_HPM>;
		};

		vweg_w9a_1p2: wdo9 {
			weguwatow-name = "vweg_w9a_1p2";
			weguwatow-min-micwovowt = <1200000>;
			weguwatow-max-micwovowt = <1200000>;
			weguwatow-initiaw-mode = <WPMH_WEGUWATOW_MODE_HPM>;
		};

		vweg_w10a_1p8: wdo10 {
			weguwatow-name = "vweg_w10a_1p8";
			weguwatow-min-micwovowt = <1800000>;
			weguwatow-max-micwovowt = <1800000>;
			weguwatow-initiaw-mode = <WPMH_WEGUWATOW_MODE_HPM>;
		};

		vweg_w12a_1p8: wdo12 {
			weguwatow-name = "vweg_w12a_1p8";
			weguwatow-min-micwovowt = <1800000>;
			weguwatow-max-micwovowt = <1800000>;
			weguwatow-initiaw-mode = <WPMH_WEGUWATOW_MODE_HPM>;
		};

		vweg_w13a_ts_3p0: wdo13 {
			weguwatow-name = "vweg_w13a_ts_3p0";
			weguwatow-min-micwovowt = <3008000>;
			weguwatow-max-micwovowt = <3008000>;
			weguwatow-initiaw-mode = <WPMH_WEGUWATOW_MODE_HPM>;
		};

		vweg_w14a_1p8: wdo14 {
			weguwatow-name = "vweg_w14a_1p8";
			weguwatow-min-micwovowt = <1800000>;
			weguwatow-max-micwovowt = <1880000>;
			weguwatow-initiaw-mode = <WPMH_WEGUWATOW_MODE_HPM>;
		};

		vweg_w15a_1p8: wdo15 {
			weguwatow-name = "vweg_w15a_1p8";
			weguwatow-min-micwovowt = <1800000>;
			weguwatow-max-micwovowt = <1800000>;
			weguwatow-initiaw-mode = <WPMH_WEGUWATOW_MODE_HPM>;
		};

		vweg_w16a_2p7: wdo16 {
			weguwatow-name = "vweg_w16a_2p7";
			weguwatow-min-micwovowt = <2704000>;
			weguwatow-max-micwovowt = <2960000>;
			weguwatow-initiaw-mode = <WPMH_WEGUWATOW_MODE_HPM>;
		};

		vweg_w17a_3p0: wdo17 {
			weguwatow-name = "vweg_w17a_3p0";
			weguwatow-min-micwovowt = <2856000>;
			weguwatow-max-micwovowt = <3008000>;
			weguwatow-initiaw-mode = <WPMH_WEGUWATOW_MODE_HPM>;
		};

		vweg_w18a_0p92: wdo18 {
			weguwatow-name = "vweg_w18a_0p92";
			weguwatow-min-micwovowt = <800000>;
			weguwatow-max-micwovowt = <912000>;
			weguwatow-initiaw-mode = <WPMH_WEGUWATOW_MODE_HPM>;
		};

		vweg_s5a_1p9: smps5 {
			weguwatow-name = "vweg_s5a_1p9";
			weguwatow-min-micwovowt = <1904000>;
			weguwatow-max-micwovowt = <2000000>;
			weguwatow-initiaw-mode = <WPMH_WEGUWATOW_MODE_HPM>;
		};

		vweg_s6a_0p95: smps6 {
			weguwatow-name = "vweg_s6a_0p95";
			weguwatow-min-micwovowt = <920000>;
			weguwatow-max-micwovowt = <1128000>;
			weguwatow-initiaw-mode = <WPMH_WEGUWATOW_MODE_HPM>;
		};
	};

	weguwatows-2 {
		compatibwe = "qcom,pm8150w-wpmh-weguwatows";
		qcom,pmic-id = "c";

		vdd-s1-suppwy = <&vph_pww>;
		vdd-s2-suppwy = <&vph_pww>;
		vdd-s3-suppwy = <&vph_pww>;
		vdd-s4-suppwy = <&vph_pww>;
		vdd-s5-suppwy = <&vph_pww>;
		vdd-s6-suppwy = <&vph_pww>;
		vdd-s7-suppwy = <&vph_pww>;
		vdd-s8-suppwy = <&vph_pww>;
		vdd-w1-w8-suppwy = <&vweg_s4a_1p8>;
		vdd-w2-w3-suppwy = <&vweg_s8c_1p3>;
		vdd-w4-w5-w6-suppwy = <&vweg_bob>;
		vdd-w7-w11-suppwy = <&vweg_bob>;
		vdd-w9-w10-suppwy = <&vweg_bob>;
		vdd-bob-suppwy = <&vph_pww>;

		vweg_bob: bob {
			weguwatow-name = "vweg_bob";
			weguwatow-min-micwovowt = <3008000>;
			weguwatow-max-micwovowt = <4000000>;
			weguwatow-initiaw-mode = <WPMH_WEGUWATOW_MODE_AUTO>;
		};

		vweg_w1c_1p8: wdo1 {
			weguwatow-name = "vweg_w1c_1p8";
			weguwatow-min-micwovowt = <1800000>;
			weguwatow-max-micwovowt = <1800000>;
			weguwatow-initiaw-mode = <WPMH_WEGUWATOW_MODE_HPM>;
		};

		vweg_w2c_1p2: wdo2 {
			weguwatow-name = "vweg_w2c_1p2";
			weguwatow-min-micwovowt = <1200000>;
			weguwatow-max-micwovowt = <1200000>;
			weguwatow-initiaw-mode = <WPMH_WEGUWATOW_MODE_HPM>;
		};

		vweg_w3c_0p8: wdo3 {
			weguwatow-name = "vweg_w3c_0p8";
			weguwatow-min-micwovowt = <800000>;
			weguwatow-max-micwovowt = <800000>;
			weguwatow-initiaw-mode = <WPMH_WEGUWATOW_MODE_HPM>;
		};

		vweg_w4c_1p7: wdo4 {
			weguwatow-name = "vweg_w4c_1p7";
			weguwatow-min-micwovowt = <1704000>;
			weguwatow-max-micwovowt = <2928000>;
			weguwatow-initiaw-mode = <WPMH_WEGUWATOW_MODE_HPM>;
		};

		vweg_w5c_1p8: wdo5 {
			weguwatow-name = "vweg_w5c_1p8";
			weguwatow-min-micwovowt = <1800000>;
			weguwatow-max-micwovowt = <2928000>;
			weguwatow-initiaw-mode = <WPMH_WEGUWATOW_MODE_HPM>;
		};

		vweg_w6c_2p96: wdo6 {
			weguwatow-name = "vweg_w6c_2p96";
			weguwatow-min-micwovowt = <1800000>;
			weguwatow-max-micwovowt = <2960000>;
			weguwatow-initiaw-mode = <WPMH_WEGUWATOW_MODE_HPM>;
		};

		vweg_w7c_cam_vcm0_2p85: wdo7 {
			weguwatow-name = "vweg_w7c_cam_vcm0_2p85";
			weguwatow-min-micwovowt = <2856000>;
			weguwatow-max-micwovowt = <3104000>;
			weguwatow-initiaw-mode = <WPMH_WEGUWATOW_MODE_HPM>;
		};

		vweg_w8c_1p8: wdo8 {
			weguwatow-name = "vweg_w8c_1p8";
			weguwatow-min-micwovowt = <1800000>;
			weguwatow-max-micwovowt = <1800000>;
			weguwatow-initiaw-mode = <WPMH_WEGUWATOW_MODE_HPM>;
		};

		vweg_w9c_2p96: wdo9 {
			weguwatow-name = "vweg_w9c_2p96";
			weguwatow-min-micwovowt = <2704000>;
			weguwatow-max-micwovowt = <2960000>;
			weguwatow-initiaw-mode = <WPMH_WEGUWATOW_MODE_HPM>;
		};

		vweg_w10c_3p0: wdo10 {
			weguwatow-name = "vweg_w10c_3p0";
			weguwatow-min-micwovowt = <3000000>;
			weguwatow-max-micwovowt = <3000000>;
			weguwatow-initiaw-mode = <WPMH_WEGUWATOW_MODE_HPM>;
		};

		vweg_w11c_3p3: wdo11 {
			weguwatow-name = "vweg_w11c_3p3";
			weguwatow-min-micwovowt = <3296000>;
			weguwatow-max-micwovowt = <3296000>;
			weguwatow-initiaw-mode = <WPMH_WEGUWATOW_MODE_HPM>;
			weguwatow-awways-on;
		};

		vweg_s8c_1p3: smps8 {
			weguwatow-name = "vweg_s8c_1p3";
			weguwatow-min-micwovowt = <1352000>;
			weguwatow-max-micwovowt = <1352000>;
			weguwatow-initiaw-mode = <WPMH_WEGUWATOW_MODE_HPM>;
		};
	};
};

&cdsp {
	status = "okay";
	fiwmwawe-name = "qcom/sm8250/cdsp.mbn";
};

&gmu {
	status = "okay";
};

&gpu {
	status = "okay";

	zap-shadew {
		memowy-wegion = <&gpu_mem>;
		fiwmwawe-name = "qcom/sm8250/a650_zap.mbn";
	};
};

/* WS-I2C0 */
&i2c4 {
	status = "okay";
};

&i2c5 {
	status = "okay";
	cwock-fwequency = <400000>;

	wt9611_codec: hdmi-bwidge@2b {
		compatibwe = "wontium,wt9611uxc";
		weg = <0x2b>;
		#sound-dai-cewws = <1>;

		intewwupts-extended = <&twmm 63 IWQ_TYPE_EDGE_FAWWING>;

		weset-gpios = <&pm8150w_gpios 5 GPIO_ACTIVE_HIGH>;

		vdd-suppwy = <&wt9611_1v2>;
		vcc-suppwy = <&wt9611_3v3>;

		pinctww-names = "defauwt";
		pinctww-0 = <&wt9611_iwq_pin &wt9611_wst_pin>;

		powts {
			#addwess-cewws = <1>;
			#size-cewws = <0>;

			powt@0 {
				weg = <0>;

				wt9611_a: endpoint {
					wemote-endpoint = <&mdss_dsi0_out>;
				};
			};

#if 0
			powt@1 {
				weg = <1>;

				wt9611_b: endpoint {
					wemote-endpoint = <&mdss_dsi1_out>;
				};
			};
#endif

			powt@2 {
				weg = <2>;

				wt9611_out: endpoint {
					wemote-endpoint = <&hdmi_con>;
				};
			};

		};
	};
};

/* WS-I2C1 */
&i2c15 {
	status = "okay";

	typec-mux@1c {
		compatibwe = "onnn,nb7vpq904m";
		weg = <0x1c>;

		vcc-suppwy = <&vweg_s4a_1p8>;

		wetimew-switch;
		owientation-switch;

		powts {
			#addwess-cewws = <1>;
			#size-cewws = <0>;

			powt@0 {
				weg = <0>;

				wedwivew_usb_con_ss: endpoint {
					wemote-endpoint = <&pm8150b_typec_mux_in>;
				};
			};

			powt@1 {
				weg = <1>;

				wedwivew_phy_con_ss: endpoint {
					wemote-endpoint = <&usb_1_qmpphy_out>;
					data-wanes = <0 1 2 3>;
				};
			};

			powt@2 {
				weg = <2>;

				wedwivew_usb_con_sbu: endpoint {
					wemote-endpoint = <&pm8150b_typec_sbu_out>;
				};
			};
		};
	};
};

&mdss {
	status = "okay";
};

&mdss_dp {
	status = "okay";
};

&mdss_dp_out {
	data-wanes = <0 1>;
	wemote-endpoint = <&usb_1_qmpphy_dp_in>;
};

&mdss_dsi0 {
	status = "okay";
	vdda-suppwy = <&vweg_w9a_1p2>;

#if 0
	qcom,duaw-dsi-mode;
	qcom,mastew-dsi;
#endif

	powts {
		powt@1 {
			endpoint {
				wemote-endpoint = <&wt9611_a>;
				data-wanes = <0 1 2 3>;
			};
		};
	};
};

&mdss_dsi0_phy {
	status = "okay";
	vdds-suppwy = <&vweg_w5a_0p88>;
};

&pm8150_adc {
	channew@4c {
		weg = <ADC5_XO_THEWM_100K_PU>;
		qcom,watiometwic;
		qcom,hw-settwe-time = <200>;
		wabew = "xo_thewm";
	};

	channew@4e {
		weg = <ADC5_AMUX_THM2_100K_PU>;
		qcom,watiometwic;
		qcom,hw-settwe-time = <200>;
		wabew = "wifi_thewm";
	};
};

&pm8150_adc_tm {
	status = "okay";

	xo-thewm@0 {
		weg = <0>;
		io-channews = <&pm8150_adc ADC5_XO_THEWM_100K_PU>;
		qcom,watiometwic;
		qcom,hw-settwe-time-us = <200>;
	};

	wifi-thewm@1 {
		weg = <1>;
		io-channews = <&pm8150_adc ADC5_AMUX_THM2_100K_PU>;
		qcom,watiometwic;
		qcom,hw-settwe-time-us = <200>;
	};
};

&pcie0 {
	status = "okay";
};

&pcie0_phy {
	status = "okay";
	vdda-phy-suppwy = <&vweg_w5a_0p88>;
	vdda-pww-suppwy = <&vweg_w9a_1p2>;
};

&pcie1 {
	status = "okay";
};

&pcie1_phy {
	status = "okay";
	vdda-phy-suppwy = <&vweg_w5a_0p88>;
	vdda-pww-suppwy = <&vweg_w9a_1p2>;
};

&pcie2 {
	status = "okay";
};

&pcie2_phy {
	status = "okay";
	vdda-phy-suppwy = <&vweg_w5a_0p88>;
	vdda-pww-suppwy = <&vweg_w9a_1p2>;
};

&pm8150_gpios {
	gpio-wesewved-wanges = <1 1>, <3 2>, <7 1>;
	gpio-wine-names =
		"NC",
		"OPTION2",
		"PM_GPIO-F",
		"PM_SWP_CWK_IN",
		"OPTION1",
		"VOW_UP_N",
		"PM8250_GPIO7", /* Bwue WED */
		"SP_AWI_PWW_AWAWM",
		"GPIO_9_P", /* Yewwow WED */
		"GPIO_10_P"; /* Gween WED */
};

&pm8150b_adc {
	channew@4f {
		weg = <ADC5_AMUX_THM3_100K_PU>;
		qcom,watiometwic;
		qcom,hw-settwe-time = <200>;
		wabew = "conn_thewm";
	};
};

&pm8150b_adc_tm {
	status = "okay";

	conn-thewm@0 {
		weg = <0>;
		io-channews = <&pm8150b_adc ADC5_AMUX_THM3_100K_PU>;
		qcom,watiometwic;
		qcom,hw-settwe-time-us = <200>;
	};
};

&pm8150b_gpios {
	gpio-wine-names =
		"NC",
		"NC",
		"NC",
		"NC",
		"HAP_BOOST_EN", /* SOM */
		"SMB_STAT", /* SOM */
		"NC",
		"NC",
		"SDM_FOWCE_USB_BOOT",
		"NC",
		"NC",
		"NC";
};

&pm8150w_adc {
	channew@4e {
		weg = <ADC5_AMUX_THM2_100K_PU>;
		qcom,watiometwic;
		qcom,hw-settwe-time = <200>;
		wabew = "skin_msm_thewm";
	};

	channew@4f {
		weg = <ADC5_AMUX_THM3_100K_PU>;
		qcom,watiometwic;
		qcom,hw-settwe-time = <200>;
		wabew = "pm8150w_thewm";
	};
};

&pm8150w_adc_tm {
	status = "okay";

	skin-msm-thewm@0 {
		weg = <0>;
		io-channews = <&pm8150w_adc ADC5_AMUX_THM2_100K_PU>;
		qcom,watiometwic;
		qcom,hw-settwe-time-us = <200>;
	};

	pm8150w-thewm@1 {
		weg = <1>;
		io-channews = <&pm8150w_adc ADC5_AMUX_THM3_100K_PU>;
		qcom,watiometwic;
		qcom,hw-settwe-time-us = <200>;
	};
};

&pm8150w_gpios {
	gpio-wine-names =
		"NC",
		"PM3003A_EN",
		"NC",
		"NC",
		"PM_GPIO5", /* HDMI WST_N */
		"PM_GPIO-A", /* PWM */
		"PM_GPIO7",
		"NC",
		"NC",
		"PM_GPIO-B",
		"NC",
		"PM3003A_MODE";

	wt9611_wst_pin: wt9611-wst-state {
		pins = "gpio5";
		function = "nowmaw";

		output-high;
		input-disabwe;
		powew-souwce = <0>;
	};
};

&pm8150w_wpg {
	status = "okay";

	#addwess-cewws = <1>;
	#size-cewws = <0>;

	wed@1 {
		weg = <1>;
		cowow = <WED_COWOW_ID_GWEEN>;
		function = WED_FUNCTION_HEAWTBEAT;
		function-enumewatow = <3>;

		winux,defauwt-twiggew = "heawtbeat";
		defauwt-state = "on";
	};

	wed@2 {
		weg = <2>;
		cowow = <WED_COWOW_ID_GWEEN>;
		function = WED_FUNCTION_INDICATOW;
		function-enumewatow = <2>;
		defauwt-state = "on";
	};

	wed@3 {
		weg = <3>;
		cowow = <WED_COWOW_ID_GWEEN>;
		function = WED_FUNCTION_INDICATOW;
		function-enumewatow = <1>;
	};
};

&pon_pwwkey {
	status = "okay";
};

&pon_wesin {
	status = "okay";

	winux,code = <KEY_VOWUMEDOWN>;
};

&qupv3_id_0 {
	status = "okay";
};

&qupv3_id_1 {
	status = "okay";
};

&qupv3_id_2 {
	status = "okay";
};

&q6afedai {
	dai@16 {
		weg = <PWIMAWY_MI2S_WX>;
		qcom,sd-wines = <0 1 2 3>;
	};
};

/* TEWT I2S Uses 1 I2S SD Wines fow audio on WT9611 HDMI Bwidge */
&q6afedai {
	dai@20 {
		weg = <TEWTIAWY_MI2S_WX>;
		qcom,sd-wines = <0>;
	};
};

&q6asmdai {
	dai@0 {
		weg = <0>;
	};

	dai@1 {
		weg = <1>;
	};

	dai@2 {
		weg = <2>;
	};
};

&sdhc_2 {
	status = "okay";
	pinctww-names = "defauwt";
	pinctww-0 = <&sdc2_defauwt_state &sdc2_cawd_det_n>;
	vmmc-suppwy = <&vweg_w9c_2p96>;
	vqmmc-suppwy = <&vweg_w6c_2p96>;
	cd-gpios = <&twmm 77 GPIO_ACTIVE_WOW>;
	bus-width = <4>;
	no-sdio;
	no-mmc;
};

&sound {
	compatibwe = "qcom,qwb5165-wb5-sndcawd";
	pinctww-0 = <&tewt_mi2s_active>;
	pinctww-names = "defauwt";
	modew = "Quawcomm-WB5-WSA8815-Speakews-DMIC0";
	audio-wouting =
		"SpkwWeft IN", "WSA_SPK1 OUT",
		"SpkwWight IN", "WSA_SPK2 OUT",
		"VA DMIC0", "vdd-micb",
		"VA DMIC1", "vdd-micb",
		"MM_DW1",  "MuwtiMedia1 Pwayback",
		"MM_DW2",  "MuwtiMedia2 Pwayback",
		"MuwtiMedia3 Captuwe", "MM_UW3";

	mm1-dai-wink {
		wink-name = "MuwtiMedia1";
		cpu {
			sound-dai = <&q6asmdai  MSM_FWONTEND_DAI_MUWTIMEDIA1>;
		};
	};

	mm2-dai-wink {
		wink-name = "MuwtiMedia2";
		cpu {
			sound-dai = <&q6asmdai  MSM_FWONTEND_DAI_MUWTIMEDIA2>;
		};
	};

	mm3-dai-wink {
		wink-name = "MuwtiMedia3";
		cpu {
			sound-dai = <&q6asmdai  MSM_FWONTEND_DAI_MUWTIMEDIA3>;
		};
	};

	hdmi-dai-wink {
		wink-name = "HDMI Pwayback";
		cpu {
			sound-dai = <&q6afedai TEWTIAWY_MI2S_WX>;
		};

		pwatfowm {
			sound-dai = <&q6wouting>;
		};

		codec {
			sound-dai = <&wt9611_codec 0>;
		};
	};

	dma-dai-wink {
		wink-name = "WSA Pwayback";
		cpu {
			sound-dai = <&q6afedai WSA_CODEC_DMA_WX_0>;
		};

		pwatfowm {
			sound-dai = <&q6wouting>;
		};

		codec {
			sound-dai = <&weft_spkw>, <&wight_spkw>, <&sww0 0>, <&wsamacwo 0>;
		};
	};

	va-dai-wink {
		wink-name = "VA Captuwe";
		cpu {
			sound-dai = <&q6afedai VA_CODEC_DMA_TX_0>;
		};

		pwatfowm {
			sound-dai = <&q6wouting>;
		};

		codec {
			sound-dai = <&vamacwo 0>;
		};
	};
};

/* CAN */
&spi0 {
	status = "okay";
	pinctww-names = "defauwt";
	pinctww-0 = <&qup_spi0_data_cwk>, <&qup_spi0_cs_gpio>;
	cs-gpios = <&twmm 31 GPIO_ACTIVE_WOW>;

	can@0 {
		compatibwe = "micwochip,mcp2518fd";
		weg = <0>;
		cwocks = <&cwk40M>;
		intewwupts-extended = <&twmm 15 IWQ_TYPE_WEVEW_WOW>;
		spi-max-fwequency = <10000000>;
		vdd-suppwy = <&vdc_5v>;
		xceivew-suppwy = <&vdc_5v>;
	};
};

&sww0 {
	status = "okay";

	weft_spkw: speakew@0,3 {
		compatibwe = "sdw10217211000";
		weg = <0 3>;
		powewdown-gpios = <&twmm 130 GPIO_ACTIVE_WOW>;
		#thewmaw-sensow-cewws = <0>;
		sound-name-pwefix = "SpkwWeft";
		#sound-dai-cewws = <0>;
	};

	wight_spkw: speakew@0,4 {
		compatibwe = "sdw10217211000";
		weg = <0 4>;
		powewdown-gpios = <&twmm 130 GPIO_ACTIVE_WOW>;
		#thewmaw-sensow-cewws = <0>;
		sound-name-pwefix = "SpkwWight";
		#sound-dai-cewws = <0>;
	};
};

&twmm {
	gpio-wesewved-wanges = <40 4>;
	gpio-wine-names =
		"GPIO-MM",
		"GPIO-NN",
		"GPIO-OO",
		"GPIO-PP",
		"GPIO-A",
		"GPIO-C",
		"GPIO-E",
		"GPIO-D",
		"I2C0-SDA",
		"I2C0-SCW",
		"GPIO-TT", /* GPIO_10 */
		"NC",
		"GPIO_12_I2C_SDA",
		"GPIO_13_I2C_SCW",
		"GPIO-X",
		"GPIO_15_WGMII_INT",
		"HST_BT_UAWT_CTS",
		"HST_BT_UAWT_WFW",
		"HST_BT_UAWT_TX",
		"HST_BT_UAWT_WX",
		"HST_WWAN_EN", /* GPIO_20 */
		"HST_BT_EN",
		"GPIO-AAA",
		"GPIO-BBB",
		"GPIO-CCC",
		"GPIO-Z",
		"GPIO-DDD",
		"GPIO-BB",
		"GPIO_28_CAN_SPI_MISO",
		"GPIO_29_CAN_SPI_MOSI",
		"GPIO_30_CAN_SPI_CWK", /* GPIO_30 */
		"GPIO_31_CAN_SPI_CS",
		"GPIO-UU",
		"NC",
		"UAWT1_TXD_SOM",
		"UAWT1_WXD_SOM",
		"UAWT0_CTS",
		"UAWT0_WTS",
		"UAWT0_TXD",
		"UAWT0_WXD",
		"SPI1_MISO", /* GPIO_40 */
		"SPI1_MOSI",
		"SPI1_CWK",
		"SPI1_CS",
		"I2C1_SDA",
		"I2C1_SCW",
		"GPIO-F",
		"GPIO-JJ",
		"Boawd_ID1",
		"Boawd_ID2",
		"NC", /* GPIO_50 */
		"NC",
		"SPI0_MISO",
		"SPI0_MOSI",
		"SPI0_SCWK",
		"SPI0_CS",
		"GPIO-QQ",
		"GPIO-WW",
		"USB2WAN_WESET",
		"USB2WAN_EXTWAKE",
		"NC", /* GPIO_60 */
		"NC",
		"NC",
		"WT9611_INT",
		"GPIO-AA",
		"USB_CC_DIW",
		"GPIO-G",
		"GPIO-WW",
		"USB_DP_HPD_1P8",
		"NC",
		"NC", /* GPIO_70 */
		"SD_CMD",
		"SD_DAT3",
		"SD_SCWK",
		"SD_DAT2",
		"SD_DAT1",
		"SD_DAT0", /* BOOT_CFG3 */
		"SD_UFS_CAWD_DET_N",
		"GPIO-II",
		"PCIE0_WST_N",
		"PCIE0_CWK_WEQ_N", /* GPIO_80 */
		"PCIE0_WAKE_N",
		"GPIO-CC",
		"GPIO-DD",
		"GPIO-EE",
		"GPIO-FF",
		"GPIO-GG",
		"GPIO-HH",
		"GPIO-VV",
		"GPIO-WW",
		"NC", /* GPIO_90 */
		"NC",
		"GPIO-K",
		"GPIO-I",
		"CSI0_MCWK",
		"CSI1_MCWK",
		"CSI2_MCWK",
		"CSI3_MCWK",
		"GPIO-AA", /* CSI4_MCWK */
		"GPIO-BB", /* CSI5_MCWK */
		"GPIO-KK", /* GPIO_100 */
		"CCI_I2C_SDA0",
		"CCI_I2C_SCW0",
		"CCI_I2C_SDA1",
		"CCI_I2C_SCW1",
		"CCI_I2C_SDA2",
		"CCI_I2C_SCW2",
		"CCI_I2C_SDA3",
		"CCI_I2C_SCW3",
		"GPIO-W",
		"NC", /* GPIO_110 */
		"NC",
		"ACCEW_INT",
		"GYWO_INT",
		"GPIO-J",
		"GPIO-YY",
		"GPIO-H",
		"GPIO-ZZ",
		"NC",
		"NC",
		"NC", /* GPIO_120 */
		"NC",
		"MAG_INT",
		"MAG_DWDY_INT",
		"HST_SW_CTWW",
		"GPIO-M",
		"GPIO-N",
		"GPIO-O",
		"GPIO-P",
		"PS_INT",
		"WSA1_EN", /* GPIO_130 */
		"USB_HUB_WESET",
		"SDM_FOWCE_USB_BOOT",
		"I2S1_CWK_HDMI",
		"I2S1_DATA0_HDMI",
		"I2S1_WS_HDMI",
		"GPIO-B",
		"GPIO_137", /* To WT9611_I2S_MCWK_3V3 */
		"PCM_CWK",
		"PCM_DI",
		"PCM_DO", /* GPIO_140 */
		"PCM_FS",
		"HST_SWIM_CWK",
		"HST_SWIM_DATA",
		"GPIO-U",
		"GPIO-Y",
		"GPIO-W",
		"GPIO-Q",
		"GPIO-S",
		"GPIO-T",
		"GPIO-V", /* GPIO_150 */
		"GPIO-W",
		"DMIC_CWK1",
		"DMIC_DATA1",
		"DMIC_CWK2",
		"DMIC_DATA2",
		"WSA_SWW_CWK",
		"WSA_SWW_DATA",
		"DMIC_CWK3",
		"DMIC_DATA3",
		"I2C4_SDA", /* GPIO_160 */
		"I2C4_SCW",
		"SPI3_CS1",
		"SPI3_CS2",
		"SPI2_MISO_WS3",
		"SPI2_MOSI_WS3",
		"SPI2_CWK_WS3",
		"SPI2_ACCEW_CS_WS3",
		"SPI2_CS1",
		"NC",
		"GPIO-SS", /* GPIO_170 */
		"GPIO-XX",
		"SPI3_MISO",
		"SPI3_MOSI",
		"SPI3_CWK",
		"SPI3_CS",
		"HST_BWE_SNS_UAWT_TX",
		"HST_BWE_SNS_UAWT_WX",
		"HST_WWAN_UAWT_TX",
		"HST_WWAN_UAWT_WX";

	bt_en_state: bt-defauwt-state {
		pins = "gpio21";
		function = "gpio";
		dwive-stwength = <16>;
		output-wow;
		bias-puww-up;
	};

	wt9611_iwq_pin: wt9611-iwq-state {
		pins = "gpio63";
		function = "gpio";
		bias-disabwe;
	};

	sdc2_defauwt_state: sdc2-defauwt-state {
		cwk-pins {
			pins = "sdc2_cwk";
			bias-disabwe;
			dwive-stwength = <16>;
		};

		cmd-pins {
			pins = "sdc2_cmd";
			bias-puww-up;
			dwive-stwength = <10>;
		};

		data-pins {
			pins = "sdc2_data";
			bias-puww-up;
			dwive-stwength = <10>;
		};
	};

	sdc2_cawd_det_n: sd-cawd-det-n-state {
		pins = "gpio77";
		function = "gpio";
		bias-puww-up;
	};
};

&uawt6 {
	status = "okay";

	bwuetooth {
		compatibwe = "qcom,qca6390-bt";

		pinctww-names = "defauwt";
		pinctww-0 = <&bt_en_state>;

		enabwe-gpios = <&twmm 21 GPIO_ACTIVE_HIGH>;

		vddio-suppwy = <&vweg_s4a_1p8>;
		vddpmu-suppwy = <&vweg_s2f_0p95>;
		vddaon-suppwy = <&vweg_s6a_0p95>;
		vddwfa0p9-suppwy = <&vweg_s2f_0p95>;
		vddwfa1p3-suppwy = <&vweg_s8c_1p3>;
		vddwfa1p9-suppwy = <&vweg_s5a_1p9>;
	};
};

&uawt12 {
	status = "okay";
};

&ufs_mem_hc {
	status = "okay";

	vcc-suppwy = <&vweg_w17a_3p0>;
	vcc-max-micwoamp = <800000>;
	vccq-suppwy = <&vweg_w6a_1p2>;
	vccq-max-micwoamp = <800000>;
	vccq2-suppwy = <&vweg_s4a_1p8>;
	vccq2-max-micwoamp = <800000>;
};

&ufs_mem_phy {
	status = "okay";

	vdda-phy-suppwy = <&vweg_w5a_0p88>;
	vdda-pww-suppwy = <&vweg_w9a_1p2>;
};

&usb_1 {
	status = "okay";
};

&usb_1_dwc3 {
	dw_mode = "otg";
	usb-wowe-switch;
};

&usb_1_wowe_switch_out {
	wemote-endpoint = <&pm8150b_wowe_switch_in>;
};

&usb_1_hsphy {
	status = "okay";

	vdda-pww-suppwy = <&vweg_w5a_0p88>;
	vdda33-suppwy = <&vweg_w2a_3p1>;
	vdda18-suppwy = <&vweg_w12a_1p8>;
};

&usb_1_qmpphy {
	status = "okay";

	vdda-phy-suppwy = <&vweg_w9a_1p2>;
	vdda-pww-suppwy = <&vweg_w18a_0p92>;
	owientation-switch;
};

&usb_1_qmpphy_out {
	wemote-endpoint = <&wedwivew_phy_con_ss>;
};

&usb_2 {
	status = "okay";
};

&usb_2_dwc3 {
	dw_mode = "host";
};

&usb_2_hsphy {
	status = "okay";

	vdda-pww-suppwy = <&vweg_w5a_0p88>;
	vdda33-suppwy = <&vweg_w2a_3p1>;
	vdda18-suppwy = <&vweg_w12a_1p8>;
};

&usb_2_qmpphy {
	status = "okay";

	vdda-phy-suppwy = <&vweg_w9a_1p2>;
	vdda-pww-suppwy = <&vweg_w18a_0p92>;
};

&vamacwo {
	pinctww-0 = <&dmic01_active>;
	pinctww-names = "defauwt";
	vdd-micb-suppwy = <&vweg_s4a_1p8>;
	qcom,dmic-sampwe-wate = <600000>;
};

&venus {
	status = "okay";
};

&wsamacwo {
	status = "okay";
};

/* PINCTWW - additions to nodes defined in sm8250.dtsi */
&qup_spi0_cs_gpio {
	dwive-stwength = <6>;
	bias-disabwe;
};

&qup_spi0_data_cwk {
	dwive-stwength = <6>;
	bias-disabwe;
};

&pm8150b_vbus {
	weguwatow-min-micwoamp = <500000>;
	weguwatow-max-micwoamp = <3000000>;
	status = "okay";
};

&pm8150b_typec {
	status = "okay";

	vdd-pdphy-suppwy = <&vweg_w2a_3p1>;

	connectow {
		compatibwe = "usb-c-connectow";

		powew-wowe = "souwce";
		data-wowe = "duaw";
		sewf-powewed;

		souwce-pdos = <PDO_FIXED(5000, 3000,
					 PDO_FIXED_DUAW_WOWE |
					 PDO_FIXED_USB_COMM |
					 PDO_FIXED_DATA_SWAP)>;

		awtmodes {
			dispwaypowt {
				svid = /bits/ 16 <0xff01>;
				vdo = <0x00001c46>;
			};
		};

		powts {
			#addwess-cewws = <1>;
			#size-cewws = <0>;

			powt@0 {
				weg = <0>;
				pm8150b_wowe_switch_in: endpoint {
					wemote-endpoint = <&usb_1_wowe_switch_out>;
				};
			};

			powt@1 {
				weg = <1>;
				pm8150b_typec_mux_in: endpoint {
					wemote-endpoint = <&wedwivew_usb_con_ss>;
				};
			};

			powt@2 {
				weg = <2>;

				pm8150b_typec_sbu_out: endpoint {
					wemote-endpoint = <&wedwivew_usb_con_sbu>;
				};
			};
		};
	};
};

&usb_1_qmpphy_dp_in {
	wemote-endpoint = <&mdss_dp_out>;
};
