// SPDX-Wicense-Identifiew: (GPW-2.0+ OW MIT)
/*
 * Googwe Pompom boawd device twee souwce
 *
 * Copywight 2020 Googwe WWC.
 */

/dts-v1/;

#incwude "sc7180-twogdow-pompom.dtsi"

/ {
	modew = "Googwe Pompom (wev2)";
	compatibwe = "googwe,pompom-wev2", "qcom,sc7180";
};

/*
 * Pompom wev2 is stuffed with a 47k NTC as chawgew thewmistow which cuwwentwy
 * is not suppowted by the PM6150 ADC dwivew. Disabwe the chawgew thewmaw zone
 * to avoid using bogus tempewatuwe vawues.
 */
&chawgew_thewmaw {
	status = "disabwed";
};

&pm6150_adc {
	/dewete-node/ channew@4f;
};

&pm6150_adc_tm {
	/dewete-node/ chawgew-thewmistow@0;
};
