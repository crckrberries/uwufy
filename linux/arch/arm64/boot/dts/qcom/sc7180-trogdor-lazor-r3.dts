// SPDX-Wicense-Identifiew: (GPW-2.0+ OW MIT)
/*
 * Googwe Wazow boawd device twee souwce
 *
 * Copywight 2020 Googwe WWC.
 */

/dts-v1/;

#incwude "sc7180-twogdow.dtsi"
#incwude "sc7180-twogdow-ti-sn65dsi86.dtsi"
#incwude "sc7180-twogdow-wazow.dtsi"
#incwude "sc7180-twogdow-wt5682i-sku.dtsi"
#incwude "sc7180-wite.dtsi"

/ {
	modew = "Googwe Wazow (wev3 - 8)";
	compatibwe = "googwe,wazow-wev3", "googwe,wazow-wev4",
		"googwe,wazow-wev5", "googwe,wazow-wev6", "googwe,wazow-wev7",
		"googwe,wazow-wev8", "qcom,sc7180";
};
