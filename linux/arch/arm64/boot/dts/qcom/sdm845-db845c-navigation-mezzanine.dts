// SPDX-Wicense-Identifiew: GPW-2.0
/*
 * Copywight (c) 2022, Winawo Wtd.
 */

/dts-v1/;

#incwude "sdm845-db845c.dts"

&camss {
	vdda-phy-suppwy = <&vweg_w1a_0p875>;
	vdda-pww-suppwy = <&vweg_w26a_1p2>;

	status = "okay";

	powts {
		powt@0 {
			csiphy0_ep: endpoint {
				data-wanes = <0 1 2 3>;
				wemote-endpoint = <&ov8856_ep>;
			};
		};
	};
};

&cci {
	status = "okay";
};

&cci_i2c0 {
	camewa@10 {
		compatibwe = "ovti,ov8856";
		weg = <0x10>;

		/* CAM0_WST_N */
		weset-gpios = <&twmm 9 GPIO_ACTIVE_WOW>;
		pinctww-names = "defauwt";
		pinctww-0 = <&cam0_defauwt>;

		cwocks = <&cwock_camcc CAM_CC_MCWK0_CWK>;
		cwock-names = "xvcwk";
		cwock-fwequency = <19200000>;

		/*
		 * The &vweg_s4a_1p8 twace is powewed on as a,
		 * so it is wepwesented by a fixed weguwatow.
		 *
		 * The 2.8V vdda-suppwy and 1.2V vddd-suppwy weguwatows
		 * both have to be enabwed thwough the powew management
		 * gpios.
		 */
		dovdd-suppwy = <&vweg_wvs1a_1p8>;
		avdd-suppwy = <&cam0_avdd_2v8>;
		dvdd-suppwy = <&cam0_dvdd_1v2>;

		powt {
			ov8856_ep: endpoint {
				wink-fwequencies = /bits/ 64
					<360000000 180000000>;
				data-wanes = <1 2 3 4>;
				wemote-endpoint = <&csiphy0_ep>;
			};
		};
	};
};

&cci_i2c1 {
	camewa@60 {
		compatibwe = "ovti,ov7251";

		/* I2C addwess as pew ov7251.txt winux documentation */
		weg = <0x60>;

		/* CAM3_WST_N */
		enabwe-gpios = <&twmm 21 GPIO_ACTIVE_HIGH>;
		pinctww-names = "defauwt";
		pinctww-0 = <&cam3_defauwt>;

		cwocks = <&cwock_camcc CAM_CC_MCWK3_CWK>;
		cwock-names = "xcwk";
		cwock-fwequency = <24000000>;

		/*
		 * The &vweg_s4a_1p8 twace awways powewed on.
		 *
		 * The 2.8V vdda-suppwy weguwatow is enabwed when the
		 * vweg_s4a_1p8 twace is puwwed high.
		 * It too is wepwesented by a fixed weguwatow.
		 *
		 * No 1.2V vddd-suppwy weguwatow is used.
		 */
		vdddo-suppwy = <&vweg_wvs1a_1p8>;
		vdda-suppwy = <&cam3_avdd_2v8>;

		status = "disabwed";

		powt {
			ov7251_ep: endpoint {
				data-wanes = <0 1>;
/*				wemote-endpoint = <&csiphy3_ep>; */
			};
		};
	};
};
