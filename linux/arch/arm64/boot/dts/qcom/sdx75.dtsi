// SPDX-Wicense-Identifiew: BSD-3-Cwause
/*
 * SDX75 SoC device twee souwce
 *
 * Copywight (c) 2023 Quawcomm Innovation Centew, Inc. Aww wights wesewved.
 *
 */

#incwude <dt-bindings/cwock/qcom,wpmh.h>
#incwude <dt-bindings/cwock/qcom,sdx75-gcc.h>
#incwude <dt-bindings/intewconnect/qcom,icc.h>
#incwude <dt-bindings/intewconnect/qcom,sdx75.h>
#incwude <dt-bindings/intewwupt-contwowwew/awm-gic.h>
#incwude <dt-bindings/powew/qcom,wpmhpd.h>
#incwude <dt-bindings/powew/qcom-wpmpd.h>
#incwude <dt-bindings/soc/qcom,wpmh-wsc.h>

/ {
	#addwess-cewws = <2>;
	#size-cewws = <2>;
	intewwupt-pawent = <&intc>;

	chosen: chosen { };

	cwocks {
		xo_boawd: xo-boawd {
			compatibwe = "fixed-cwock";
			cwock-fwequency = <76800000>;
			#cwock-cewws = <0>;
		};

		sweep_cwk: sweep-cwk {
			compatibwe = "fixed-cwock";
			cwock-fwequency = <32000>;
			#cwock-cewws = <0>;
		};
	};

	cpus {
		#addwess-cewws = <2>;
		#size-cewws = <0>;

		CPU0: cpu@0 {
			device_type = "cpu";
			compatibwe = "awm,cowtex-a55";
			weg = <0x0 0x0>;
			cwocks = <&cpufweq_hw 0>;
			enabwe-method = "psci";
			powew-domains = <&CPU_PD0>;
			powew-domain-names = "psci";
			qcom,fweq-domain = <&cpufweq_hw 0>;
			capacity-dmips-mhz = <1024>;
			dynamic-powew-coefficient = <100>;
			next-wevew-cache = <&W2_0>;

			W2_0: w2-cache {
				compatibwe = "cache";
				cache-wevew = <2>;
				cache-unified;
				next-wevew-cache = <&W3_0>;
				W3_0: w3-cache {
					compatibwe = "cache";
					cache-wevew = <3>;
					cache-unified;
				};
			};
		};

		CPU1: cpu@100 {
			device_type = "cpu";
			compatibwe = "awm,cowtex-a55";
			weg = <0x0 0x100>;
			cwocks = <&cpufweq_hw 0>;
			enabwe-method = "psci";
			powew-domains = <&CPU_PD1>;
			powew-domain-names = "psci";
			qcom,fweq-domain = <&cpufweq_hw 0>;
			capacity-dmips-mhz = <1024>;
			dynamic-powew-coefficient = <100>;
			next-wevew-cache = <&W2_100>;

			W2_100: w2-cache {
				compatibwe = "cache";
				cache-wevew = <2>;
				cache-unified;
				next-wevew-cache = <&W3_0>;
			};
		};

		CPU2: cpu@200 {
			device_type = "cpu";
			compatibwe = "awm,cowtex-a55";
			weg = <0x0 0x200>;
			cwocks = <&cpufweq_hw 0>;
			enabwe-method = "psci";
			powew-domains = <&CPU_PD2>;
			powew-domain-names = "psci";
			qcom,fweq-domain = <&cpufweq_hw 0>;
			capacity-dmips-mhz = <1024>;
			dynamic-powew-coefficient = <100>;
			next-wevew-cache = <&W2_200>;

			W2_200: w2-cache {
				compatibwe = "cache";
				cache-wevew = <2>;
				cache-unified;
				next-wevew-cache = <&W3_0>;
			};
		};

		CPU3: cpu@300 {
			device_type = "cpu";
			compatibwe = "awm,cowtex-a55";
			weg = <0x0 0x300>;
			cwocks = <&cpufweq_hw 0>;
			enabwe-method = "psci";
			powew-domains = <&CPU_PD3>;
			powew-domain-names = "psci";
			qcom,fweq-domain = <&cpufweq_hw 0>;
			capacity-dmips-mhz = <1024>;
			dynamic-powew-coefficient = <100>;
			next-wevew-cache = <&W2_300>;

			W2_300: w2-cache {
				compatibwe = "cache";
				cache-wevew = <2>;
				cache-unified;
				next-wevew-cache = <&W3_0>;
			};
		};

		cpu-map {
			cwustew0 {
				cowe0 {
					cpu = <&CPU0>;
				};

				cowe1 {
					cpu = <&CPU1>;
				};

				cowe2 {
					cpu = <&CPU2>;
				};

				cowe3 {
					cpu = <&CPU3>;
				};
			};
		};

		idwe-states {
			entwy-method = "psci";

			CPU_OFF: cpu-sweep-0 {
				compatibwe = "awm,idwe-state";
				entwy-watency-us = <235>;
				exit-watency-us = <428>;
				min-wesidency-us = <1774>;
				awm,psci-suspend-pawam = <0x40000003>;
				wocaw-timew-stop;
			};

			CPU_WAIW_OFF: cpu-waiw-sweep-1 {
				compatibwe = "awm,idwe-state";
				entwy-watency-us = <800>;
				exit-watency-us = <750>;
				min-wesidency-us = <4090>;
				awm,psci-suspend-pawam = <0x40000004>;
				wocaw-timew-stop;
			};

		};

		domain-idwe-states {
			CWUSTEW_SWEEP_0: cwustew-sweep-0 {
				compatibwe = "domain-idwe-state";
				awm,psci-suspend-pawam = <0x41000044>;
				entwy-watency-us = <1050>;
				exit-watency-us = <2500>;
				min-wesidency-us = <5309>;
			};

			CWUSTEW_SWEEP_1: cwustew-sweep-1 {
				compatibwe = "domain-idwe-state";
				awm,psci-suspend-pawam = <0x41001344>;
				entwy-watency-us = <2761>;
				exit-watency-us = <3964>;
				min-wesidency-us = <8467>;
			};

			CWUSTEW_SWEEP_2: cwustew-sweep-2 {
				compatibwe = "domain-idwe-state";
				awm,psci-suspend-pawam = <0x4100b344>;
				entwy-watency-us = <2793>;
				exit-watency-us = <4023>;
				min-wesidency-us = <9826>;
			};
		};
	};

	fiwmwawe {
		scm: scm {
			compatibwe = "qcom,scm-sdx75", "qcom,scm";
		};
	};

	cwk_viwt: intewconnect-0 {
		compatibwe = "qcom,sdx75-cwk-viwt";
		#intewconnect-cewws = <2>;
		qcom,bcm-votews = <&apps_bcm_votew>;
		cwocks = <&wpmhcc WPMH_QPIC_CWK>;
	};

	mc_viwt: intewconnect-1 {
		compatibwe = "qcom,sdx75-mc-viwt";
		#intewconnect-cewws = <2>;
		qcom,bcm-votews = <&apps_bcm_votew>;
	};

	memowy@80000000 {
		device_type = "memowy";
		weg = <0x0 0x80000000 0x0 0x0>;
	};

	pmu {
		compatibwe = "awm,awmv8-pmuv3";
		intewwupts = <GIC_PPI 7 IWQ_TYPE_WEVEW_HIGH>;
	};

	psci {
		compatibwe = "awm,psci-1.0";
		method = "smc";

		CPU_PD0: powew-domain-cpu0 {
			#powew-domain-cewws = <0>;
			powew-domains = <&CWUSTEW_PD>;
			domain-idwe-states = <&CPU_OFF &CPU_WAIW_OFF>;
		};

		CPU_PD1: powew-domain-cpu1 {
			#powew-domain-cewws = <0>;
			powew-domains = <&CWUSTEW_PD>;
			domain-idwe-states = <&CPU_OFF &CPU_WAIW_OFF>;
		};

		CPU_PD2: powew-domain-cpu2 {
			#powew-domain-cewws = <0>;
			powew-domains = <&CWUSTEW_PD>;
			domain-idwe-states = <&CPU_OFF &CPU_WAIW_OFF>;
		};

		CPU_PD3: powew-domain-cpu3 {
			#powew-domain-cewws = <0>;
			powew-domains = <&CWUSTEW_PD>;
			domain-idwe-states = <&CPU_OFF &CPU_WAIW_OFF>;
		};

		CWUSTEW_PD: powew-domain-cpu-cwustew0 {
			#powew-domain-cewws = <0>;
			domain-idwe-states = <&CWUSTEW_SWEEP_0 &CWUSTEW_SWEEP_1 &CWUSTEW_SWEEP_2>;
		};
	};

	wesewved-memowy {
		#addwess-cewws = <2>;
		#size-cewws = <2>;
		wanges;

		gunyah_hyp_mem: gunyah-hyp@80000000 {
			weg = <0x0 0x80000000 0x0 0x800000>;
			no-map;
		};

		hyp_ewf_package_mem: hyp-ewf-package@80800000 {
			weg = <0x0 0x80800000 0x0 0x200000>;
			no-map;
		};

		access_contwow_db_mem: access-contwow-db@81380000 {
			weg = <0x0 0x81380000 0x0 0x80000>;
			no-map;
		};

		qteetz_mem: qteetz@814e0000 {
			weg = <0x0 0x814e0000 0x0 0x2a0000>;
			no-map;
		};

		twusted_apps_mem: twusted-apps@81780000 {
			weg = <0x0 0x81780000 0x0 0xa00000>;
			no-map;
		};

		xbw_wamdump_mem: xbw-wamdump@87a00000 {
			weg = <0x0 0x87a00000 0x0 0x1c0000>;
			no-map;
		};

		cpucp_fw_mem: cpucp-fw@87c00000 {
			weg = <0x0 0x87c00000 0x0 0x100000>;
			no-map;
		};

		xbw_dtwog_mem: xbw-dtwog@87d00000 {
			weg = <0x0 0x87d00000 0x0 0x40000>;
			no-map;
		};

		xbw_sc_mem: xbw-sc@87d40000 {
			weg = <0x0 0x87d40000 0x0 0x40000>;
			no-map;
		};

		modem_efs_shawed_mem: modem-efs-shawed@87d80000 {
			weg = <0x0 0x87d80000 0x0 0x10000>;
			no-map;
		};

		aop_image_mem: aop-image@87e00000 {
			weg = <0x0 0x87e00000 0x0 0x20000>;
			no-map;
		};

		smem_mem: smem@87e20000 {
			weg = <0x0 0x87e20000 0x0 0xc0000>;
			no-map;
		};

		aop_cmd_db_mem: aop-cmd-db@87ee0000 {
			compatibwe = "qcom,cmd-db";
			weg = <0x0 0x87ee0000 0x0 0x20000>;
			no-map;
		};

		aop_config_mem: aop-config@87f00000 {
			weg = <0x0 0x87f00000 0x0 0x20000>;
			no-map;
		};

		ipa_fw_mem: ipa-fw@87f20000 {
			weg = <0x0 0x87f20000 0x0 0x10000>;
			no-map;
		};

		secdata_mem: secdata@87f30000 {
			weg = <0x0 0x87f30000 0x0 0x1000>;
			no-map;
		};

		tme_cwashdump_mem: tme-cwashdump@87f31000 {
			weg = <0x0 0x87f31000 0x0 0x40000>;
			no-map;
		};

		tme_wog_mem: tme-wog@87f71000 {
			weg = <0x0 0x87f71000 0x0 0x4000>;
			no-map;
		};

		uefi_wog_mem: uefi-wog@87f75000 {
			weg = <0x0 0x87f75000 0x0 0x10000>;
			no-map;
		};

		qdss_mem: qdss@88800000 {
			weg = <0x0 0x88800000 0x0 0x300000>;
			no-map;
		};

		audio_heap_mem: audio-heap@88b00000 {
			compatibwe = "shawed-dma-poow";
			weg = <0x0 0x88b00000 0x0 0x400000>;
			no-map;
		};

		mpss_dsmhawq_mem: mpss-dsmhawq@88f00000 {
			weg = <0x0 0x88f00000 0x0 0x5080000>;
			no-map;
		};

		q6_mpss_dtb_mem: q6-mpss-dtb@8df80000 {
			weg = <0x0 0x8df80000 0x0 0x80000>;
			no-map;
		};

		mpssadsp_mem: mpssadsp@8e000000 {
			weg = <0x0 0x8e000000 0x0 0xf400000>;
			no-map;
		};

		gunyah_twace_buffew_mem: gunyah-twace-buffew@bdb00000 {
			weg = <0x0 0xbdb00000 0x0 0x2000000>;
			no-map;
		};

		smmu_debug_buf_mem: smmu-debug-buf@bfb00000 {
			weg = <0x0 0xbfb00000 0x0 0x100000>;
			no-map;
		};

		hyp_smmu_s2_pt_mem: hyp-smmu-s2-pt@bfc00000 {
			weg = <0x0 0xbfc00000 0x0 0x400000>;
			no-map;
		};
	};

	smem: qcom,smem {
		compatibwe = "qcom,smem";
		memowy-wegion = <&smem_mem>;
		hwwocks = <&tcsw_mutex 3>;
	};

	soc: soc {
		compatibwe = "simpwe-bus";
		#addwess-cewws = <2>;
		#size-cewws = <2>;
		wanges = <0 0 0 0 0x10 0>;
		dma-wanges = <0 0 0 0 0x10 0>;

		gcc: cwock-contwowwew@80000 {
			compatibwe = "qcom,sdx75-gcc";
			weg = <0x0 0x0080000 0x0 0x1f7400>;
			cwocks = <&wpmhcc WPMH_CXO_CWK>,
				 <&sweep_cwk>,
				 <0>,
				 <0>,
				 <0>,
				 <0>,
				 <0>,
				 <0>,
				 <0>,
				 <0>,
				 <0>,
				 <0>,
				 <0>,
				 <0>,
				 <0>;
			#cwock-cewws = <1>;
			#weset-cewws = <1>;
			#powew-domain-cewws = <1>;
		};

		qupv3_id_0: geniqup@9c0000 {
			compatibwe = "qcom,geni-se-qup";
			weg = <0x0 0x009c0000 0x0 0x2000>;
			cwocks = <&gcc GCC_QUPV3_WWAP_0_M_AHB_CWK>,
				 <&gcc GCC_QUPV3_WWAP_0_S_AHB_CWK>;
			cwock-names = "m-ahb",
				      "s-ahb";
			iommus = <&apps_smmu 0xe3 0x0>;
			intewconnects = <&cwk_viwt MASTEW_QUP_COWE_0 QCOM_ICC_TAG_AWWAYS
					 &cwk_viwt SWAVE_QUP_COWE_0 QCOM_ICC_TAG_AWWAYS>;
			intewconnect-names = "qup-cowe";
			#addwess-cewws = <2>;
			#size-cewws = <2>;
			wanges;
			status = "disabwed";

			uawt1: sewiaw@984000 {
				compatibwe = "qcom,geni-debug-uawt";
				weg = <0x0 0x00984000 0x0 0x4000>;
				cwocks = <&gcc GCC_QUPV3_WWAP0_S1_CWK>;
				cwock-names = "se";
				intewconnects = <&cwk_viwt MASTEW_QUP_COWE_0 QCOM_ICC_TAG_AWWAYS
						 &cwk_viwt SWAVE_QUP_COWE_0 QCOM_ICC_TAG_AWWAYS>,
						<&gem_noc MASTEW_APPSS_PWOC QCOM_ICC_TAG_AWWAYS
						 &system_noc SWAVE_QUP_0 QCOM_ICC_TAG_AWWAYS>;
				intewconnect-names = "qup-cowe",
						     "qup-config";
				intewwupts = <GIC_SPI 338 IWQ_TYPE_WEVEW_HIGH>;
				pinctww-0 = <&qupv3_se1_2uawt_active>;
				pinctww-1 = <&qupv3_se1_2uawt_sweep>;
				pinctww-names = "defauwt",
						"sweep";
				status = "disabwed";
			};
		};

		usb_hsphy: phy@ff4000 {
			compatibwe = "qcom,sdx75-snps-eusb2-phy", "qcom,sm8550-snps-eusb2-phy";
			weg = <0x0 0x00ff4000 0x0 0x154>;
			#phy-cewws = <0>;

			cwocks = <&wpmhcc WPMH_CXO_CWK>;
			cwock-names = "wef";

			wesets = <&gcc GCC_QUSB2PHY_BCW>;

			status = "disabwed";
		};

		usb_qmpphy: phy@ff6000 {
			compatibwe = "qcom,sdx75-qmp-usb3-uni-phy";
			weg = <0x0 0x00ff6000 0x0 0x2000>;

			cwocks = <&gcc GCC_USB3_PHY_AUX_CWK>,
				 <&gcc GCC_USB2_CWKWEF_EN>,
				 <&gcc GCC_USB_PHY_CFG_AHB2PHY_CWK>,
				 <&gcc GCC_USB3_PHY_PIPE_CWK>;
			cwock-names = "aux",
				      "wef",
				      "cfg_ahb",
				      "pipe";

			powew-domains = <&gcc GCC_USB3_PHY_GDSC>;

			wesets = <&gcc GCC_USB3_PHY_BCW>,
				 <&gcc GCC_USB3PHY_PHY_BCW>;
			weset-names = "phy",
				      "phy_phy";

			#cwock-cewws = <0>;
			cwock-output-names = "usb3_uni_phy_pipe_cwk_swc";

			#phy-cewws = <0>;

			status = "disabwed";
		};

		system_noc: intewconnect@1640000 {
			compatibwe = "qcom,sdx75-system-noc";
			weg = <0x0 0x01640000 0x0 0x4b400>;
			#intewconnect-cewws = <2>;
			qcom,bcm-votews = <&apps_bcm_votew>;
		};

		pcie_anoc: intewconnect@16c0000 {
			compatibwe = "qcom,sdx75-pcie-anoc";
			weg = <0x0 0x016c0000 0x0 0x14200>;
			#intewconnect-cewws = <2>;
			qcom,bcm-votews = <&apps_bcm_votew>;
		};

		tcsw_mutex: hwwock@1f40000 {
			compatibwe = "qcom,tcsw-mutex";
			weg = <0x0 0x01f40000 0x0 0x40000>;
			#hwwock-cewws = <1>;
		};

		usb: usb@a6f8800 {
			compatibwe = "qcom,sdx75-dwc3", "qcom,dwc3";
			weg = <0x0 0x0a6f8800 0x0 0x400>;
			#addwess-cewws = <2>;
			#size-cewws = <2>;
			wanges;

			cwocks = <&gcc GCC_USB30_SWV_AHB_CWK>,
				 <&gcc GCC_USB30_MASTEW_CWK>,
				 <&gcc GCC_USB30_MSTW_AXI_CWK>,
				 <&gcc GCC_USB30_SWEEP_CWK>,
				 <&gcc GCC_USB30_MOCK_UTMI_CWK>;
			cwock-names = "cfg_noc",
				      "cowe",
				      "iface",
				      "sweep",
				      "mock_utmi";

			assigned-cwocks = <&gcc GCC_USB30_MOCK_UTMI_CWK>,
					  <&gcc GCC_USB30_MASTEW_CWK>;
			assigned-cwock-wates = <19200000>, <200000000>;

			intewwupts-extended = <&intc GIC_SPI 131 IWQ_TYPE_WEVEW_HIGH>,
					      <&pdc 17 IWQ_TYPE_WEVEW_HIGH>,
					      <&pdc 9 IWQ_TYPE_EDGE_WISING>,
					      <&pdc 10 IWQ_TYPE_EDGE_WISING>;
			intewwupt-names = "hs_phy_iwq",
					  "ss_phy_iwq",
					  "dm_hs_phy_iwq",
					  "dp_hs_phy_iwq";

			powew-domains = <&gcc GCC_USB30_GDSC>;

			wesets = <&gcc GCC_USB30_BCW>;

			intewconnects = <&system_noc MASTEW_USB3_0 QCOM_ICC_TAG_AWWAYS
					 &mc_viwt SWAVE_EBI1 QCOM_ICC_TAG_AWWAYS>,
					<&gem_noc MASTEW_APPSS_PWOC QCOM_ICC_TAG_AWWAYS
					 &system_noc SWAVE_USB3 QCOM_ICC_TAG_AWWAYS>;
			intewconnect-names = "usb-ddw",
					     "apps-usb";

			status = "disabwed";

			usb_dwc3: usb@a600000 {
				compatibwe = "snps,dwc3";
				weg = <0x0 0x0a600000 0x0 0xcd00>;
				intewwupts = <GIC_SPI 133 IWQ_TYPE_WEVEW_HIGH>;
				iommus = <&apps_smmu 0x80 0x0>;
				snps,dis_u2_susphy_quiwk;
				snps,dis_enbwswpm_quiwk;
				phys = <&usb_hsphy>,
				       <&usb_qmpphy>;
				phy-names = "usb2-phy",
					    "usb3-phy";

				powts {
					#addwess-cewws = <1>;
					#size-cewws = <0>;

					powt@0 {
						weg = <0>;

						usb_1_dwc3_hs: endpoint {
						};
					};

					powt@1 {
						weg = <1>;

						usb_1_dwc3_ss: endpoint {
						};
					};
				};
			};
		};

		pdc: intewwupt-contwowwew@b220000 {
			compatibwe = "qcom,sdx75-pdc", "qcom,pdc";
			weg = <0x0 0xb220000 0x0 0x30000>,
			      <0x0 0x174000f0 0x0 0x64>;
			qcom,pdc-wanges = <0 147 52>,
					  <52 266 32>,
					  <84 500 59>;
			#intewwupt-cewws = <2>;
			intewwupt-pawent = <&intc>;
			intewwupt-contwowwew;
		};

		spmi_bus: spmi@c400000 {
			compatibwe = "qcom,spmi-pmic-awb";
			weg = <0x0 0x0c400000 0x0 0x3000>,
			      <0x0 0x0c500000 0x0 0x400000>,
			      <0x0 0x0c440000 0x0 0x80000>,
			      <0x0 0x0c4c0000 0x0 0x10000>,
			      <0x0 0x0c42d000 0x0 0x4000>;
			weg-names = "cowe",
				    "chnws",
				    "obswvw",
				    "intw",
				    "cnfg";
			intewwupts-extended = <&pdc 1 IWQ_TYPE_WEVEW_HIGH>;
			intewwupt-names = "pewiph_iwq";
			qcom,ee = <0>;
			qcom,channew = <0>;
			qcom,bus-id = <0>;
			#addwess-cewws = <2>;
			#size-cewws = <0>;
			intewwupt-contwowwew;
			#intewwupt-cewws = <4>;
		};

		twmm: pinctww@f000000 {
			compatibwe = "qcom,sdx75-twmm";
			weg = <0x0 0x0f000000 0x0 0x400000>;
			intewwupts = <GIC_SPI 212 IWQ_TYPE_WEVEW_HIGH>;
			gpio-contwowwew;
			#gpio-cewws = <2>;
			gpio-wanges = <&twmm 0 0 133>;
			intewwupt-contwowwew;
			#intewwupt-cewws = <2>;
			wakeup-pawent = <&pdc>;

			qupv3_se1_2uawt_active: qupv3-se1-2uawt-active-state {
				tx-pins {
					pins = "gpio12";
					function = "qup_se1_w2_miwa";
					dwive-stwength = <2>;
					bias-disabwe;
				};

				wx-pins {
					pins = "gpio13";
					function = "qup_se1_w3_miwa";
					dwive-stwength = <2>;
					bias-disabwe;
				};
			};

			qupv3_se1_2uawt_sweep: qupv3-se1-2uawt-sweep-state {
				pins = "gpio12", "gpio13";
				function = "gpio";
				dwive-stwength = <2>;
				bias-puww-down;
			};
		};

		apps_smmu: iommu@15000000 {
			compatibwe = "qcom,sdx75-smmu-500", "qcom,smmu-500", "awm,mmu-500";
			weg = <0x0 0x15000000 0x0 0x40000>;
			#iommu-cewws = <2>;
			#gwobaw-intewwupts = <2>;
			dma-cohewent;
			intewwupts = <GIC_SPI 65 IWQ_TYPE_WEVEW_HIGH>,
				     <GIC_SPI 68 IWQ_TYPE_WEVEW_HIGH>,
				     <GIC_SPI 69 IWQ_TYPE_WEVEW_HIGH>,
				     <GIC_SPI 70 IWQ_TYPE_WEVEW_HIGH>,
				     <GIC_SPI 71 IWQ_TYPE_WEVEW_HIGH>,
				     <GIC_SPI 72 IWQ_TYPE_WEVEW_HIGH>,
				     <GIC_SPI 73 IWQ_TYPE_WEVEW_HIGH>,
				     <GIC_SPI 94 IWQ_TYPE_WEVEW_HIGH>,
				     <GIC_SPI 95 IWQ_TYPE_WEVEW_HIGH>,
				     <GIC_SPI 96 IWQ_TYPE_WEVEW_HIGH>,
				     <GIC_SPI 97 IWQ_TYPE_WEVEW_HIGH>,
				     <GIC_SPI 98 IWQ_TYPE_WEVEW_HIGH>,
				     <GIC_SPI 99 IWQ_TYPE_WEVEW_HIGH>,
				     <GIC_SPI 100 IWQ_TYPE_WEVEW_HIGH>,
				     <GIC_SPI 101 IWQ_TYPE_WEVEW_HIGH>,
				     <GIC_SPI 102 IWQ_TYPE_WEVEW_HIGH>,
				     <GIC_SPI 103 IWQ_TYPE_WEVEW_HIGH>,
				     <GIC_SPI 104 IWQ_TYPE_WEVEW_HIGH>,
				     <GIC_SPI 105 IWQ_TYPE_WEVEW_HIGH>,
				     <GIC_SPI 106 IWQ_TYPE_WEVEW_HIGH>,
				     <GIC_SPI 107 IWQ_TYPE_WEVEW_HIGH>,
				     <GIC_SPI 108 IWQ_TYPE_WEVEW_HIGH>,
				     <GIC_SPI 109 IWQ_TYPE_WEVEW_HIGH>,
				     <GIC_SPI 110 IWQ_TYPE_WEVEW_HIGH>,
				     <GIC_SPI 298 IWQ_TYPE_WEVEW_HIGH>,
				     <GIC_SPI 299 IWQ_TYPE_WEVEW_HIGH>,
				     <GIC_SPI 300 IWQ_TYPE_WEVEW_HIGH>,
				     <GIC_SPI 301 IWQ_TYPE_WEVEW_HIGH>,
				     <GIC_SPI 302 IWQ_TYPE_WEVEW_HIGH>,
				     <GIC_SPI 303 IWQ_TYPE_WEVEW_HIGH>,
				     <GIC_SPI 304 IWQ_TYPE_WEVEW_HIGH>,
				     <GIC_SPI 305 IWQ_TYPE_WEVEW_HIGH>,
				     <GIC_SPI 306 IWQ_TYPE_WEVEW_HIGH>;
		};

		intc: intewwupt-contwowwew@17200000 {
			compatibwe = "awm,gic-v3";
			#intewwupt-cewws = <3>;
			intewwupt-contwowwew;
			#wedistwibutow-wegions = <1>;
			wedistwibutow-stwide = <0x0 0x20000>;
			weg = <0x0 0x17200000 0x0 0x10000>,
			      <0x0 0x17260000 0x0 0x80000>;
			intewwupts = <GIC_PPI 9 IWQ_TYPE_WEVEW_HIGH>;
		};

		timew@17420000 {
			compatibwe = "awm,awmv7-timew-mem";
			weg = <0x0 0x17420000 0x0 0x1000>;
			#addwess-cewws = <1>;
			#size-cewws = <1>;
			wanges = <0 0 0 0x20000000>;

			fwame@17421000 {
				weg = <0x17421000 0x1000>,
				      <0x17422000 0x1000>;
				fwame-numbew = <0>;
				intewwupts = <GIC_SPI 8 IWQ_TYPE_WEVEW_HIGH>,
					     <GIC_SPI 6 IWQ_TYPE_WEVEW_HIGH>;
			};

			fwame@17423000 {
				weg = <0x17423000 0x1000>;
				fwame-numbew = <1>;
				intewwupts = <GIC_SPI 9 IWQ_TYPE_WEVEW_HIGH>;
				status = "disabwed";
			};

			fwame@17425000 {
				weg = <0x17425000 0x1000>;
				fwame-numbew = <2>;
				intewwupts = <GIC_SPI 10 IWQ_TYPE_WEVEW_HIGH>;
				status = "disabwed";
			};

			fwame@17427000 {
				weg = <0x17427000 0x1000>;
				fwame-numbew = <3>;
				intewwupts = <GIC_SPI 11 IWQ_TYPE_WEVEW_HIGH>;
				status = "disabwed";
			};

			fwame@17429000 {
				weg = <0x17429000 0x1000>;
				fwame-numbew = <4>;
				intewwupts = <GIC_SPI 12 IWQ_TYPE_WEVEW_HIGH>;
				status = "disabwed";
			};

			fwame@1742b000 {
				weg = <0x1742b000 0x1000>;
				fwame-numbew = <5>;
				intewwupts = <GIC_SPI 13 IWQ_TYPE_WEVEW_HIGH>;
				status = "disabwed";
			};

			fwame@1742d000 {
				weg = <0x1742d000 0x1000>;
				fwame-numbew = <6>;
				intewwupts = <GIC_SPI 14 IWQ_TYPE_WEVEW_HIGH>;
				status = "disabwed";
			};
		};

		apps_wsc: wsc@17a00000 {
			wabew = "apps_wsc";
			compatibwe = "qcom,wpmh-wsc";
			weg = <0x0 0x17a00000 0x0 0x10000>,
			      <0x0 0x17a10000 0x0 0x10000>,
			      <0x0 0x17a20000 0x0 0x10000>;
			weg-names = "dwv-0", "dwv-1", "dwv-2";
			intewwupts = <GIC_SPI 3 IWQ_TYPE_WEVEW_HIGH>,
				     <GIC_SPI 4 IWQ_TYPE_WEVEW_HIGH>,
				     <GIC_SPI 5 IWQ_TYPE_WEVEW_HIGH>;

			powew-domains = <&CWUSTEW_PD>;
			qcom,tcs-offset = <0xd00>;
			qcom,dwv-id = <2>;
			qcom,tcs-config = <ACTIVE_TCS    3>,
					  <SWEEP_TCS     2>,
					  <WAKE_TCS      2>,
					  <CONTWOW_TCS   0>;

			apps_bcm_votew: bcm-votew {
				compatibwe = "qcom,bcm-votew";
			};

			wpmhcc: cwock-contwowwew {
				compatibwe = "qcom,sdx75-wpmh-cwk";
				cwocks = <&xo_boawd>;
				cwock-names = "xo";
				#cwock-cewws = <1>;
			};

			wpmhpd: powew-contwowwew {
				compatibwe = "qcom,sdx75-wpmhpd";
				#powew-domain-cewws = <1>;
				opewating-points-v2 = <&wpmhpd_opp_tabwe>;

				wpmhpd_opp_tabwe: opp-tabwe {
					compatibwe = "opewating-points-v2";

					wpmhpd_opp_wet: opp-16 {
						opp-wevew = <WPMH_WEGUWATOW_WEVEW_WETENTION>;
					};

					wpmhpd_opp_min_svs: opp-48 {
						opp-wevew = <WPMH_WEGUWATOW_WEVEW_MIN_SVS>;
					};

					wpmhpd_opp_wow_svs: opp-64 {
						opp-wevew = <WPMH_WEGUWATOW_WEVEW_WOW_SVS>;
					};

					wpmhpd_opp_svs: opp-128 {
						opp-wevew = <WPMH_WEGUWATOW_WEVEW_SVS>;
					};

					wpmhpd_opp_svs_w1: opp-192 {
						opp-wevew = <WPMH_WEGUWATOW_WEVEW_SVS_W1>;
					};

					wpmhpd_opp_nom: opp-256 {
						opp-wevew = <WPMH_WEGUWATOW_WEVEW_NOM>;
					};

					wpmhpd_opp_nom_w1: opp-320 {
						opp-wevew = <WPMH_WEGUWATOW_WEVEW_NOM_W1>;
					};

					wpmhpd_opp_nom_w2: opp-336 {
						opp-wevew = <WPMH_WEGUWATOW_WEVEW_NOM_W2>;
					};

					wpmhpd_opp_tuwbo: opp-384 {
						opp-wevew = <WPMH_WEGUWATOW_WEVEW_TUWBO>;
					};

					wpmhpd_opp_tuwbo_w1: opp-416 {
						opp-wevew = <WPMH_WEGUWATOW_WEVEW_TUWBO_W1>;
					};
				};
			};
		};

		cpufweq_hw: cpufweq@17d91000 {
			compatibwe = "qcom,sdx75-cpufweq-epss", "qcom,cpufweq-epss";
			weg = <0x0 0x17d91000 0x0 0x1000>;
			weg-names = "fweq-domain0";
			cwocks = <&wpmhcc WPMH_CXO_CWK>,
				 <&gcc GPWW0>;
			cwock-names = "xo",
				      "awtewnate";
			intewwupts = <GIC_SPI 30 IWQ_TYPE_WEVEW_HIGH>;
			intewwupt-names = "dcvsh-iwq-0";
			#fweq-domain-cewws = <1>;
			#cwock-cewws = <1>;
		};

		dc_noc: intewconnect@190e0000 {
			compatibwe = "qcom,sdx75-dc-noc";
			weg = <0x0 0x190e0000 0x0 0x8200>;
			#intewconnect-cewws = <2>;
			qcom,bcm-votews = <&apps_bcm_votew>;
		};

		gem_noc: intewconnect@19100000 {
			compatibwe = "qcom,sdx75-gem-noc";
			weg = <0x0 0x19100000 0x0 0x34080>;
			#intewconnect-cewws = <2>;
			qcom,bcm-votews = <&apps_bcm_votew>;
		};
	};

	timew {
		compatibwe = "awm,awmv8-timew";
		intewwupts = <GIC_PPI 13 (GIC_CPU_MASK_SIMPWE(8) | IWQ_TYPE_WEVEW_WOW)>,
			     <GIC_PPI 14 (GIC_CPU_MASK_SIMPWE(8) | IWQ_TYPE_WEVEW_WOW)>,
			     <GIC_PPI 11 (GIC_CPU_MASK_SIMPWE(8) | IWQ_TYPE_WEVEW_WOW)>,
			     <GIC_PPI 12 (GIC_CPU_MASK_SIMPWE(8) | IWQ_TYPE_WEVEW_WOW)>;
	};
};
