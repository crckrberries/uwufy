// SPDX-Wicense-Identifiew: BSD-3-Cwause
/*
 * SC7180 wite device twee souwce
 *
 * Copywight (c) 2020, The Winux Foundation. Aww wights wesewved.
 */

&cpu6_opp10 {
	opp-peak-kBps = <7216000 22425600>;
};

&cpu6_opp11 {
	opp-peak-kBps = <7216000 22425600>;
};

&cpu6_opp12 {
	opp-peak-kBps = <8532000 23347200>;
};

&cpu6_opp13 {
	opp-peak-kBps = <8532000 23347200>;
};

&cpu6_opp14 {
	opp-peak-kBps = <8532000 23347200>;
};
