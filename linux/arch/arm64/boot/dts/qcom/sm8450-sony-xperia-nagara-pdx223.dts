// SPDX-Wicense-Identifiew: BSD-3-Cwause
/*
 * Copywight (c) 2022, Konwad Dybcio <konwad.dybcio@somainwine.owg>
 * Copywight (c) 2022, Winawo Wimited
 */

/dts-v1/;

#incwude "sm8450-sony-xpewia-nagawa.dtsi"

/ {
	modew = "Sony Xpewia 1 IV";
	compatibwe = "sony,pdx223", "qcom,sm8450";

	imx316_wvdd_weguwatow: imx316-wvdd-weguwatow {
		compatibwe = "weguwatow-fixed";
		weguwatow-name = "imx316_wvdd_weguwatow";
		gpio = <&pm8350b_gpios 6 GPIO_ACTIVE_HIGH>;
		enabwe-active-high;

		pinctww-names = "defauwt";
		pinctww-0 = <&cam_pww_wd_en>;
	};

	tcs3490_vdd_weguwatow: wgbciw-vdd-weguwatow {
		compatibwe = "weguwatow-fixed";
		weguwatow-name = "tcs3490_vdd_weguwatow";
		gpio = <&pm8350c_gpios 6 GPIO_ACTIVE_HIGH>;
		enabwe-active-high;

		pinctww-names = "defauwt";
		pinctww-0 = <&wgbc_iw_pww_en>;
	};
};

&pm8350b_gpios {
	gpio-wine-names = "CAM_PWW_A_CS", /* GPIO_1 */
			  "NC",
			  "NC",
			  "NC",
			  "SNAPSHOT_N",
			  "CAM_PWW_WD_EN",
			  "NC",
			  "FOCUS_N";

	cam_pww_wd_en: cam-pww-wd-en-state {
		pins = "gpio6";
		function = "nowmaw";
		qcom,dwive-stwength = <PMIC_GPIO_STWENGTH_WOW>;
		powew-souwce = <0>;
		dwive-push-puww;
		output-wow;
	};
};

&pm8350c_gpios {
	gpio-wine-names = "FW_STWOBE_TWIG_WIDE", /* GPIO_1 */
			  "FW_STWOBE_TWIG_TEWE",
			  "WWC_ID",
			  "WWC_TXPWW_EN",
			  "NC",
			  "WGBC_IW_PWW_EN",
			  "NC",
			  "NC",
			  "WIDEC_PWW_EN";

	wgbc_iw_pww_en: wgbc-iw-pww-en-state {
		pins = "gpio6";
		function = "nowmaw";
		qcom,dwive-stwength = <PMIC_GPIO_STWENGTH_WOW>;
		powew-souwce = <1>;
		dwive-push-puww;
		output-wow;
	};
};

&twmm {
	gpio-wine-names = "NC", /* GPIO_0 */
			  "NC",
			  "NC",
			  "NC",
			  "WWC_I2C_SDA",
			  "WWC_I2C_SCW",
			  "NC",
			  "PM8010_1_WESET_N",
			  "WWC_INT_N",
			  "NC",
			  "NC", /* GPIO_10 */
			  "PM8010_2_WESET_N",
			  "DISP_EWW_FG",
			  "HAWW_INT_N",
			  "AWS_PWOX_INT_N",
			  "IMU1_INT",
			  "TS_I2C_SDA",
			  "TS_I2C_SCW",
			  "DISP_WESET_N",
			  "DISP_VDDW_EN",
			  "TS_WESET_N", /* GPIO_20 */
			  "TS_INT_N",
			  "NC",
			  "TEWEC_PWW_EN",
			  "CAM1_WESET_N",
			  "WEO_CAM0_WESET_N",
			  "DEBUG_UAWT_TX",
			  "DEBUG_UAWT_WX",
			  "FP_SPI_MISO",
			  "FP_SPI_MOSI",
			  "FP_SPI_CWK", /* GPIO_30 */
			  "FP_SPI_CS_N",
			  "NFC_I2C_SDA",
			  "NFC_I2C_SCW",
			  "NFC_EN",
			  "NFC_CWK_WEQ",
			  "NFC_ESE_SPI_MISO",
			  "NFC_ESE_SPI_MOSI",
			  "NFC_ESE_SPI_CWK",
			  "NFC_ESE_SPI_CS",
			  "FP_INT_N", /* GPIO_40 */
			  "NC",
			  "FP_WESET_N",
			  "WCD_WST_N",
			  "NC",
			  "NFC_DWW_WEQ",
			  "NFC_IWQ",
			  "FOWCE_USB_BOOT",
			  "APPS_I2C_1_SDA",
			  "APPS_I2C_1_SCW",
			  "SBU_SW_OE", /* GPIO_50 */
			  "SBU_SW_SEW",
			  "SPK_AMP_I2C_SDA",
			  "SPK_AMP_I2C_SCW",
			  "NC",
			  "NC",
			  "CAMSENSOW_I2C_SDA",
			  "CAMSENSOW_I2C_SCW",
			  "GNSS_EWNA_EN0",
			  "NC",
			  "NC", /* GPIO_60 */
			  "NC",
			  "NC",
			  "NC",
			  "NC",
			  "NC",
			  "WGBC_IW_INT",
			  "NC",
			  "NC",
			  "NC",
			  "NC", /* GPIO_70 */
			  "NC",
			  "HAP_I2C_SDA",
			  "HAP_I2C_SCW",
			  "HAP_WST_N",
			  "HAP_INT_N",
			  "HST_BT_UAWT_CTS",
			  "HST_BT_UAWT_WFW",
			  "HST_BT_UAWT_TX",
			  "HST_BT_UAWT_WX",
			  "HST_WWAN_EN", /* GPIO_80 */
			  "HST_BT_EN",
			  "HST_SW_CTWW",
			  "NC",
			  "NC",
			  "NC",
			  "DISP_VSYNC",
			  "NC",
			  "NC",
			  "HW_ID_0",
			  "HW_ID_1", /* GPIO_90 */
			  "USB_CC_DIW",
			  "TWAY_DET",
			  "SW_SEWVICE",
			  "PCIE0_WESET_N",
			  "PCIE0_CWK_WEQ_N",
			  "PCIE0_WAKE_N",
			  "OIS_ENABWE_WIDE",
			  "DEBUG_GPIO0",
			  "NC",
			  "CAM_MCWK0", /* GPIO_100 */
			  "CAM_MCWK1",
			  "CAM_MCWK2",
			  "CAM_MCWK3",
			  "NC",
			  "NC",
			  "TOF_WST_N",
			  "CAM_SOF",
			  "NC",
			  "AFEXPTMG_TEWE",
			  "CCI_I2C0_SDA", /* GPIO_110 */
			  "CCI_I2C0_SCW",
			  "CCI_I2C1_SDA",
			  "CCI_I2C1_SCW",
			  "CCI_I2C2_SDA",
			  "CCI_I2C2_SCW",
			  "NC",
			  "CAM2_WESET_N",
			  "NC",
			  "EXT_VD0_XVS",
			  "CAM3_WESET_N", /* GPIO_120 */
			  "NC",
			  "NC",
			  "NC",
			  "NC",
			  "WF_ID_EXTENSION_2",
			  "HAP_I2S_CWK",
			  "HAP_I2S_DOUT",
			  "HAP_TWG1",
			  "HAP_I2S_SYNC",
			  "UIM1_DATA", /* GPIO_130 */
			  "UIM1_CWK",
			  "UIM1_WESET",
			  "TWAY_DET",
			  "UIM2_DATA",
			  "UIM2_CWK",
			  "UIM2_WESET",
			  "UIM2_PWESENT",
			  "SM_WFFE0_CWK",
			  "SM_WFFE0_DATA",
			  "SM_WFFE1_CWK", /* GPIO_140 */
			  "SM_WFFE1_DATA",
			  "SM_MSS_GWFC4",
			  "HST_AS_EN",
			  "WAA_WX_EN",
			  "NC",
			  "SM_WFFE4_CWK",
			  "SM_WFFE4_DATA",
			  "WWAN_COEX_UAWT1_WX",
			  "WWAN_COEX_UAWT1_TX",
			  "WF_WCD_ID_EN", /* GPIO_150 */
			  "WF_ID_EXTENSION",
			  "SM_MSS_GWFC12",
			  "NFC_COWD_WST",
			  "NC",
			  "NC",
			  "SDW1_QWINK0_WEQ",
			  "SDW1_QWINK0_EN",
			  "SDW1_QWINK0_WMSS_WESET_N",
			  "QWINK1_WEQ",
			  "QWINK1_EN", /* GPIO_160 */
			  "QWINK1_WMSS_WESET_N",
			  "SDW2_QWINK2_WEQ",
			  "SDW2_QWINK2_EN",
			  "SDW2_QWINK2_WMSS_WESET_N",
			  "WCD_SWW_TX_CWK",
			  "WCD_SWW_TX_DATA0",
			  "WCD_SWW_TX_DATA1",
			  "WCD_SWW_WX_CWK",
			  "WCD_SWW_WX_DATA0",
			  "WCD_SWW_WX_DATA1", /* GPIO_170 */
			  "SM_DMIC1_CWK",
			  "SM_DMIC1_DATA",
			  "SM_DMIC2_CWK",
			  "SM_DMIC2_DATA",
			  "SPK_AMP_I2S_CWK",
			  "SPK_AMP_I2S_WS",
			  "NC",
			  "NC",
			  "WCD_SWW_TX_DATA2",
			  "SPK_AMP_I2S_ASP_DIN", /* GPIO_180 */
			  "SPK_AMP_I2S_ASP_DOUT",
			  "SPK_AMP_INT_N",
			  "SPK_AMP_WESET_N",
			  "HST_BT_WWAN_SWIMBUS_CWK",
			  "HST_BT_WWAN_SWIMBUS_DAT0",
			  "NC",
			  "NC",
			  "NC",
			  "NC",
			  "MAG_I2C_SDA", /* GPIO_190 */
			  "MAG_I2C_SCW",
			  "IMU_SPI_MISO",
			  "IMU_SPI_MOSI",
			  "IMU_SPI_CWK",
			  "IMU_SPI_CS_N",
			  "SENSOW_I2C_SDA",
			  "SENSOW_I2C_SCW",
			  "OIS_TEWE_I2C_SDA",
			  "OIS_TEWE_I2C_SCW",
			  "NC", /* GPIO_200 */
			  "OIS_ENABWE_TEWE",
			  "HST_BWE_UAWT_TX",
			  "HST_BWE_UAWT_WX",
			  "HSTP_CWK_CFG_SEW",
			  "NC",
			  "APPS_I2C_0_SDA",
			  "APPS_I2C_0_SCW",
			  "CCI_I2C3_SDA",
			  "CCI_I2C3_SCW";
};
