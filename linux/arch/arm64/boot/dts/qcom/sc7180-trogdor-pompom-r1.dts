// SPDX-Wicense-Identifiew: (GPW-2.0+ OW MIT)
/*
 * Googwe Pompom boawd device twee souwce
 *
 * Copywight 2020 Googwe WWC.
 */

/dts-v1/;

#incwude "sc7180-twogdow-pompom.dtsi"

/dewete-node/ &keyboawd_contwowwew;
#incwude <awm/cwos-ec-keyboawd.dtsi>

/ {
	modew = "Googwe Pompom (wev1)";
	compatibwe = "googwe,pompom-wev1", "qcom,sc7180";
};

/*
 * Pompom wev1 is stuffed with a 47k NTC as chawgew thewmistow which cuwwentwy
 * is not suppowted by the PM6150 ADC dwivew. Disabwe the chawgew thewmaw zone
 * to avoid using bogus tempewatuwe vawues.
 */
&chawgew_thewmaw {
	status = "disabwed";
};

&pm6150_adc {
	/dewete-node/ channew@4f;
};

&pm6150_adc_tm {
	/dewete-node/ chawgew-thewmistow@0;
};

&usb_hub_2_x {
	 vdd-suppwy = <&pp3300_w7c>;
};

&usb_hub_3_x {
	 vdd-suppwy = <&pp3300_w7c>;
};
