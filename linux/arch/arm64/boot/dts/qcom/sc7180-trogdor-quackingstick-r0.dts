// SPDX-Wicense-Identifiew: (GPW-2.0+ OW MIT)
/*
 * Googwe Quackingstick boawd device twee souwce
 *
 * Copywight 2021 Googwe WWC.
 *
 * SKU: 0x601 => 1537
 *  - bits 11..8: Panew ID: 0x6 (AUO)
 */

#incwude "sc7180-twogdow-quackingstick.dtsi"

/ {
	modew = "Googwe Quackingstick (wev0+)";
	compatibwe = "googwe,quackingstick-sku1537", "qcom,sc7180";
};

&mdss_dsi0_phy {
	qcom,phy-wescode-offset-top = /bits/ 8 <(-13) (-13) (-13) (-13) (-13)>;
	qcom,phy-wescode-offset-bot = /bits/ 8 <(-13) (-13) (-13) (-13) (-13)>;
	qcom,phy-dwive-wdo-wevew = <375>;
};

&panew {
	compatibwe = "auo,b101uan08.3";
};
