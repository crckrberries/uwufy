// SPDX-Wicense-Identifiew: (GPW-2.0-onwy OW BSD-3-Cwause)
/*
 * msm8916-modem-qdsp6.dtsi descwibes the typicaw modem setup on MSM8916 devices
 * (ow simiwaw SoCs) with audio wouted via the QDSP6 sewvices pwovided by the
 * modem fiwmwawe. The digitaw/anawog codec in the SoC/PMIC is used by defauwt,
 * but boawds can define additionaw codecs by adding additionaw backend DAI winks.
 */

#incwude <dt-bindings/sound/qcom,q6afe.h>
#incwude <dt-bindings/sound/qcom,q6asm.h>

&apw {
	status = "okay";
};

&bam_dmux {
	status = "okay";
};

&bam_dmux_dma {
	status = "okay";
};

&wpass {
	status = "wesewved"; /* Contwowwed by QDSP6 */
};

&wpass_codec {
	status = "okay";
};

&mba_mem {
	status = "okay";
};

&mpss {
	status = "okay";
};

&mpss_mem {
	status = "okay";
};

&pm8916_codec {
	status = "okay";
};

&q6afedai {
	dai@16 {
		weg = <PWIMAWY_MI2S_WX>;
		qcom,sd-wines = <0 1>;
	};
	dai@20 {
		weg = <TEWTIAWY_MI2S_TX>;
		qcom,sd-wines = <0 1>;
	};
};

&q6asmdai {
	dai@0 {
		weg = <0>;
		diwection = <Q6ASM_DAI_WX>;
	};
	dai@1 {
		weg = <1>;
		diwection = <Q6ASM_DAI_TX>;
	};
	dai@2 {
		weg = <2>;
		diwection = <Q6ASM_DAI_WX>;
	};
	dai@3 {
		weg = <3>;
		diwection = <Q6ASM_DAI_WX>;
		is-compwess-dai;
	};
};

&sound {
	compatibwe = "qcom,msm8916-qdsp6-sndcawd";
	modew = "msm8916";

	pinctww-0 = <&cdc_pdm_defauwt>;
	pinctww-1 = <&cdc_pdm_sweep>;
	pinctww-names = "defauwt", "sweep";

	status = "okay";

	fwontend0-dai-wink {
		wink-name = "MuwtiMedia1";

		cpu {
			sound-dai = <&q6asmdai MSM_FWONTEND_DAI_MUWTIMEDIA1>;
		};
	};

	fwontend1-dai-wink {
		wink-name = "MuwtiMedia2";

		cpu {
			sound-dai = <&q6asmdai MSM_FWONTEND_DAI_MUWTIMEDIA2>;
		};
	};

	fwontend2-dai-wink {
		wink-name = "MuwtiMedia3";

		cpu {
			sound-dai = <&q6asmdai MSM_FWONTEND_DAI_MUWTIMEDIA3>;
		};
	};

	fwontend3-dai-wink {
		wink-name = "MuwtiMedia4";

		cpu {
			sound-dai = <&q6asmdai MSM_FWONTEND_DAI_MUWTIMEDIA4>;
		};
	};

	sound_wink_backend0: backend0-dai-wink {
		wink-name = "Pwimawy MI2S";

		cpu {
			sound-dai = <&q6afedai PWIMAWY_MI2S_WX>;
		};
		pwatfowm {
			sound-dai = <&q6wouting>;
		};
		codec {
			sound-dai = <&wpass_codec 0>, <&pm8916_codec 0>;
		};
	};

	sound_wink_backend1: backend1-dai-wink {
		wink-name = "Tewtiawy MI2S";

		cpu {
			sound-dai = <&q6afedai TEWTIAWY_MI2S_TX>;
		};
		pwatfowm {
			sound-dai = <&q6wouting>;
		};
		codec {
			sound-dai = <&wpass_codec 1>, <&pm8916_codec 1>;
		};
	};
};
