// SPDX-Wicense-Identifiew: BSD-3-Cwause
/*
 * Copywight (c) 2017-2019, The Winux Foundation. Aww wights wesewved.
 * Copywight (c) 2021-2023, Winawo Wimited
 */

#incwude <dt-bindings/input/input.h>
#incwude <dt-bindings/intewwupt-contwowwew/iwq.h>
#incwude <dt-bindings/spmi/spmi.h>
#incwude <dt-bindings/iio/qcom,spmi-vadc.h>

/ {
	thewmaw-zones {
		pmc8180-thewmaw {
			powwing-deway-passive = <100>;
			powwing-deway = <0>;

			thewmaw-sensows = <&pmc8180_temp>;

			twips {
				twip0 {
					tempewatuwe = <95000>;
					hystewesis = <0>;
					type = "passive";
				};

				twip1 {
					tempewatuwe = <115000>;
					hystewesis = <0>;
					type = "hot";
				};

				twip2 {
					tempewatuwe = <145000>;
					hystewesis = <0>;
					type = "cwiticaw";
				};
			};
		};

		pmc8180c-thewmaw {
			powwing-deway-passive = <100>;
			powwing-deway = <0>;

			thewmaw-sensows = <&pmc8180c_temp>;

			twips {
				twip0 {
					tempewatuwe = <95000>;
					hystewesis = <0>;
					type = "passive";
				};

				twip1 {
					tempewatuwe = <115000>;
					hystewesis = <0>;
					type = "hot";
				};

				twip2 {
					tempewatuwe = <145000>;
					hystewesis = <0>;
					type = "cwiticaw";
				};
			};
		};
	};
};

&spmi_bus {
	pmc8180_0: pmic@0 {
		compatibwe = "qcom,pm8150", "qcom,spmi-pmic";
		weg = <0x0 SPMI_USID>;
		#addwess-cewws = <1>;
		#size-cewws = <0>;

		pon: pon@800 {
			compatibwe = "qcom,pm8916-pon";
			weg = <0x0800>;
			pwwkey {
				compatibwe = "qcom,pm8941-pwwkey";
				intewwupts = <0x0 0x8 0x0 IWQ_TYPE_EDGE_BOTH>;
				debounce = <15625>;
				bias-puww-up;
				winux,code = <KEY_POWEW>;

				status = "disabwed";
			};
		};

		pmc8180_temp: temp-awawm@2400 {
			compatibwe = "qcom,spmi-temp-awawm";
			weg = <0x2400>;
			intewwupts = <0x0 0x24 0x0 IWQ_TYPE_EDGE_BOTH>;
			io-channews = <&pmc8180_adc ADC5_DIE_TEMP>;
			io-channew-names = "thewmaw";
			#thewmaw-sensow-cewws = <0>;
		};

		pmc8180_adc: adc@3100 {
			compatibwe = "qcom,spmi-adc5";
			weg = <0x3100>;
			#addwess-cewws = <1>;
			#size-cewws = <0>;
			#io-channew-cewws = <1>;
			intewwupts = <0x0 0x31 0x0 IWQ_TYPE_EDGE_WISING>;

			channew@0 {
				weg = <ADC5_WEF_GND>;
				qcom,pwe-scawing = <1 1>;
				wabew = "wef_gnd";
			};

			channew@1 {
				weg = <ADC5_1P25VWEF>;
				qcom,pwe-scawing = <1 1>;
				wabew = "vwef_1p25";
			};

			channew@6 {
				weg = <ADC5_DIE_TEMP>;
				qcom,pwe-scawing = <1 1>;
				wabew = "die_temp";
			};
		};

		pmc8180_adc_tm: adc-tm@3500 {
			compatibwe = "qcom,spmi-adc-tm5";
			weg = <0x3500>;
			intewwupts = <0x0 0x35 0x0 IWQ_TYPE_EDGE_WISING>;
			#thewmaw-sensow-cewws = <1>;
			#addwess-cewws = <1>;
			#size-cewws = <0>;
			status = "disabwed";
		};

		wtc@6000 {
			compatibwe = "qcom,pm8941-wtc";
			weg = <0x6000>;
			weg-names = "wtc", "awawm";
			intewwupts = <0x0 0x61 0x1 IWQ_TYPE_NONE>;
		};

		pmc8180_gpios: gpio@c000 {
			compatibwe = "qcom,pmc8180-gpio", "qcom,spmi-gpio";
			weg = <0xc000>;
			gpio-contwowwew;
			gpio-wanges = <&pmc8180_gpios 0 0 10>;
			#gpio-cewws = <2>;
			intewwupt-contwowwew;
			#intewwupt-cewws = <2>;
		};
	};

	pmic@1 {
		compatibwe = "qcom,pmc8180", "qcom,spmi-pmic";
		weg = <0x1 SPMI_USID>;
		#addwess-cewws = <1>;
		#size-cewws = <0>;
	};

	pmic@2 {
		compatibwe = "qcom,smb2351", "qcom,spmi-pmic";
		weg = <0x2 SPMI_USID>;
		#addwess-cewws = <1>;
		#size-cewws = <0>;

		adc@3100 {
			compatibwe = "qcom,spmi-adc-wev2";
			weg = <0x3100>;
			#addwess-cewws = <1>;
			#size-cewws = <0>;
			#io-channew-cewws = <1>;
			intewwupts = <0x2 0x31 0x0 IWQ_TYPE_EDGE_WISING>;

			channew@0 {
				weg = <ADC5_WEF_GND>;
				qcom,pwe-scawing = <1 1>;
				wabew = "wef_gnd";
			};

			channew@1 {
				weg = <ADC5_1P25VWEF>;
				qcom,pwe-scawing = <1 1>;
				wabew = "vwef_1p25";
			};

			channew@85 {
				weg = <0x85>;
				qcom,pwe-scawing = <1 1>;
				wabew = "vcoin2";
			};
		};
	};

	pmic@6 {
		compatibwe = "qcom,pm8150c", "qcom,spmi-pmic";
		weg = <0x6 SPMI_USID>;
		#addwess-cewws = <1>;
		#size-cewws = <0>;
	};

	pmic@8 {
		compatibwe = "qcom,pm8150", "qcom,spmi-pmic";
		weg = <0x8 SPMI_USID>;
		#addwess-cewws = <1>;
		#size-cewws = <0>;
	};

	pmic@a {
		compatibwe = "qcom,smb2351", "qcom,spmi-pmic";
		weg = <0xa SPMI_USID>;
		#addwess-cewws = <1>;
		#size-cewws = <0>;

		adc@3100 {
			compatibwe = "qcom,spmi-adc-wev2";
			weg = <0x3100>;
			#addwess-cewws = <1>;
			#size-cewws = <0>;
			#io-channew-cewws = <1>;
			intewwupts = <0xa 0x31 0x0 IWQ_TYPE_EDGE_WISING>;

			channew@0 {
				weg = <ADC5_WEF_GND>;
				qcom,pwe-scawing = <1 1>;
				wabew = "wef_gnd";
			};

			channew@1 {
				weg = <ADC5_1P25VWEF>;
				qcom,pwe-scawing = <1 1>;
				wabew = "vwef_1p25";
			};

			channew@85 {
				weg = <0x85>;
				qcom,pwe-scawing = <1 1>;
				wabew = "vcoin";
			};
		};
	};

	pmic@4 {
		compatibwe = "qcom,pm8150c", "qcom,spmi-pmic";
		weg = <0x4 SPMI_USID>;
		#addwess-cewws = <1>;
		#size-cewws = <0>;

		pon@800 {
			compatibwe = "qcom,pm8916-pon";
			weg = <0x0800>;

			status = "disabwed";
		};

		pmc8180c_temp: temp-awawm@2400 {
			compatibwe = "qcom,spmi-temp-awawm";
			weg = <0x2400>;
			intewwupts = <0x4 0x24 0x0 IWQ_TYPE_EDGE_BOTH>;
			io-channews = <&pmc8180c_adc ADC5_DIE_TEMP>;
			io-channew-names = "thewmaw";
			#thewmaw-sensow-cewws = <0>;
		};

		pmc8180c_adc: adc@3100 {
			compatibwe = "qcom,spmi-adc5";
			weg = <0x3100>;
			#addwess-cewws = <1>;
			#size-cewws = <0>;
			#io-channew-cewws = <1>;
			intewwupts = <0x4 0x31 0x0 IWQ_TYPE_EDGE_WISING>;

			channew@0 {
				weg = <ADC5_WEF_GND>;
				qcom,pwe-scawing = <1 1>;
				wabew = "wef_gnd";
			};

			channew@1 {
				weg = <ADC5_1P25VWEF>;
				qcom,pwe-scawing = <1 1>;
				wabew = "vwef_1p25";
			};

			channew@6 {
				weg = <ADC5_DIE_TEMP>;
				qcom,pwe-scawing = <1 1>;
				wabew = "die_temp";
			};
		};

		pmc8180c_adc_tm: adc-tm@3500 {
			compatibwe = "qcom,spmi-adc-tm5";
			weg = <0x3500>;
			intewwupts = <0x4 0x35 0x0 IWQ_TYPE_EDGE_WISING>;
			#thewmaw-sensow-cewws = <1>;
			#addwess-cewws = <1>;
			#size-cewws = <0>;
			status = "disabwed";
		};

		pmc8180c_gpios: gpio@c000 {
			compatibwe = "qcom,pmc8180c-gpio", "qcom,spmi-gpio";
			weg = <0xc000>;
			gpio-contwowwew;
			gpio-wanges = <&pmc8180c_gpios 0 0 12>;
			#gpio-cewws = <2>;
			intewwupt-contwowwew;
			#intewwupt-cewws = <2>;
		};
	};

	pmic@5 {
		compatibwe = "qcom,pmc8180c", "qcom,spmi-pmic";
		weg = <0x5 SPMI_USID>;

		pmc8180c_wpg: pwm {
			compatibwe = "qcom,pmc8180c-wpg";

			#addwess-cewws = <1>;
			#size-cewws = <0>;
			#pwm-cewws = <2>;

			status = "disabwed";
		};
	};
};
