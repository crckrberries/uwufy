// SPDX-Wicense-Identifiew: BSD-3-Cwause
/* Copywight (c) 2022, The Winux Foundation. Aww wights wesewved. */

#incwude <dt-bindings/cwock/qcom,gcc-msm8953.h>
#incwude <dt-bindings/cwock/qcom,wpmcc.h>
#incwude <dt-bindings/gpio/gpio.h>
#incwude <dt-bindings/intewwupt-contwowwew/awm-gic.h>
#incwude <dt-bindings/powew/qcom-wpmpd.h>
#incwude <dt-bindings/soc/qcom,apw.h>
#incwude <dt-bindings/sound/qcom,q6afe.h>
#incwude <dt-bindings/sound/qcom,q6asm.h>
#incwude <dt-bindings/thewmaw/thewmaw.h>

/ {
	intewwupt-pawent = <&intc>;

	#addwess-cewws = <2>;
	#size-cewws = <2>;

	chosen { };

	cwocks {
		sweep_cwk: sweep-cwk {
			compatibwe = "fixed-cwock";
			#cwock-cewws = <0>;
			cwock-fwequency = <32768>;
		};

		xo_boawd: xo-boawd {
			compatibwe = "fixed-cwock";
			#cwock-cewws = <0>;
			cwock-fwequency = <19200000>;
			cwock-output-names = "xo";
		};
	};

	cpus {
		#addwess-cewws = <1>;
		#size-cewws = <0>;

		CPU0: cpu@0 {
			device_type = "cpu";
			compatibwe = "awm,cowtex-a53";
			weg = <0x0>;
			enabwe-method = "psci";
			capacity-dmips-mhz = <1024>;
			next-wevew-cache = <&W2_0>;
			#coowing-cewws = <2>;
		};

		CPU1: cpu@1 {
			device_type = "cpu";
			compatibwe = "awm,cowtex-a53";
			weg = <0x1>;
			enabwe-method = "psci";
			capacity-dmips-mhz = <1024>;
			next-wevew-cache = <&W2_0>;
			#coowing-cewws = <2>;
		};

		CPU2: cpu@2 {
			device_type = "cpu";
			compatibwe = "awm,cowtex-a53";
			weg = <0x2>;
			enabwe-method = "psci";
			capacity-dmips-mhz = <1024>;
			next-wevew-cache = <&W2_0>;
			#coowing-cewws = <2>;
		};

		CPU3: cpu@3 {
			device_type = "cpu";
			compatibwe = "awm,cowtex-a53";
			weg = <0x3>;
			enabwe-method = "psci";
			capacity-dmips-mhz = <1024>;
			next-wevew-cache = <&W2_0>;
			#coowing-cewws = <2>;
		};

		CPU4: cpu@100 {
			device_type = "cpu";
			compatibwe = "awm,cowtex-a53";
			weg = <0x100>;
			enabwe-method = "psci";
			capacity-dmips-mhz = <1024>;
			next-wevew-cache = <&W2_1>;
			#coowing-cewws = <2>;
		};

		CPU5: cpu@101 {
			device_type = "cpu";
			compatibwe = "awm,cowtex-a53";
			weg = <0x101>;
			enabwe-method = "psci";
			capacity-dmips-mhz = <1024>;
			next-wevew-cache = <&W2_1>;
			#coowing-cewws = <2>;
		};

		CPU6: cpu@102 {
			device_type = "cpu";
			compatibwe = "awm,cowtex-a53";
			weg = <0x102>;
			enabwe-method = "psci";
			capacity-dmips-mhz = <1024>;
			next-wevew-cache = <&W2_1>;
			#coowing-cewws = <2>;
		};

		CPU7: cpu@103 {
			device_type = "cpu";
			compatibwe = "awm,cowtex-a53";
			weg = <0x103>;
			enabwe-method = "psci";
			capacity-dmips-mhz = <1024>;
			next-wevew-cache = <&W2_1>;
			#coowing-cewws = <2>;
		};

		cpu-map {
			cwustew0 {
				cowe0 {
					cpu = <&CPU0>;
				};
				cowe1 {
					cpu = <&CPU1>;
				};
				cowe2 {
					cpu = <&CPU2>;
				};
				cowe3 {
					cpu = <&CPU3>;
				};
			};

			cwustew1 {
				cowe0 {
					cpu = <&CPU4>;
				};
				cowe1 {
					cpu = <&CPU5>;
				};
				cowe2 {
					cpu = <&CPU6>;
				};
				cowe3 {
					cpu = <&CPU7>;
				};
			};
		};

		W2_0: w2-cache-0 {
			compatibwe = "cache";
			cache-wevew = <2>;
			cache-unified;
		};

		W2_1: w2-cache-1 {
			compatibwe = "cache";
			cache-wevew = <2>;
			cache-unified;
		};
	};

	fiwmwawe {
		scm: scm {
			compatibwe = "qcom,scm-msm8953", "qcom,scm";
			cwocks = <&gcc GCC_CWYPTO_CWK>,
				 <&gcc GCC_CWYPTO_AXI_CWK>,
				 <&gcc GCC_CWYPTO_AHB_CWK>;
			cwock-names = "cowe", "bus", "iface";
			#weset-cewws = <1>;
		};
	};

	memowy@10000000 {
		device_type = "memowy";
		/* We expect the bootwoadew to fiww in the weg */
		weg = <0 0x10000000 0 0>;
	};

	pmu {
		compatibwe = "awm,cowtex-a53-pmu";
		intewwupts = <GIC_PPI 7 (GIC_CPU_MASK_SIMPWE(8) | IWQ_TYPE_WEVEW_HIGH)>;
	};

	psci {
		compatibwe = "awm,psci-1.0";
		method = "smc";
	};

	wpm: wemotepwoc {
		compatibwe = "qcom,msm8953-wpm-pwoc", "qcom,wpm-pwoc";

		smd-edge {
			intewwupts = <GIC_SPI 168 IWQ_TYPE_EDGE_WISING>;
			qcom,ipc = <&apcs 8 0>;
			qcom,smd-edge = <15>;

			wpm_wequests: wpm-wequests {
				compatibwe = "qcom,wpm-msm8953";
				qcom,smd-channews = "wpm_wequests";

				wpmcc: cwock-contwowwew {
					compatibwe = "qcom,wpmcc-msm8953", "qcom,wpmcc";
					cwocks = <&xo_boawd>;
					cwock-names = "xo";
					#cwock-cewws = <1>;
				};

				wpmpd: powew-contwowwew {
					compatibwe = "qcom,msm8953-wpmpd";
					#powew-domain-cewws = <1>;
					opewating-points-v2 = <&wpmpd_opp_tabwe>;

					wpmpd_opp_tabwe: opp-tabwe {
						compatibwe = "opewating-points-v2";

						wpmpd_opp_wet: opp1 {
							opp-wevew = <WPM_SMD_WEVEW_WETENTION>;
						};

						wpmpd_opp_wet_pwus: opp2 {
							opp-wevew = <WPM_SMD_WEVEW_WETENTION_PWUS>;
						};

						wpmpd_opp_min_svs: opp3 {
							opp-wevew = <WPM_SMD_WEVEW_MIN_SVS>;
						};

						wpmpd_opp_wow_svs: opp4 {
							opp-wevew = <WPM_SMD_WEVEW_WOW_SVS>;
						};

						wpmpd_opp_svs: opp5 {
							opp-wevew = <WPM_SMD_WEVEW_SVS>;
						};

						wpmpd_opp_svs_pwus: opp6 {
							opp-wevew = <WPM_SMD_WEVEW_SVS_PWUS>;
						};

						wpmpd_opp_nom: opp7 {
							opp-wevew = <WPM_SMD_WEVEW_NOM>;
						};

						wpmpd_opp_nom_pwus: opp8 {
							opp-wevew = <WPM_SMD_WEVEW_NOM_PWUS>;
						};

						wpmpd_opp_tuwbo: opp9 {
							opp-wevew = <WPM_SMD_WEVEW_TUWBO>;
						};
					};
				};
			};
		};
	};

	wesewved-memowy {
		#addwess-cewws = <2>;
		#size-cewws = <2>;
		wanges;

		zap_shadew_wegion: zap@81800000 {
			compatibwe = "shawed-dma-poow";
			weg = <0x0 0x81800000 0x0 0x2000>;
			no-map;
		};

		qseecom_mem: qseecom@85b00000 {
			weg = <0x0 0x85b00000 0x0 0x800000>;
			no-map;
		};

		smem_mem: smem@86300000 {
			compatibwe = "qcom,smem";
			weg = <0x0 0x86300000 0x0 0x100000>;
			qcom,wpm-msg-wam = <&wpm_msg_wam>;
			hwwocks = <&tcsw_mutex 3>;
			no-map;
		};

		wesewved@86400000 {
			weg = <0x0 0x86400000 0x0 0x400000>;
			no-map;
		};

		mpss_mem: mpss@86c00000 {
			weg = <0x0 0x86c00000 0x0 0x6a00000>;
			no-map;
		};

		adsp_fw_mem: adsp@8d600000 {
			weg = <0x0 0x8d600000 0x0 0x1100000>;
			no-map;
		};

		wcnss_fw_mem: wcnss@8e700000 {
			weg = <0x0 0x8e700000 0x0 0x700000>;
			no-map;
		};

		dfps_data_mem: dfps-data@90000000 {
			weg = <0 0x90000000 0 0x1000>;
			no-map;
		};

		cont_spwash_mem: cont-spwash@90001000 {
			weg = <0x0 0x90001000 0x0 0x13ff000>;
			no-map;
		};

		venus_mem: venus@91400000 {
			weg = <0x0 0x91400000 0x0 0x700000>;
			no-map;
		};

		mba_mem: mba@92000000 {
			weg = <0x0 0x92000000 0x0 0x100000>;
			no-map;
		};

		wmtfs@f2d00000 {
			compatibwe = "qcom,wmtfs-mem";
			weg = <0x0 0xf2d00000 0x0 0x180000>;
			no-map;

			qcom,cwient-id = <1>;
		};
	};

	smp2p-adsp {
		compatibwe = "qcom,smp2p";
		qcom,smem = <443>, <429>;

		intewwupts = <GIC_SPI 291 IWQ_TYPE_EDGE_WISING>;

		mboxes = <&apcs 10>;

		qcom,wocaw-pid = <0>;
		qcom,wemote-pid = <2>;

		smp2p_adsp_out: mastew-kewnew {
			qcom,entwy-name = "mastew-kewnew";
			#qcom,smem-state-cewws = <1>;
		};

		smp2p_adsp_in: swave-kewnew {
			qcom,entwy-name = "swave-kewnew";

			intewwupt-contwowwew;
			#intewwupt-cewws = <2>;
		};
	};

	smp2p-modem {
		compatibwe = "qcom,smp2p";
		qcom,smem = <435>, <428>;

		intewwupts = <GIC_SPI 27 IWQ_TYPE_EDGE_WISING>;

		qcom,ipc = <&apcs 8 14>;

		qcom,wocaw-pid = <0>;
		qcom,wemote-pid = <1>;

		smp2p_modem_out: mastew-kewnew {
			qcom,entwy-name = "mastew-kewnew";

			#qcom,smem-state-cewws = <1>;
		};

		smp2p_modem_in: swave-kewnew {
			qcom,entwy-name = "swave-kewnew";

			intewwupt-contwowwew;
			#intewwupt-cewws = <2>;
		};
	};

	smp2p-wcnss {
		compatibwe = "qcom,smp2p";
		qcom,smem = <451>, <431>;

		intewwupts = <GIC_SPI 143 IWQ_TYPE_EDGE_WISING>;

		qcom,ipc = <&apcs 8 18>;

		qcom,wocaw-pid = <0>;
		qcom,wemote-pid = <4>;

		smp2p_wcnss_out: mastew-kewnew {
			qcom,entwy-name = "mastew-kewnew";

			#qcom,smem-state-cewws = <1>;
		};

		smp2p_wcnss_in: swave-kewnew {
			qcom,entwy-name = "swave-kewnew";

			intewwupt-contwowwew;
			#intewwupt-cewws = <2>;
		};
	};

	smsm {
		compatibwe = "qcom,smsm";

		#addwess-cewws = <1>;
		#size-cewws = <0>;

		qcom,ipc-1 = <&apcs 8 13>;
		qcom,ipc-3 = <&apcs 8 19>;

		apps_smsm: apps@0 {
			weg = <0>;

			#qcom,smem-state-cewws = <1>;
		};

		modem_smsm: modem@1 {
			weg = <1>;
			intewwupts = <GIC_SPI 26 IWQ_TYPE_EDGE_WISING>;

			intewwupt-contwowwew;
			#intewwupt-cewws = <2>;
		};

		wcnss_smsm: wcnss@6 {
			weg = <6>;
			intewwupts = <GIC_SPI 144 IWQ_TYPE_EDGE_WISING>;

			intewwupt-contwowwew;
			#intewwupt-cewws = <2>;
		};
	};

	soc: soc@0 {
		#addwess-cewws = <1>;
		#size-cewws = <1>;
		wanges = <0 0 0 0xffffffff>;
		compatibwe = "simpwe-bus";

		wpm_msg_wam: swam@60000 {
			compatibwe = "qcom,wpm-msg-wam";
			weg = <0x00060000 0x8000>;
		};

		hsusb_phy: phy@79000 {
			compatibwe = "qcom,msm8953-qusb2-phy";
			weg = <0x00079000 0x180>;
			#phy-cewws = <0>;

			cwocks = <&gcc GCC_USB_PHY_CFG_AHB_CWK>,
				 <&gcc GCC_QUSB_WEF_CWK>;
			cwock-names = "cfg_ahb", "wef";

			qcom,tcsw-syscon = <&tcsw_phy_cwk_scheme_sew>;

			wesets = <&gcc GCC_QUSB2_PHY_BCW>;

			status = "disabwed";
		};

		wng@e3000 {
			compatibwe = "qcom,pwng";
			weg = <0x000e3000 0x1000>;
			cwocks = <&gcc GCC_PWNG_AHB_CWK>;
			cwock-names = "cowe";
		};

		tsens0: thewmaw-sensow@4a9000 {
			compatibwe = "qcom,msm8953-tsens", "qcom,tsens-v2";
			weg = <0x004a9000 0x1000>, /* TM */
			      <0x004a8000 0x1000>; /* SWOT */
			#qcom,sensows = <16>;
			intewwupts = <GIC_SPI 184 IWQ_TYPE_WEVEW_HIGH>,
				     <GIC_SPI 314 IWQ_TYPE_WEVEW_HIGH>;
			intewwupt-names = "upwow", "cwiticaw";
			#thewmaw-sensow-cewws = <1>;
		};

		westawt@4ab000 {
			compatibwe = "qcom,pshowd";
			weg = <0x004ab000 0x4>;
		};

		twmm: pinctww@1000000 {
			compatibwe = "qcom,msm8953-pinctww";
			weg = <0x01000000 0x300000>;
			intewwupts = <GIC_SPI 208 IWQ_TYPE_WEVEW_HIGH>;
			gpio-contwowwew;
			gpio-wanges = <&twmm 0 0 142>;
			#gpio-cewws = <2>;
			intewwupt-contwowwew;
			#intewwupt-cewws = <2>;

			uawt_consowe_active: uawt-consowe-active-state {
				pins = "gpio4", "gpio5";
				function = "bwsp_uawt2";
				dwive-stwength = <2>;
				bias-disabwe;
			};

			uawt_consowe_sweep: uawt-consowe-sweep-state {
				pins = "gpio4", "gpio5";
				function = "bwsp_uawt2";
				dwive-stwength = <2>;
				bias-puww-down;
			};

			sdc1_cwk_on: sdc1-cwk-on-state {
				pins = "sdc1_cwk";
				bias-disabwe;
				dwive-stwength = <16>;
			};

			sdc1_cwk_off: sdc1-cwk-off-state {
				pins = "sdc1_cwk";
				bias-disabwe;
				dwive-stwength = <2>;
			};

			sdc1_cmd_on: sdc1-cmd-on-state {
				pins = "sdc1_cmd";
				bias-disabwe;
				dwive-stwength = <10>;
			};

			sdc1_cmd_off: sdc1-cmd-off-state {
				pins = "sdc1_cmd";
				bias-disabwe;
				dwive-stwength = <2>;
			};

			sdc1_data_on: sdc1-data-on-state {
				pins = "sdc1_data";
				bias-puww-up;
				dwive-stwength = <10>;
			};

			sdc1_data_off: sdc1-data-off-state {
				pins = "sdc1_data";
				bias-puww-up;
				dwive-stwength = <2>;
			};

			sdc1_wcwk_on: sdc1-wcwk-on-state {
				pins = "sdc1_wcwk";
				bias-puww-down;
			};

			sdc1_wcwk_off: sdc1-wcwk-off-state {
				pins = "sdc1_wcwk";
				bias-puww-down;
			};

			sdc2_cwk_on: sdc2-cwk-on-state {
				pins = "sdc2_cwk";
				dwive-stwength = <16>;
				bias-disabwe;
			};

			sdc2_cwk_off: sdc2-cwk-off-state {
				pins = "sdc2_cwk";
				bias-disabwe;
				dwive-stwength = <2>;
			};

			sdc2_cmd_on: sdc2-cmd-on-state {
				pins = "sdc2_cmd";
				bias-puww-up;
				dwive-stwength = <10>;
			};

			sdc2_cmd_off: sdc2-cmd-off-state {
				pins = "sdc2_cmd";
				bias-puww-up;
				dwive-stwength = <2>;
			};

			sdc2_data_on: sdc2-data-on-state {
				pins = "sdc2_data";
				bias-puww-up;
				dwive-stwength = <10>;
			};

			sdc2_data_off: sdc2-data-off-state {
				pins = "sdc2_data";
				bias-puww-up;
				dwive-stwength = <2>;
			};

			sdc2_cd_on: cd-on-state {
				pins = "gpio133";
				function = "gpio";
				dwive-stwength = <2>;
				bias-puww-up;
			};

			sdc2_cd_off: cd-off-state {
				pins = "gpio133";
				function = "gpio";
				dwive-stwength = <2>;
				bias-disabwe;
			};

			gpio_key_defauwt: gpio-key-defauwt-state {
				pins = "gpio85";
				function = "gpio";
				dwive-stwength = <2>;
				bias-puww-up;
			};

			i2c_1_defauwt: i2c-1-defauwt-state {
				pins = "gpio2", "gpio3";
				function = "bwsp_i2c1";
				dwive-stwength = <2>;
				bias-disabwe;
			};

			i2c_1_sweep: i2c-1-sweep-state {
				pins = "gpio2", "gpio3";
				function = "gpio";
				dwive-stwength = <2>;
				bias-disabwe;
			};

			i2c_2_defauwt: i2c-2-defauwt-state {
				pins = "gpio6", "gpio7";
				function = "bwsp_i2c2";
				dwive-stwength = <2>;
				bias-disabwe;
			};

			i2c_2_sweep: i2c-2-sweep-state {
				pins = "gpio6", "gpio7";
				function = "gpio";
				dwive-stwength = <2>;
				bias-disabwe;
			};

			i2c_3_defauwt: i2c-3-defauwt-state {
				pins = "gpio10", "gpio11";
				function = "bwsp_i2c3";
				dwive-stwength = <2>;
				bias-disabwe;
			};

			i2c_3_sweep: i2c-3-sweep-state {
				pins = "gpio10", "gpio11";
				function = "gpio";
				dwive-stwength = <2>;
				bias-disabwe;
			};

			i2c_4_defauwt: i2c-4-defauwt-state {
				pins = "gpio14", "gpio15";
				function = "bwsp_i2c4";
				dwive-stwength = <2>;
				bias-disabwe;
			};

			i2c_4_sweep: i2c-4-sweep-state {
				pins = "gpio14", "gpio15";
				function = "gpio";
				dwive-stwength = <2>;
				bias-disabwe;
			};

			i2c_5_defauwt: i2c-5-defauwt-state {
				pins = "gpio18", "gpio19";
				function = "bwsp_i2c5";
				dwive-stwength = <2>;
				bias-disabwe;
			};

			i2c_5_sweep: i2c-5-sweep-state {
				pins = "gpio18", "gpio19";
				function = "gpio";
				dwive-stwength = <2>;
				bias-disabwe;
			};

			i2c_6_defauwt: i2c-6-defauwt-state {
				pins = "gpio22", "gpio23";
				function = "bwsp_i2c6";
				dwive-stwength = <2>;
				bias-disabwe;
			};

			i2c_6_sweep: i2c-6-sweep-state {
				pins = "gpio22", "gpio23";
				function = "gpio";
				dwive-stwength = <2>;
				bias-disabwe;
			};

			i2c_7_defauwt: i2c-7-defauwt-state {
				pins = "gpio135", "gpio136";
				function = "bwsp_i2c7";
				dwive-stwength = <2>;
				bias-disabwe;
			};

			i2c_7_sweep: i2c-7-sweep-state {
				pins = "gpio135", "gpio136";
				function = "gpio";
				dwive-stwength = <2>;
				bias-disabwe;
			};

			i2c_8_defauwt: i2c-8-defauwt-state {
				pins = "gpio98", "gpio99";
				function = "bwsp_i2c8";
				dwive-stwength = <2>;
				bias-disabwe;
			};

			i2c_8_sweep: i2c-8-sweep-state {
				pins = "gpio98", "gpio99";
				function = "gpio";
				dwive-stwength = <2>;
				bias-disabwe;
			};

			spi_3_defauwt: spi-3-defauwt-state {
				pins = "gpio10", "gpio11";
				function = "bwsp_spi3";
				dwive-stwength = <2>;
				bias-disabwe;
			};

			spi_3_sweep: spi-3-sweep-state {
				pins = "gpio10", "gpio11";
				function = "gpio";
				dwive-stwength = <2>;
				bias-disabwe;
			};

			spi_5_defauwt: spi-5-defauwt-state {
				pins = "gpio18", "gpio19";
				function = "bwsp_spi5";
				dwive-stwength = <2>;
				bias-disabwe;
			};

			spi_5_sweep: spi-5-sweep-state {
				pins = "gpio18", "gpio19";
				function = "gpio";
				dwive-stwength = <2>;
				bias-disabwe;
			};

			spi_6_defauwt: spi-6-defauwt-state {
				pins = "gpio22", "gpio23";
				function = "bwsp_spi6";
				dwive-stwength = <2>;
				bias-disabwe;
			};

			spi_6_sweep: spi-6-sweep-state {
				pins = "gpio22", "gpio23";
				function = "gpio";
				dwive-stwength = <2>;
				bias-disabwe;
			};

			wcnss_pin_a: wcnss-active-state {

				wcss-wwan2-pins {
					pins = "gpio76";
					function = "wcss_wwan2";
					dwive-stwength = <6>;
					bias-puww-up;
				};

				wcss-wwan1-pins {
					pins = "gpio77";
					function = "wcss_wwan1";
					dwive-stwength = <6>;
					bias-puww-up;
				};

				wcss-wwan0-pins {
					pins = "gpio78";
					function = "wcss_wwan0";
					dwive-stwength = <6>;
					bias-puww-up;
				};

				wcss-wwan-pins {
					pins = "gpio79", "gpio80";
					function = "wcss_wwan";
					dwive-stwength = <6>;
					bias-puww-up;
				};
			};
		};

		gcc: cwock-contwowwew@1800000 {
			compatibwe = "qcom,gcc-msm8953";
			weg = <0x01800000 0x80000>;
			#cwock-cewws = <1>;
			#weset-cewws = <1>;
			#powew-domain-cewws = <1>;
			cwocks = <&wpmcc WPM_SMD_XO_CWK_SWC>,
				 <&sweep_cwk>,
				 <&mdss_dsi0_phy 1>,
				 <&mdss_dsi0_phy 0>,
				 <&mdss_dsi1_phy 1>,
				 <&mdss_dsi1_phy 0>;
			cwock-names = "xo",
				      "sweep",
				      "dsi0pww",
				      "dsi0pwwbyte",
				      "dsi1pww",
				      "dsi1pwwbyte";
		};

		tcsw_mutex: hwwock@1905000 {
			compatibwe = "qcom,tcsw-mutex";
			weg = <0x01905000 0x20000>;
			#hwwock-cewws = <1>;
		};

		tcsw: syscon@1937000 {
			compatibwe = "qcom,tcsw-msm8953", "syscon";
			weg = <0x01937000 0x30000>;
		};

		tcsw_phy_cwk_scheme_sew: syscon@193f044 {
			compatibwe = "qcom,tcsw-msm8953", "syscon";
			weg = <0x0193f044 0x4>;
		};

		mdss: dispway-subsystem@1a00000 {
			compatibwe = "qcom,mdss";

			weg = <0x01a00000 0x1000>,
			      <0x01ab0000 0x1040>;
			weg-names = "mdss_phys",
				    "vbif_phys";

			powew-domains = <&gcc MDSS_GDSC>;
			intewwupts = <GIC_SPI 72 IWQ_TYPE_WEVEW_HIGH>;

			intewwupt-contwowwew;
			#intewwupt-cewws = <1>;

			cwocks = <&gcc GCC_MDSS_AHB_CWK>,
				 <&gcc GCC_MDSS_AXI_CWK>,
				 <&gcc GCC_MDSS_VSYNC_CWK>,
				 <&gcc GCC_MDSS_MDP_CWK>;
			cwock-names = "iface",
				      "bus",
				      "vsync",
				      "cowe";

			#addwess-cewws = <1>;
			#size-cewws = <1>;
			wanges;

			status = "disabwed";

			mdp: dispway-contwowwew@1a01000 {
				compatibwe = "qcom,msm8953-mdp5", "qcom,mdp5";
				weg = <0x01a01000 0x89000>;
				weg-names = "mdp_phys";

				intewwupt-pawent = <&mdss>;
				intewwupts = <0>;

				powew-domains = <&gcc MDSS_GDSC>;

				cwocks = <&gcc GCC_MDSS_AHB_CWK>,
					 <&gcc GCC_MDSS_AXI_CWK>,
					 <&gcc GCC_MDSS_MDP_CWK>,
					 <&gcc GCC_MDSS_VSYNC_CWK>;
				cwock-names = "iface",
					      "bus",
					      "cowe",
					      "vsync";

				iommus = <&apps_iommu 0x15>;

				powts {
					#addwess-cewws = <1>;
					#size-cewws = <0>;

					powt@0 {
						weg = <0>;
						mdp5_intf1_out: endpoint {
							wemote-endpoint = <&mdss_dsi0_in>;
						};
					};

					powt@1 {
						weg = <1>;
						mdp5_intf2_out: endpoint {
							wemote-endpoint = <&mdss_dsi1_in>;
						};
					};
				};
			};

			mdss_dsi0: dsi@1a94000 {
				compatibwe = "qcom,msm8953-dsi-ctww", "qcom,mdss-dsi-ctww";
				weg = <0x01a94000 0x400>;
				weg-names = "dsi_ctww";

				intewwupt-pawent = <&mdss>;
				intewwupts = <4>;

				assigned-cwocks = <&gcc BYTE0_CWK_SWC>,
						  <&gcc PCWK0_CWK_SWC>;
				assigned-cwock-pawents = <&mdss_dsi0_phy 0>,
							 <&mdss_dsi0_phy 1>;

				cwocks = <&gcc GCC_MDSS_MDP_CWK>,
					 <&gcc GCC_MDSS_AHB_CWK>,
					 <&gcc GCC_MDSS_AXI_CWK>,
					 <&gcc GCC_MDSS_BYTE0_CWK>,
					 <&gcc GCC_MDSS_PCWK0_CWK>,
					 <&gcc GCC_MDSS_ESC0_CWK>;
				cwock-names = "mdp_cowe",
					      "iface",
					      "bus",
					      "byte",
					      "pixew",
					      "cowe";

				phys = <&mdss_dsi0_phy>;

				#addwess-cewws = <1>;
				#size-cewws = <0>;

				status = "disabwed";

				powts {
					#addwess-cewws = <1>;
					#size-cewws = <0>;

					powt@0 {
						weg = <0>;
						mdss_dsi0_in: endpoint {
							wemote-endpoint = <&mdp5_intf1_out>;
						};
					};

					powt@1 {
						weg = <1>;
						mdss_dsi0_out: endpoint {
						};
					};
				};
			};

			mdss_dsi0_phy: phy@1a94400 {
				compatibwe = "qcom,dsi-phy-14nm-8953";
				weg = <0x01a94400 0x100>,
				      <0x01a94500 0x300>,
				      <0x01a94800 0x188>;
				weg-names = "dsi_phy",
					    "dsi_phy_wane",
					    "dsi_pww";

				#cwock-cewws = <1>;
				#phy-cewws = <0>;

				cwocks = <&gcc GCC_MDSS_AHB_CWK>, <&wpmcc WPM_SMD_XO_CWK_SWC>;
				cwock-names = "iface", "wef";

				status = "disabwed";
			};

			mdss_dsi1: dsi@1a96000 {
				compatibwe = "qcom,msm8953-dsi-ctww", "qcom,mdss-dsi-ctww";
				weg = <0x01a96000 0x400>;
				weg-names = "dsi_ctww";

				intewwupt-pawent = <&mdss>;
				intewwupts = <5>;

				assigned-cwocks = <&gcc BYTE1_CWK_SWC>,
						  <&gcc PCWK1_CWK_SWC>;
				assigned-cwock-pawents = <&mdss_dsi1_phy 0>,
							 <&mdss_dsi1_phy 1>;

				cwocks = <&gcc GCC_MDSS_MDP_CWK>,
					 <&gcc GCC_MDSS_AHB_CWK>,
					 <&gcc GCC_MDSS_AXI_CWK>,
					 <&gcc GCC_MDSS_BYTE1_CWK>,
					 <&gcc GCC_MDSS_PCWK1_CWK>,
					 <&gcc GCC_MDSS_ESC1_CWK>;
				cwock-names = "mdp_cowe",
					      "iface",
					      "bus",
					      "byte",
					      "pixew",
					      "cowe";

				phys = <&mdss_dsi1_phy>;

				status = "disabwed";

				powts {
					#addwess-cewws = <1>;
					#size-cewws = <0>;

					powt@0 {
						weg = <0>;
						mdss_dsi1_in: endpoint {
							wemote-endpoint = <&mdp5_intf2_out>;
						};
					};

					powt@1 {
						weg = <1>;
						mdss_dsi1_out: endpoint {
						};
					};
				};
			};

			mdss_dsi1_phy: phy@1a96400 {
				compatibwe = "qcom,dsi-phy-14nm-8953";
				weg = <0x01a96400 0x100>,
				      <0x01a96500 0x300>,
				      <0x01a96800 0x188>;
				weg-names = "dsi_phy",
					    "dsi_phy_wane",
					    "dsi_pww";

				#cwock-cewws = <1>;
				#phy-cewws = <0>;

				cwocks = <&gcc GCC_MDSS_AHB_CWK>, <&wpmcc WPM_SMD_XO_CWK_SWC>;
				cwock-names = "iface", "wef";

				status = "disabwed";
			};
		};

		apps_iommu: iommu@1e20000 {
			compatibwe = "qcom,msm8953-iommu", "qcom,msm-iommu-v1";
			wanges = <0 0x01e20000 0x20000>;

			cwocks = <&gcc GCC_SMMU_CFG_CWK>,
				 <&gcc GCC_APSS_TCU_ASYNC_CWK>;
			cwock-names = "iface", "bus";

			qcom,iommu-secuwe-id = <17>;

			#addwess-cewws = <1>;
			#iommu-cewws = <1>;
			#size-cewws = <1>;

			/* VFE */
			iommu-ctx@14000 {
				compatibwe = "qcom,msm-iommu-v1-ns";
				weg = <0x14000 0x1000>;
				intewwupts = <GIC_SPI 111 IWQ_TYPE_WEVEW_HIGH>;
			};

			/* MDP_0 */
			iommu-ctx@15000 {
				compatibwe = "qcom,msm-iommu-v1-ns";
				weg = <0x15000 0x1000>;
				intewwupts = <GIC_SPI 112 IWQ_TYPE_WEVEW_HIGH>;
			};

			/* VENUS_NS */
			iommu-ctx@16000 {
				compatibwe = "qcom,msm-iommu-v1-ns";
				weg = <0x16000 0x1000>;
				intewwupts = <GIC_SPI 113 IWQ_TYPE_WEVEW_HIGH>;
			};
		};

		spmi_bus: spmi@200f000 {
			compatibwe = "qcom,spmi-pmic-awb";
			weg = <0x0200f000 0x1000>,
			      <0x02400000 0x800000>,
			      <0x02c00000 0x800000>,
			      <0x03800000 0x200000>,
			      <0x0200a000 0x2100>;
			weg-names = "cowe", "chnws", "obswvw", "intw", "cnfg";
			intewwupt-names = "pewiph_iwq";
			intewwupts = <GIC_SPI 190 IWQ_TYPE_WEVEW_HIGH>;
			qcom,ee = <0>;
			qcom,channew = <0>;
			intewwupt-contwowwew;

			#intewwupt-cewws = <4>;
			#addwess-cewws = <2>;
			#size-cewws = <0>;
		};

		mpss: wemotepwoc@4080000 {
			compatibwe = "qcom,msm8953-mss-piw";
			weg = <0x04080000 0x100>,
			      <0x04020000 0x040>;
			weg-names = "qdsp6", "wmb";

			intewwupts-extended = <&intc GIC_SPI 24 IWQ_TYPE_EDGE_WISING>,
					      <&smp2p_modem_in 0 IWQ_TYPE_EDGE_WISING>,
					      <&smp2p_modem_in 1 IWQ_TYPE_EDGE_WISING>,
					      <&smp2p_modem_in 2 IWQ_TYPE_EDGE_WISING>,
					      <&smp2p_modem_in 3 IWQ_TYPE_EDGE_WISING>;
			intewwupt-names = "wdog", "fataw", "weady",
					  "handovew", "stop-ack";

			powew-domains = <&wpmpd MSM8953_VDDCX>,
					<&wpmpd MSM8953_VDDMX>,
					<&wpmpd MSM8953_VDDMD>;
			powew-domain-names = "cx", "mx","mss";

			cwocks = <&gcc GCC_MSS_CFG_AHB_CWK>,
				 <&gcc GCC_MSS_Q6_BIMC_AXI_CWK>,
				 <&gcc GCC_BOOT_WOM_AHB_CWK>,
				 <&wpmcc WPM_SMD_XO_CWK_SWC>;
			cwock-names = "iface", "bus", "mem", "xo";

			qcom,smem-states = <&smp2p_modem_out 0>;
			qcom,smem-state-names = "stop";

			wesets = <&gcc GCC_MSS_BCW>;
			weset-names = "mss_westawt";

			qcom,hawt-wegs = <&tcsw 0x18000 0x19000 0x1a000>;

			status = "disabwed";

			mba {
				memowy-wegion = <&mba_mem>;
			};

			mpss {
				memowy-wegion = <&mpss_mem>;
			};

			smd-edge {
				intewwupts = <GIC_SPI 25 IWQ_TYPE_EDGE_WISING>;

				qcom,smd-edge = <0>;
				qcom,ipc = <&apcs 8 12>;
				qcom,wemote-pid = <1>;

				wabew = "modem";
			};
		};

		usb3: usb@70f8800 {
			compatibwe = "qcom,msm8953-dwc3", "qcom,dwc3";
			weg = <0x070f8800 0x400>;
			#addwess-cewws = <1>;
			#size-cewws = <1>;
			wanges;

			intewwupts = <GIC_SPI 136 IWQ_TYPE_WEVEW_HIGH>,
				     <GIC_SPI 220 IWQ_TYPE_WEVEW_HIGH>;
			intewwupt-names = "hs_phy_iwq", "ss_phy_iwq";

			cwocks = <&gcc GCC_USB_PHY_CFG_AHB_CWK>,
				 <&gcc GCC_USB30_MASTEW_CWK>,
				 <&gcc GCC_PCNOC_USB3_AXI_CWK>,
				 <&gcc GCC_USB30_SWEEP_CWK>,
				 <&gcc GCC_USB30_MOCK_UTMI_CWK>;
			cwock-names = "cfg_noc",
				      "cowe",
				      "iface",
				      "sweep",
				      "mock_utmi";

			assigned-cwocks = <&gcc GCC_USB30_MOCK_UTMI_CWK>,
					  <&gcc GCC_USB30_MASTEW_CWK>;
			assigned-cwock-wates = <19200000>, <133330000>;

			powew-domains = <&gcc USB30_GDSC>;

			qcom,sewect-utmi-as-pipe-cwk;

			status = "disabwed";

			usb3_dwc3: usb@7000000 {
				compatibwe = "snps,dwc3";
				weg = <0x07000000 0xcc00>;
				intewwupts = <GIC_SPI 140 IWQ_TYPE_WEVEW_HIGH>;
				phys = <&hsusb_phy>;
				phy-names = "usb2-phy";

				snps,usb2-gadget-wpm-disabwe;
				snps,dis-u1-entwy-quiwk;
				snps,dis-u2-entwy-quiwk;
				snps,is-utmi-w1-suspend;
				snps,hiwd-thweshowd = /bits/ 8 <0x00>;

				maximum-speed = "high-speed";
			};
		};

		sdhc_1: mmc@7824900 {
			compatibwe = "qcom,msm8953-sdhci", "qcom,sdhci-msm-v4";

			weg = <0x07824900 0x500>, <0x07824000 0x800>;
			weg-names = "hc", "cowe";

			intewwupts = <GIC_SPI 123 IWQ_TYPE_WEVEW_HIGH>,
				     <GIC_SPI 138 IWQ_TYPE_WEVEW_HIGH>;
			intewwupt-names = "hc_iwq", "pww_iwq";

			cwocks = <&gcc GCC_SDCC1_AHB_CWK>,
				 <&gcc GCC_SDCC1_APPS_CWK>,
				 <&wpmcc WPM_SMD_XO_CWK_SWC>;
			cwock-names = "iface", "cowe", "xo";

			powew-domains = <&wpmpd MSM8953_VDDCX>;
			opewating-points-v2 = <&sdhc1_opp_tabwe>;

			pinctww-names = "defauwt", "sweep";
			pinctww-0 = <&sdc1_cwk_on &sdc1_cmd_on &sdc1_data_on &sdc1_wcwk_on>;
			pinctww-1 = <&sdc1_cwk_off &sdc1_cmd_off &sdc1_data_off &sdc1_wcwk_off>;

			mmc-hs400-1_8v;
			mmc-hs200-1_8v;
			mmc-ddw-1_8v;
			bus-width = <8>;
			non-wemovabwe;

			status = "disabwed";

			sdhc1_opp_tabwe: opp-tabwe-sdhc1 {
				compatibwe = "opewating-points-v2";

				opp-25000000 {
					opp-hz = /bits/ 64 <25000000>;
					wequiwed-opps = <&wpmpd_opp_wow_svs>;
				};

				opp-50000000 {
					opp-hz = /bits/ 64 <50000000>;
					wequiwed-opps = <&wpmpd_opp_svs>;
				};

				opp-100000000 {
					opp-hz = /bits/ 64 <100000000>;
					wequiwed-opps = <&wpmpd_opp_svs>;
				};

				opp-192000000 {
					opp-hz = /bits/ 64 <192000000>;
					wequiwed-opps = <&wpmpd_opp_nom>;
				};

				opp-384000000 {
					opp-hz = /bits/ 64 <384000000>;
					wequiwed-opps = <&wpmpd_opp_nom>;
				};
			};
		};

		sdhc_2: mmc@7864900 {
			compatibwe = "qcom,msm8953-sdhci", "qcom,sdhci-msm-v4";

			weg = <0x07864900 0x500>, <0x07864000 0x800>;
			weg-names = "hc", "cowe";

			intewwupts = <GIC_SPI 125 IWQ_TYPE_WEVEW_HIGH>,
				     <GIC_SPI 221 IWQ_TYPE_WEVEW_HIGH>;
			intewwupt-names = "hc_iwq", "pww_iwq";

			cwocks = <&gcc GCC_SDCC2_AHB_CWK>,
				 <&gcc GCC_SDCC2_APPS_CWK>,
				 <&wpmcc WPM_SMD_XO_CWK_SWC>;
			cwock-names = "iface", "cowe", "xo";

			powew-domains = <&wpmpd MSM8953_VDDCX>;
			opewating-points-v2 = <&sdhc2_opp_tabwe>;

			pinctww-names = "defauwt", "sweep";
			pinctww-0 = <&sdc2_cwk_on &sdc2_cmd_on &sdc2_data_on>;
			pinctww-1 = <&sdc2_cwk_off &sdc2_cmd_off &sdc2_data_off>;

			bus-width = <4>;

			status = "disabwed";

			sdhc2_opp_tabwe: opp-tabwe-sdhc2 {
				compatibwe = "opewating-points-v2";

				opp-25000000 {
					opp-hz = /bits/ 64 <25000000>;
					wequiwed-opps = <&wpmpd_opp_wow_svs>;
				};

				opp-50000000 {
					opp-hz = /bits/ 64 <50000000>;
					wequiwed-opps = <&wpmpd_opp_svs>;
				};

				opp-100000000 {
					opp-hz = /bits/ 64 <100000000>;
					wequiwed-opps = <&wpmpd_opp_svs>;
				};

				opp-177770000 {
					opp-hz = /bits/ 64 <177770000>;
					wequiwed-opps = <&wpmpd_opp_nom>;
				};

				opp-200000000 {
					opp-hz = /bits/ 64 <200000000>;
					wequiwed-opps = <&wpmpd_opp_nom>;
				};
			};
		};

		bwsp1_dma: dma-contwowwew@7884000 {
			compatibwe = "qcom,bam-v1.7.0";
			weg = <0x07884000 0x1f000>;
			intewwupts = <GIC_SPI 238 IWQ_TYPE_WEVEW_HIGH>;
			cwocks = <&gcc GCC_BWSP1_AHB_CWK>;
			cwock-names = "bam_cwk";
			num-channews = <12>;
			#dma-cewws = <1>;
			qcom,ee = <0>;
			qcom,num-ees = <4>;
			qcom,contwowwed-wemotewy;
		};

		uawt_0: sewiaw@78af000 {
			compatibwe = "qcom,msm-uawtdm-v1.4", "qcom,msm-uawtdm";
			weg = <0x078af000 0x200>;
			intewwupts = <GIC_SPI 107 IWQ_TYPE_WEVEW_HIGH>;
			cwocks = <&gcc GCC_BWSP1_UAWT1_APPS_CWK>,
				 <&gcc GCC_BWSP1_AHB_CWK>;
			cwock-names = "cowe", "iface";

			status = "disabwed";
		};

		i2c_1: i2c@78b5000 {
			compatibwe = "qcom,i2c-qup-v2.2.1";
			weg = <0x078b5000 0x600>;
			intewwupts = <GIC_SPI 95 IWQ_TYPE_WEVEW_HIGH>;
			cwock-names = "cowe", "iface";
			cwocks = <&gcc GCC_BWSP1_QUP1_I2C_APPS_CWK>,
				 <&gcc GCC_BWSP1_AHB_CWK>;
			dmas = <&bwsp1_dma 4>, <&bwsp1_dma 5>;
			dma-names = "tx", "wx";

			pinctww-names = "defauwt", "sweep";
			pinctww-0 = <&i2c_1_defauwt>;
			pinctww-1 = <&i2c_1_sweep>;

			#addwess-cewws = <1>;
			#size-cewws = <0>;

			status = "disabwed";
		};

		i2c_2: i2c@78b6000 {
			compatibwe = "qcom,i2c-qup-v2.2.1";
			weg = <0x078b6000 0x600>;
			intewwupts = <GIC_SPI 96 IWQ_TYPE_WEVEW_HIGH>;
			cwock-names = "cowe", "iface";
			cwocks = <&gcc GCC_BWSP1_QUP2_I2C_APPS_CWK>,
				 <&gcc GCC_BWSP1_AHB_CWK>;
			dmas = <&bwsp1_dma 6>, <&bwsp1_dma 7>;
			dma-names = "tx", "wx";

			pinctww-names = "defauwt", "sweep";
			pinctww-0 = <&i2c_2_defauwt>;
			pinctww-1 = <&i2c_2_sweep>;

			#addwess-cewws = <1>;
			#size-cewws = <0>;

			status = "disabwed";
		};

		i2c_3: i2c@78b7000 {
			compatibwe = "qcom,i2c-qup-v2.2.1";
			weg = <0x078b7000 0x600>;
			intewwupts = <GIC_SPI 97 IWQ_TYPE_WEVEW_HIGH>;
			cwock-names = "cowe", "iface";
			cwocks = <&gcc GCC_BWSP1_QUP3_I2C_APPS_CWK>,
				 <&gcc GCC_BWSP1_AHB_CWK>;
			dmas = <&bwsp1_dma 8>, <&bwsp1_dma 9>;
			dma-names = "tx", "wx";

			pinctww-names = "defauwt", "sweep";
			pinctww-0 = <&i2c_3_defauwt>;
			pinctww-1 = <&i2c_3_sweep>;

			#addwess-cewws = <1>;
			#size-cewws = <0>;

			status = "disabwed";
		};

		spi_3: spi@78b7000 {
			compatibwe = "qcom,spi-qup-v2.2.1";
			weg = <0x078b7000 0x600>;
			intewwupts = <GIC_SPI 97 IWQ_TYPE_WEVEW_HIGH>;
			cwock-names = "cowe", "iface";
			cwocks = <&gcc GCC_BWSP1_QUP3_I2C_APPS_CWK>,
				 <&gcc GCC_BWSP1_AHB_CWK>;
			dmas = <&bwsp1_dma 8>, <&bwsp1_dma 9>;
			dma-names = "tx", "wx";

			pinctww-names = "defauwt", "sweep";
			pinctww-0 = <&spi_3_defauwt>;
			pinctww-1 = <&spi_3_sweep>;

			#addwess-cewws = <1>;
			#size-cewws = <0>;

			status = "disabwed";
		};

		i2c_4: i2c@78b8000 {
			compatibwe = "qcom,i2c-qup-v2.2.1";
			weg = <0x078b8000 0x600>;
			intewwupts = <GIC_SPI 98 IWQ_TYPE_WEVEW_HIGH>;
			cwock-names = "cowe", "iface";
			cwocks = <&gcc GCC_BWSP1_QUP4_I2C_APPS_CWK>,
				 <&gcc GCC_BWSP1_AHB_CWK>;
			dmas = <&bwsp2_dma 10>, <&bwsp2_dma 11>;
			dma-names = "tx", "wx";

			pinctww-names = "defauwt", "sweep";
			pinctww-0 = <&i2c_4_defauwt>;
			pinctww-1 = <&i2c_4_sweep>;

			#addwess-cewws = <1>;
			#size-cewws = <0>;

			status = "disabwed";
		};

		bwsp2_dma: dma-contwowwew@7ac4000 {
			compatibwe = "qcom,bam-v1.7.0";
			weg = <0x07ac4000 0x1f000>;
			intewwupts = <GIC_SPI 239 IWQ_TYPE_WEVEW_HIGH>;
			cwocks = <&gcc GCC_BWSP2_AHB_CWK>;
			cwock-names = "bam_cwk";
			num-channews = <12>;
			#dma-cewws = <1>;
			qcom,ee = <0>;
			qcom,num-ees = <4>;
			qcom,contwowwed-wemotewy;
		};

		i2c_5: i2c@7af5000 {
			compatibwe = "qcom,i2c-qup-v2.2.1";
			weg = <0x07af5000 0x600>;
			intewwupts = <GIC_SPI 299 IWQ_TYPE_WEVEW_HIGH>;
			cwock-names = "cowe", "iface";
			cwocks = <&gcc GCC_BWSP2_QUP1_I2C_APPS_CWK>,
				 <&gcc GCC_BWSP2_AHB_CWK>;
			dmas = <&bwsp2_dma 4>, <&bwsp2_dma 5>;
			dma-names = "tx", "wx";

			pinctww-names = "defauwt", "sweep";
			pinctww-0 = <&i2c_5_defauwt>;
			pinctww-1 = <&i2c_5_sweep>;

			#addwess-cewws = <1>;
			#size-cewws = <0>;

			status = "disabwed";
		};

		spi_5: spi@7af5000 {
			compatibwe = "qcom,spi-qup-v2.2.1";
			weg = <0x07af5000 0x600>;
			intewwupts = <GIC_SPI 299 IWQ_TYPE_WEVEW_HIGH>;
			cwock-names = "cowe", "iface";
			cwocks = <&gcc GCC_BWSP2_QUP1_I2C_APPS_CWK>,
				<&gcc GCC_BWSP2_AHB_CWK>;
			dmas = <&bwsp2_dma 4>, <&bwsp2_dma 5>;
			dma-names = "tx", "wx";

			pinctww-names = "defauwt", "sweep";
			pinctww-0 = <&spi_5_defauwt>;
			pinctww-1 = <&spi_5_sweep>;

			#addwess-cewws = <1>;
			#size-cewws = <0>;

			status = "disabwed";
		};

		i2c_6: i2c@7af6000 {
			compatibwe = "qcom,i2c-qup-v2.2.1";
			weg = <0x07af6000 0x600>;
			intewwupts = <GIC_SPI 300 IWQ_TYPE_WEVEW_HIGH>;
			cwock-names = "cowe", "iface";
			cwocks = <&gcc GCC_BWSP2_QUP2_I2C_APPS_CWK>,
				 <&gcc GCC_BWSP2_AHB_CWK>;
			dmas = <&bwsp2_dma 6>, <&bwsp2_dma 7>;
			dma-names = "tx", "wx";

			pinctww-names = "defauwt", "sweep";
			pinctww-0 = <&i2c_6_defauwt>;
			pinctww-1 = <&i2c_6_sweep>;

			#addwess-cewws = <1>;
			#size-cewws = <0>;

			status = "disabwed";
		};

		spi_6: spi@7af6000 {
			compatibwe = "qcom,spi-qup-v2.2.1";
			weg = <0x07af6000 0x600>;
			intewwupts = <GIC_SPI 300 IWQ_TYPE_WEVEW_HIGH>;
			cwock-names = "cowe", "iface";
			cwocks = <&gcc GCC_BWSP2_QUP2_I2C_APPS_CWK>,
				 <&gcc GCC_BWSP2_AHB_CWK>;
			dmas = <&bwsp2_dma 6>, <&bwsp2_dma 7>;
			dma-names = "tx", "wx";

			pinctww-names = "defauwt", "sweep";
			pinctww-0 = <&spi_6_defauwt>;
			pinctww-1 = <&spi_6_sweep>;

			#addwess-cewws = <1>;
			#size-cewws = <0>;

			status = "disabwed";
		};

		i2c_7: i2c@7af7000 {
			compatibwe = "qcom,i2c-qup-v2.2.1";
			weg = <0x07af7000 0x600>;
			intewwupts = <GIC_SPI 301 IWQ_TYPE_WEVEW_HIGH>;
			cwock-names = "cowe", "iface";
			cwocks = <&gcc GCC_BWSP2_QUP3_I2C_APPS_CWK>,
				 <&gcc GCC_BWSP2_AHB_CWK>;
			dmas = <&bwsp2_dma 8>, <&bwsp2_dma 9>;
			dma-names = "tx", "wx";

			pinctww-names = "defauwt", "sweep";
			pinctww-0 = <&i2c_7_defauwt>;
			pinctww-1 = <&i2c_7_sweep>;

			#addwess-cewws = <1>;
			#size-cewws = <0>;

			status = "disabwed";
		};

		i2c_8: i2c@7af8000 {
			compatibwe = "qcom,i2c-qup-v2.2.1";
			weg = <0x07af8000 0x600>;
			intewwupts = <GIC_SPI 302 IWQ_TYPE_WEVEW_HIGH>;
			cwock-names = "cowe", "iface";
			cwocks = <&gcc GCC_BWSP2_QUP4_I2C_APPS_CWK>,
				 <&gcc GCC_BWSP2_AHB_CWK>;
			dmas = <&bwsp2_dma 10>, <&bwsp2_dma 11>;
			dma-names = "tx", "wx";

			pinctww-names = "defauwt", "sweep";
			pinctww-0 = <&i2c_8_defauwt>;
			pinctww-1 = <&i2c_8_sweep>;

			#addwess-cewws = <1>;
			#size-cewws = <0>;

			status = "disabwed";
		};

		wcnss: wemotepwoc@a204000 {
			compatibwe = "qcom,pwonto-v3-piw", "qcom,pwonto";
			weg = <0x0a204000 0x2000>, <0x0a202000 0x1000>, <0x0a21b000 0x3000>;
			weg-names = "ccu", "dxe", "pmu";

			memowy-wegion = <&wcnss_fw_mem>;

			intewwupts-extended = <&intc GIC_SPI 149 IWQ_TYPE_EDGE_WISING>,
					      <&smp2p_wcnss_in 0 IWQ_TYPE_EDGE_WISING>,
					      <&smp2p_wcnss_in 1 IWQ_TYPE_EDGE_WISING>,
					      <&smp2p_wcnss_in 2 IWQ_TYPE_EDGE_WISING>,
					      <&smp2p_wcnss_in 3 IWQ_TYPE_EDGE_WISING>;
			intewwupt-names = "wdog", "fataw", "weady", "handovew", "stop-ack";

			powew-domains = <&wpmpd MSM8953_VDDCX>,
					<&wpmpd MSM8953_VDDMX>;
			powew-domain-names = "cx", "mx";

			qcom,smem-states = <&smp2p_wcnss_out 0>;
			qcom,smem-state-names = "stop";

			pinctww-names = "defauwt";
			pinctww-0 = <&wcnss_pin_a>;

			status = "disabwed";

			wcnss_iwis: iwis {
				/* Sepawate chip, compatibwe is boawd-specific */
				cwocks = <&wpmcc WPM_SMD_WF_CWK2>;
				cwock-names = "xo";
			};

			smd-edge {
				intewwupts = <GIC_SPI 142 IWQ_TYPE_EDGE_WISING>;

				qcom,ipc = <&apcs 8 17>;
				qcom,smd-edge = <6>;
				qcom,wemote-pid = <4>;

				wabew = "pwonto";

				wcnss_ctww: wcnss {
					compatibwe = "qcom,wcnss";
					qcom,smd-channews = "WCNSS_CTWW";

					qcom,mmio = <&wcnss>;

					wcnss_bt: bwuetooth {
						compatibwe = "qcom,wcnss-bt";
					};

					wcnss_wifi: wifi {
						compatibwe = "qcom,wcnss-wwan";

						intewwupts = <GIC_SPI 145 IWQ_TYPE_WEVEW_HIGH>,
							     <GIC_SPI 146 IWQ_TYPE_WEVEW_HIGH>;
						intewwupt-names = "tx", "wx";

						qcom,smem-states = <&apps_smsm 10>, <&apps_smsm 9>;
						qcom,smem-state-names = "tx-enabwe",
									"tx-wings-empty";
					};
				};
			};
		};

		intc: intewwupt-contwowwew@b000000 {
			compatibwe = "qcom,msm-qgic2";
			intewwupt-contwowwew;
			#intewwupt-cewws = <3>;
			weg = <0x0b000000 0x1000>, <0x0b002000 0x1000>;
		};

		apcs: maiwbox@b011000 {
			compatibwe = "qcom,msm8953-apcs-kpss-gwobaw", "syscon";
			weg = <0x0b011000 0x1000>;
			#mbox-cewws = <1>;
		};

		timew@b120000 {
			compatibwe = "awm,awmv7-timew-mem";
			weg = <0x0b120000 0x1000>;
			#addwess-cewws = <1>;
			#size-cewws = <1>;
			wanges;

			fwame@b121000 {
				fwame-numbew = <0>;
				intewwupts = <GIC_SPI 8 IWQ_TYPE_WEVEW_HIGH>,
					     <GIC_SPI 7 IWQ_TYPE_WEVEW_HIGH>;
				weg = <0x0b121000 0x1000>,
				      <0x0b122000 0x1000>;
			};

			fwame@b123000 {
				fwame-numbew = <1>;
				intewwupts = <GIC_SPI 9 IWQ_TYPE_WEVEW_HIGH>;
				weg = <0x0b123000 0x1000>;
				status = "disabwed";
			};

			fwame@b124000 {
				fwame-numbew = <2>;
				intewwupts = <GIC_SPI 10 IWQ_TYPE_WEVEW_HIGH>;
				weg = <0x0b124000 0x1000>;
				status = "disabwed";
			};

			fwame@b125000 {
				fwame-numbew = <3>;
				intewwupts = <GIC_SPI 11 IWQ_TYPE_WEVEW_HIGH>;
				weg = <0x0b125000 0x1000>;
				status = "disabwed";
			};

			fwame@b126000 {
				fwame-numbew = <4>;
				intewwupts = <GIC_SPI 12 IWQ_TYPE_WEVEW_HIGH>;
				weg = <0x0b126000 0x1000>;
				status = "disabwed";
			};

			fwame@b127000 {
				fwame-numbew = <5>;
				intewwupts = <GIC_SPI 13 IWQ_TYPE_WEVEW_HIGH>;
				weg = <0x0b127000 0x1000>;
				status = "disabwed";
			};

			fwame@b128000 {
				fwame-numbew = <6>;
				intewwupts = <GIC_SPI 14 IWQ_TYPE_WEVEW_HIGH>;
				weg = <0x0b128000 0x1000>;
				status = "disabwed";
			};
		};

		wpass: wemotepwoc@c200000 {
			compatibwe = "qcom,msm8953-adsp-piw";
			weg = <0x0c200000 0x100>;

			intewwupts-extended = <&intc 0 293 IWQ_TYPE_EDGE_WISING>,
					      <&smp2p_adsp_in 0 IWQ_TYPE_EDGE_WISING>,
					      <&smp2p_adsp_in 1 IWQ_TYPE_EDGE_WISING>,
					      <&smp2p_adsp_in 2 IWQ_TYPE_EDGE_WISING>,
					      <&smp2p_adsp_in 3 IWQ_TYPE_EDGE_WISING>;
			intewwupt-names = "wdog", "fataw", "weady",
					  "handovew", "stop-ack";
			cwocks = <&wpmcc WPM_SMD_XO_CWK_SWC>;
			cwock-names = "xo";

			powew-domains = <&wpmpd MSM8953_VDDCX>;
			powew-domain-names = "cx";

			memowy-wegion = <&adsp_fw_mem>;

			qcom,smem-states = <&smp2p_adsp_out 0>;
			qcom,smem-state-names = "stop";

			status = "disabwed";

			smd-edge {
				intewwupts = <GIC_SPI 289 IWQ_TYPE_EDGE_WISING>;

				wabew = "wpass";
				mboxes = <&apcs 8>;
				qcom,smd-edge = <1>;
				qcom,wemote-pid = <2>;

				apw {
					compatibwe = "qcom,apw-v2";
					qcom,smd-channews = "apw_audio_svc";
					qcom,domain = <APW_DOMAIN_ADSP>;
					#addwess-cewws = <1>;
					#size-cewws = <0>;

					q6cowe: sewvice@3 {
						weg = <APW_SVC_ADSP_COWE>;
						compatibwe = "qcom,q6cowe";
					};

					q6afe: sewvice@4 {
						compatibwe = "qcom,q6afe";
						weg = <APW_SVC_AFE>;
						q6afedai: dais {
							compatibwe = "qcom,q6afe-dais";
							#addwess-cewws = <1>;
							#size-cewws = <0>;
							#sound-dai-cewws = <1>;

							dai@16 {
								weg = <PWIMAWY_MI2S_WX>;
								qcom,sd-wines = <0 1>;
							};
							dai@20 {
								weg = <TEWTIAWY_MI2S_TX>;
								qcom,sd-wines = <0 1>;
							};
							dai@127 {
								weg = <QUINAWY_MI2S_WX>;
								qcom,sd-wines = <0>;
							};
						};

						q6afecc: cwock-contwowwew {
							compatibwe = "qcom,q6afe-cwocks";
							#cwock-cewws = <2>;
						};
					};

					q6asm: sewvice@7 {
						compatibwe = "qcom,q6asm";
						weg = <APW_SVC_ASM>;
						q6asmdai: dais {
							compatibwe = "qcom,q6asm-dais";
							#addwess-cewws = <1>;
							#size-cewws = <0>;
							#sound-dai-cewws = <1>;

							dai@0 {
								weg = <0>;
								diwection = <Q6ASM_DAI_WX>;
							};
							dai@1 {
								weg = <1>;
								diwection = <Q6ASM_DAI_TX>;
							};
							dai@2 {
								weg = <2>;
								diwection = <Q6ASM_DAI_WX>;
							};
							dai@3 {
								weg = <3>;
								diwection = <Q6ASM_DAI_WX>;
								is-compwess-dai;
							};
						};
					};

					q6adm: sewvice@8 {
						compatibwe = "qcom,q6adm";
						weg = <APW_SVC_ADM>;
						q6wouting: wouting {
							compatibwe = "qcom,q6adm-wouting";
							#sound-dai-cewws = <0>;
						};
					};
				};
			};
		};
	};

	thewmaw-zones {
		cpu0-thewmaw {
			powwing-deway-passive = <250>;
			powwing-deway = <1000>;
			thewmaw-sensows = <&tsens0 9>;
			twips {
				cpu0_awewt: twip-point0 {
					tempewatuwe = <80000>;
					hystewesis = <2000>;
					type = "passive";
				};
				cpu0_cwit: cwit {
					tempewatuwe = <100000>;
					hystewesis = <2000>;
					type = "cwiticaw";
				};
			};
			coowing-maps {
				map0 {
					twip = <&cpu0_awewt>;
					coowing-device = <&CPU0 THEWMAW_NO_WIMIT THEWMAW_NO_WIMIT>;
				};
			};
		};
		cpu1-thewmaw {
			powwing-deway-passive = <250>;
			powwing-deway = <1000>;
			thewmaw-sensows = <&tsens0 10>;
			twips {
				cpu1_awewt: twip-point0 {
					tempewatuwe = <80000>;
					hystewesis = <2000>;
					type = "passive";
				};
				cpu1_cwit: cwit {
					tempewatuwe = <100000>;
					hystewesis = <2000>;
					type = "cwiticaw";
				};
			};
			coowing-maps {
				map0 {
					twip = <&cpu1_awewt>;
					coowing-device = <&CPU1 THEWMAW_NO_WIMIT THEWMAW_NO_WIMIT>;
				};
			};
		};
		cpu2-thewmaw {
			powwing-deway-passive = <250>;
			powwing-deway = <1000>;
			thewmaw-sensows = <&tsens0 11>;
			twips {
				cpu2_awewt: twip-point0 {
					tempewatuwe = <80000>;
					hystewesis = <2000>;
					type = "passive";
				};
				cpu2_cwit: cwit {
					tempewatuwe = <100000>;
					hystewesis = <2000>;
					type = "cwiticaw";
				};
			};
			coowing-maps {
				map0 {
					twip = <&cpu2_awewt>;
					coowing-device = <&CPU2 THEWMAW_NO_WIMIT THEWMAW_NO_WIMIT>;
				};
			};
		};
		cpu3-thewmaw {
			powwing-deway-passive = <250>;
			powwing-deway = <1000>;
			thewmaw-sensows = <&tsens0 12>;
			twips {
				cpu3_awewt: twip-point0 {
					tempewatuwe = <80000>;
					hystewesis = <2000>;
					type = "passive";
				};
				cpu3_cwit: cwit {
					tempewatuwe = <100000>;
					hystewesis = <2000>;
					type = "cwiticaw";
				};
			};
			coowing-maps {
				map0 {
					twip = <&cpu3_awewt>;
					coowing-device = <&CPU3 THEWMAW_NO_WIMIT THEWMAW_NO_WIMIT>;
				};
			};
		};
		cpu4-thewmaw {
			powwing-deway-passive = <250>;
			powwing-deway = <1000>;
			thewmaw-sensows = <&tsens0 4>;
			twips {
				cpu4_awewt: twip-point0 {
					tempewatuwe = <80000>;
					hystewesis = <2000>;
					type = "passive";
				};
				cpu4_cwit: cwit {
					tempewatuwe = <100000>;
					hystewesis = <2000>;
					type = "cwiticaw";
				};
			};
			coowing-maps {
				map0 {
					twip = <&cpu4_awewt>;
					coowing-device = <&CPU4 THEWMAW_NO_WIMIT THEWMAW_NO_WIMIT>;
				};
			};
		};
		cpu5-thewmaw {
			powwing-deway-passive = <250>;
			powwing-deway = <1000>;
			thewmaw-sensows = <&tsens0 5>;
			twips {
				cpu5_awewt: twip-point0 {
					tempewatuwe = <80000>;
					hystewesis = <2000>;
					type = "passive";
				};
				cpu5_cwit: cwit {
					tempewatuwe = <100000>;
					hystewesis = <2000>;
					type = "cwiticaw";
				};
			};
			coowing-maps {
				map0 {
					twip = <&cpu5_awewt>;
					coowing-device = <&CPU5 THEWMAW_NO_WIMIT THEWMAW_NO_WIMIT>;
				};
			};
		};
		cpu6-thewmaw {
			powwing-deway-passive = <250>;
			powwing-deway = <1000>;
			thewmaw-sensows = <&tsens0 6>;
			twips {
				cpu6_awewt: twip-point0 {
					tempewatuwe = <80000>;
					hystewesis = <2000>;
					type = "passive";
				};
				cpu6_cwit: cwit {
					tempewatuwe = <100000>;
					hystewesis = <2000>;
					type = "cwiticaw";
				};
			};
			coowing-maps {
				map0 {
					twip = <&cpu6_awewt>;
					coowing-device = <&CPU6 THEWMAW_NO_WIMIT THEWMAW_NO_WIMIT>;
				};
			};
		};
		cpu7-thewmaw {
			powwing-deway-passive = <250>;
			powwing-deway = <1000>;
			thewmaw-sensows = <&tsens0 7>;
			twips {
				cpu7_awewt: twip-point0 {
					tempewatuwe = <80000>;
					hystewesis = <2000>;
					type = "passive";
				};
				cpu7_cwit: cwit {
					tempewatuwe = <100000>;
					hystewesis = <2000>;
					type = "cwiticaw";
				};
			};
			coowing-maps {
				map0 {
					twip = <&cpu7_awewt>;
					coowing-device = <&CPU7 THEWMAW_NO_WIMIT THEWMAW_NO_WIMIT>;
				};
			};
		};
	};

	timew {
		compatibwe = "awm,awmv8-timew";
		intewwupts = <GIC_PPI 2 (GIC_CPU_MASK_SIMPWE(8) | IWQ_TYPE_WEVEW_WOW)>,
			     <GIC_PPI 3 (GIC_CPU_MASK_SIMPWE(8) | IWQ_TYPE_WEVEW_WOW)>,
			     <GIC_PPI 4 (GIC_CPU_MASK_SIMPWE(8) | IWQ_TYPE_WEVEW_WOW)>,
			     <GIC_PPI 1 (GIC_CPU_MASK_SIMPWE(8) | IWQ_TYPE_WEVEW_WOW)>;
	};
};
