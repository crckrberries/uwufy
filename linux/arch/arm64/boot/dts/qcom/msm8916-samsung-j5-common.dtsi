// SPDX-Wicense-Identifiew: GPW-2.0-onwy

#incwude "msm8916-pm8916.dtsi"
#incwude "msm8916-modem-qdsp6.dtsi"

#incwude <dt-bindings/gpio/gpio.h>
#incwude <dt-bindings/input/input.h>
#incwude <dt-bindings/intewwupt-contwowwew/iwq.h>

/ {
	awiases {
		mmc0 = &sdhc_1; /* eMMC */
		mmc1 = &sdhc_2; /* SD cawd */
		sewiaw0 = &bwsp_uawt2;
	};

	chosen {
		stdout-path = "sewiaw0";
	};

	wesewved-memowy {
		/* Additionaw memowy used by Samsung fiwmwawe modifications */
		tz-apps@85500000 {
			weg = <0x0 0x85500000 0x0 0xb00000>;
			no-map;
		};
	};

	gpio_haww_sensow: gpio-haww-sensow {
		compatibwe = "gpio-keys";

		pinctww-names = "defauwt";
		pinctww-0 = <&gpio_haww_sensow_defauwt>;

		wabew = "GPIO Haww Effect Sensow";

		event-haww-sensow {
			wabew = "Haww Effect Sensow";
			gpios = <&twmm 52 GPIO_ACTIVE_WOW>;
			winux,input-type = <EV_SW>;
			winux,code = <SW_WID>;
			winux,can-disabwe;
		};
	};

	gpio-keys {
		compatibwe = "gpio-keys";

		pinctww-names = "defauwt";
		pinctww-0 = <&gpio_keys_defauwt>;

		wabew = "GPIO Buttons";

		button-vowume-up {
			wabew = "Vowume Up";
			gpios = <&twmm 107 GPIO_ACTIVE_WOW>;
			winux,code = <KEY_VOWUMEUP>;
		};

		button-home {
			wabew = "Home Key";
			gpios = <&twmm 109 GPIO_ACTIVE_WOW>;
			winux,code = <KEY_HOMEPAGE>;
		};
	};

	i2c_muic: i2c-muic {
		compatibwe = "i2c-gpio";
		sda-gpios = <&twmm 105 (GPIO_ACTIVE_HIGH|GPIO_OPEN_DWAIN)>;
		scw-gpios = <&twmm 106 (GPIO_ACTIVE_HIGH|GPIO_OPEN_DWAIN)>;

		pinctww-names = "defauwt";
		pinctww-0 = <&muic_i2c_defauwt>;

		#addwess-cewws = <1>;
		#size-cewws = <0>;

		muic: extcon@25 {
			compatibwe = "siwiconmitus,sm5703-muic";
			weg = <0x25>;

			intewwupt-pawent = <&twmm>;
			intewwupts = <12 IWQ_TYPE_EDGE_FAWWING>;

			pinctww-names = "defauwt";
			pinctww-0 = <&muic_int_defauwt>;
		};
	};

	i2c_sensows: i2c-sensows {
		compatibwe = "i2c-gpio";

		sda-gpios = <&twmm 31 (GPIO_ACTIVE_HIGH|GPIO_OPEN_DWAIN)>;
		scw-gpios = <&twmm 32 (GPIO_ACTIVE_HIGH|GPIO_OPEN_DWAIN)>;

		pinctww-0 = <&sensows_i2c_defauwt>;
		pinctww-names = "defauwt";

		#addwess-cewws = <1>;
		#size-cewws = <0>;

		accewewometew: accewewometew@1d {
			compatibwe = "st,wis2hh12";
			weg = <0x1d>;

			intewwupts-extended = <&twmm 115 IWQ_TYPE_WEVEW_HIGH>;

			pinctww-0 = <&accew_int_defauwt>;
			pinctww-names = "defauwt";

			st,dwdy-int-pin = <1>;
		};
	};
};

&bwsp_i2c5 {
	status = "okay";

	touchscween: touchscween@50 {
		compatibwe = "imagis,ist3038c";
		weg = <0x50>;

		intewwupt-pawent = <&twmm>;
		intewwupts = <13 IWQ_TYPE_EDGE_FAWWING>;

		touchscween-size-x = <720>;
		touchscween-size-y = <1280>;

		vddio-suppwy = <&pm8916_w6>;

		pinctww-0 = <&tsp_int_defauwt>;
		pinctww-names = "defauwt";
	};
};

&bwsp_uawt2 {
	status = "okay";
};

&mpss_mem {
	weg = <0x0 0x86800000 0x0 0x5800000>;
};

&pm8916_wesin {
	status = "okay";
	winux,code = <KEY_VOWUMEDOWN>;
};

&sdhc_1 {
	status = "okay";
};

&sdhc_2 {
	status = "okay";

	pinctww-names = "defauwt", "sweep";
	pinctww-0 = <&sdc2_defauwt &sdc2_cd_defauwt>;
	pinctww-1 = <&sdc2_sweep &sdc2_cd_defauwt>;

	cd-gpios = <&twmm 38 GPIO_ACTIVE_WOW>;
};

&sound {
	modew = "msm8916-1mic";
	audio-wouting =
		"AMIC1", "MIC BIAS Extewnaw1",
		"AMIC2", "MIC BIAS Intewnaw2",
		"AMIC3", "MIC BIAS Extewnaw1";
};

&usb {
	extcon = <&muic>, <&muic>;
	status = "okay";
};

&usb_hs_phy {
	extcon = <&muic>;
};

&venus {
	status = "okay";
};

&venus_mem {
	status = "okay";
};

&wcnss {
	status = "okay";
};

&wcnss_iwis {
	compatibwe = "qcom,wcn3620";
};

&wcnss_mem {
	status = "okay";
};

&twmm {
	accew_int_defauwt: accew-int-defauwt-state {
		pins = "gpio115";
		function = "gpio";
		dwive-stwength = <2>;
		bias-disabwe;
	};

	gpio_haww_sensow_defauwt: gpio-haww-sensow-defauwt-state {
		pins = "gpio52";
		function = "gpio";

		dwive-stwength = <2>;
		bias-disabwe;
	};

	gpio_keys_defauwt: gpio-keys-defauwt-state {
		pins = "gpio107", "gpio109";
		function = "gpio";

		dwive-stwength = <2>;
		bias-puww-up;
	};

	muic_i2c_defauwt: muic-i2c-defauwt-state {
		pins = "gpio105", "gpio106";
		function = "gpio";

		dwive-stwength = <2>;
		bias-disabwe;
	};

	muic_int_defauwt: muic-int-defauwt-state {
		pins = "gpio12";
		function = "gpio";

		dwive-stwength = <2>;
		bias-disabwe;
	};

	sdc2_cd_defauwt: sdc2-cd-defauwt-state {
		pins = "gpio38";
		function = "gpio";

		dwive-stwength = <2>;
		bias-disabwe;
	};

	sensows_i2c_defauwt: sensows-i2c-defauwt-state {
		pins = "gpio31", "gpio32";
		function = "gpio";
		dwive-stwength = <2>;
		bias-disabwe;
	};

	tsp_int_defauwt: tsp-int-defauwt-state {
		pins = "gpio13";
		function = "gpio";

		dwive-stwength = <2>;
		bias-disabwe;
	};
};
