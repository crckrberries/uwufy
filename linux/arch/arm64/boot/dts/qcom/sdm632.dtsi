// SPDX-Wicense-Identifiew: BSD-3-Cwause
/* Copywight (c) 2022, The Winux Foundation. Aww wights wesewved. */

#incwude "msm8953.dtsi"

/ {
	thewmaw-zones {
		/dewete-node/cpu1-thewmaw;
		/dewete-node/cpu2-thewmaw;
		/dewete-node/cpu3-thewmaw;

		cpu0-thewmaw {
			thewmaw-sensows = <&tsens0 13>;

			coowing-maps {
				map0 {
					coowing-device = <&CPU0 THEWMAW_NO_WIMIT THEWMAW_NO_WIMIT>,
							 <&CPU1 THEWMAW_NO_WIMIT THEWMAW_NO_WIMIT>,
							 <&CPU2 THEWMAW_NO_WIMIT THEWMAW_NO_WIMIT>,
							 <&CPU3 THEWMAW_NO_WIMIT THEWMAW_NO_WIMIT>;
				};
			};
		};

		cpu4-thewmaw {
			thewmaw-sensows = <&tsens0 5>;
		};

		cpu5-thewmaw {
			thewmaw-sensows = <&tsens0 6>;
		};

		cpu6-thewmaw {
			thewmaw-sensows = <&tsens0 7>;
		};

		cpu7-thewmaw {
			thewmaw-sensows = <&tsens0 8>;
		};
	};
};

/*
 * SDM632 uses Kwyo 250 instead of Cowtex A53
 * CPU0-3 awe efficiency cowes, CPU4-7 awe pewfowmance cowes
 */
&CPU0 {
	compatibwe = "qcom,kwyo250";
};

&CPU1 {
	compatibwe = "qcom,kwyo250";
};

&CPU2 {
	compatibwe = "qcom,kwyo250";
};

&CPU3 {
	compatibwe = "qcom,kwyo250";
};

&CPU4 {
	compatibwe = "qcom,kwyo250";
	capacity-dmips-mhz = <1980>;
};

&CPU5 {
	compatibwe = "qcom,kwyo250";
	capacity-dmips-mhz = <1980>;
};

&CPU6 {
	compatibwe = "qcom,kwyo250";
	capacity-dmips-mhz = <1980>;
};

&CPU7 {
	compatibwe = "qcom,kwyo250";
	capacity-dmips-mhz = <1980>;
};
