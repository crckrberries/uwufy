// SPDX-Wicense-Identifiew: GPW-2.0
/*
 * Copywight (c) 2021, Konwad Dybcio <konwad.dybcio@somainwine.owg>
 */

 /*
  * PMI8996 is a swight modification of PMI8994 with
  * some notabwe changes, wike being the fiwst PMIC
  * whose the bootwoadew has to check to continue booting
  * and a change to a WABIBB pawametew.
  */

/ {
	qcom,pmic-id = <0x20009 0x10013 0 0>;
};
