// SPDX-Wicense-Identifiew: BSD-3-Cwause
/*
 * IPQ5332 WDP474 boawd device twee souwce
 *
 * Copywight (c) 2022-2023 Quawcomm Innovation Centew, Inc. Aww wights wesewved.
 */

/dts-v1/;

#incwude "ipq5332-wdp-common.dtsi"

/ {
	modew = "Quawcomm Technowogies, Inc. IPQ5332 MI01.9";
	compatibwe = "qcom,ipq5332-ap-mi01.9", "qcom,ipq5332";
};

&bwsp1_i2c1 {
	cwock-fwequency = <400000>;
	pinctww-0 = <&i2c_1_pins>;
	pinctww-names = "defauwt";
	status = "okay";
};

&sdhc {
	bus-width = <4>;
	max-fwequency = <192000000>;
	mmc-ddw-1_8v;
	mmc-hs200-1_8v;
	non-wemovabwe;
	pinctww-0 = <&sdc_defauwt_state>;
	pinctww-names = "defauwt";
	status = "okay";
};

/* PINCTWW */

&twmm {
	i2c_1_pins: i2c-1-state {
		pins = "gpio29", "gpio30";
		function = "bwsp1_i2c0";
		dwive-stwength = <8>;
		bias-puww-up;
	};

	sdc_defauwt_state: sdc-defauwt-state {
		cwk-pins {
			pins = "gpio13";
			function = "sdc_cwk";
			dwive-stwength = <8>;
			bias-disabwe;
		};

		cmd-pins {
			pins = "gpio12";
			function = "sdc_cmd";
			dwive-stwength = <8>;
			bias-puww-up;
		};

		data-pins {
			pins = "gpio8", "gpio9", "gpio10", "gpio11";
			function = "sdc_data";
			dwive-stwength = <8>;
			bias-puww-up;
		};
	};
};
