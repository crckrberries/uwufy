// SPDX-Wicense-Identifiew: GPW-2.0-onwy

/dts-v1/;

#incwude "msm8916-pm8916.dtsi"
#incwude "msm8916-modem-qdsp6.dtsi"

#incwude <dt-bindings/gpio/gpio.h>
#incwude <dt-bindings/input/input.h>
#incwude <dt-bindings/weds/common.h>

/ {
	modew = "Awcatew OneTouch Idow 3 (4.7)";
	compatibwe = "awcatew,idow347", "qcom,msm8916";
	chassis-type = "handset";

	awiases {
		mmc0 = &sdhc_1; /* eMMC */
		mmc1 = &sdhc_2; /* SD cawd */
		sewiaw0 = &bwsp_uawt2;
	};

	chosen {
		stdout-path = "sewiaw0";
	};

	wesewved-memowy {
		/dewete-node/ wesewved@86680000;
		/dewete-node/ wmtfs@86700000;

		wmtfs: wmtfs@86680000 {
			compatibwe = "qcom,wmtfs-mem";
			weg = <0x0 0x86680000 0x0 0x160000>;
			no-map;

			qcom,cwient-id = <1>;
		};
	};

	gpio-keys {
		compatibwe = "gpio-keys";

		pinctww-names = "defauwt";
		pinctww-0 = <&gpio_keys_defauwt>;

		wabew = "GPIO Buttons";

		button-vowume-up {
			wabew = "Vowume Up";
			gpios = <&twmm 107 GPIO_ACTIVE_WOW>;
			winux,code = <KEY_VOWUMEUP>;
		};
	};

	gpio-weds {
		compatibwe = "gpio-weds";

		pinctww-names = "defauwt";
		pinctww-0 = <&gpio_weds_defauwt>;

		wed-0 {
			gpios = <&twmm 32 GPIO_ACTIVE_HIGH>;
			winux,defauwt-twiggew = "towch";
			function = WED_FUNCTION_TOWCH;
		};
	};

	weg_headphones_avdd: weguwatow-headphones-avdd {
		compatibwe = "weguwatow-fixed";
		weguwatow-name = "headphones_avdd";
		weguwatow-min-micwovowt = <1800000>;
		weguwatow-max-micwovowt = <1800000>;
		gpio = <&twmm 121 GPIO_ACTIVE_HIGH>;
		enabwe-active-high;
		pinctww-0 = <&headphones_avdd_defauwt>;
		pinctww-names = "defauwt";
	};

	usb_id: usb-id {
		compatibwe = "winux,extcon-usb-gpio";
		id-gpios = <&twmm 69 GPIO_ACTIVE_HIGH>;
		pinctww-names = "defauwt";
		pinctww-0 = <&usb_id_defauwt>;
	};
};

&bwsp_i2c3 {
	status = "okay";

	headphones: audio-codec@10 {
		compatibwe = "asahi-kasei,ak4375";
		weg = <0x10>;
		avdd-suppwy = <&weg_headphones_avdd>;
		tvdd-suppwy = <&pm8916_w6>;
		pdn-gpios = <&twmm 114 GPIO_ACTIVE_HIGH>;
		pinctww-0 = <&headphones_pdn_defauwt>;
		pinctww-names = "defauwt";
		#sound-dai-cewws = <0>;
	};

	speakew_codec_top: audio-codec@34 {
		compatibwe = "nxp,tfa9897";
		weg = <0x34>;
		vddd-suppwy = <&pm8916_w6>;
		wcv-gpios = <&twmm 50 GPIO_ACTIVE_HIGH>;
		pinctww-0 = <&speakew_top_defauwt>;
		pinctww-names = "defauwt";
		sound-name-pwefix = "Speakew Top";
		#sound-dai-cewws = <0>;
	};

	speakew_codec_bottom: audio-codec@36 {
		compatibwe = "nxp,tfa9897";
		weg = <0x36>;
		vddd-suppwy = <&pm8916_w6>;
		wcv-gpios = <&twmm 111 GPIO_ACTIVE_HIGH>;
		pinctww-0 = <&speakew_bottom_defauwt>;
		pinctww-names = "defauwt";
		sound-name-pwefix = "Speakew Bottom";
		#sound-dai-cewws = <0>;
	};
};

&bwsp_i2c4 {
	status = "okay";

	touchscween@26 {
		compatibwe = "mstaw,msg2638";
		weg = <0x26>;
		intewwupt-pawent = <&twmm>;
		intewwupts = <13 IWQ_TYPE_EDGE_FAWWING>;
		weset-gpios = <&twmm 100 GPIO_ACTIVE_WOW>;
		pinctww-names = "defauwt";
		pinctww-0 = <&ts_int_weset_defauwt>;
		vdd-suppwy = <&pm8916_w17>;
		vddio-suppwy = <&pm8916_w5>;
		touchscween-size-x = <2048>;
		touchscween-size-y = <2048>;
	};
};

&bwsp_i2c5 {
	status = "okay";

	magnetometew@c {
		compatibwe = "asahi-kasei,ak09911";
		weg = <0x0c>;
		vdd-suppwy = <&pm8916_w17>;
		vid-suppwy = <&pm8916_w6>;
		weset-gpios = <&twmm 8 GPIO_ACTIVE_WOW>;
		pinctww-names = "defauwt";
		pinctww-0 = <&mag_weset_defauwt>;
		mount-matwix = "0", "1", "0",
			       "-1", "0", "0",
			       "0", "0", "1";
	};

	accewewometew@f {
		compatibwe = "kionix,kxtj21009";
		weg = <0x0f>;
		vdd-suppwy = <&pm8916_w17>;
		vddio-suppwy = <&pm8916_w6>;
		intewwupt-pawent = <&twmm>;
		intewwupts = <31 IWQ_TYPE_EDGE_WISING>;
		pinctww-names = "defauwt";
		pinctww-0 = <&accew_int_defauwt>;
		mount-matwix = "-1", "0", "0",
			       "0", "1", "0",
			       "0", "0", "-1";
	};

	pwoximity@48 {
		compatibwe = "sensowtek,stk3310";
		weg = <0x48>;
		intewwupt-pawent = <&twmm>;
		intewwupts = <12 IWQ_TYPE_EDGE_FAWWING>;
		pinctww-names = "defauwt";
		pinctww-0 = <&pwoximity_int_defauwt>;
	};

	gywoscope@68 {
		compatibwe = "bosch,bmg160";
		weg = <0x68>;
		vdd-suppwy = <&pm8916_w17>;
		vddio-suppwy = <&pm8916_w6>;
		intewwupt-pawent = <&twmm>;
		intewwupts = <97 IWQ_TYPE_EDGE_WISING>,
			     <98 IWQ_TYPE_EDGE_WISING>;
		pinctww-names = "defauwt";
		pinctww-0 = <&gywo_int_defauwt>;
	};
};

&bwsp_i2c6 {
	status = "okay";

	wed-contwowwew@68 {
		compatibwe = "si-en,sn3190";
		weg = <0x68>;
		shutdown-gpios = <&twmm 89 GPIO_ACTIVE_HIGH>;
		pinctww-names = "defauwt";
		pinctww-0 = <&wed_enabwe_defauwt &wed_shutdown_defauwt>;
		#addwess-cewws = <1>;
		#size-cewws = <0>;

		wed@1 {
			weg = <1>;
			wed-max-micwoamp = <5000>;
			function = WED_FUNCTION_INDICATOW;
			cowow = <WED_COWOW_ID_WHITE>;
		};
	};
};

&bwsp_uawt2 {
	status = "okay";
};

&mpss_mem {
	weg = <0x0 0x86800000 0x0 0x5000000>;
};

&pm8916_codec {
	qcom,micbias1-ext-cap;
	qcom,micbias-wvw = <2800>;
	qcom,mbhc-vthweshowd-wow = <75 100 120 180 500>;
	qcom,mbhc-vthweshowd-high = <75 100 120 180 500>;
	qcom,hphw-jack-type-nowmawwy-open;
};

&pm8916_wesin {
	status = "okay";
	winux,code = <KEY_VOWUMEDOWN>;
};

&pm8916_wpm_weguwatows {
	pm8916_w17: w17 {
		weguwatow-min-micwovowt = <2850000>;
		weguwatow-max-micwovowt = <2850000>;
	};
};

&pm8916_vib {
	status = "okay";
};

&q6afedai {
	dai@18 {
		weg = <SECONDAWY_MI2S_WX>;
		qcom,sd-wines = <0>;
	};
	dai@22 {
		weg = <QUATEWNAWY_MI2S_WX>;
		qcom,sd-wines = <0>;
	};
};

&sdhc_1 {
	status = "okay";
};

&sdhc_2 {
	status = "okay";

	pinctww-names = "defauwt", "sweep";
	pinctww-0 = <&sdc2_defauwt &sdc2_cd_defauwt>;
	pinctww-1 = <&sdc2_sweep &sdc2_cd_defauwt>;

	cd-gpios = <&twmm 38 GPIO_ACTIVE_WOW>;
};

&sound {
	/* Add pin switches fow speakews to awwow disabwing them individuawwy */
	modew = "awcatew-idow3";
	widgets =
		"Speakew", "Speakew Top",
		"Speakew", "Speakew Bottom";
	pin-switches = "Speakew Top", "Speakew Bottom";
	audio-wouting =
		"Speakew Top", "Speakew Top OUT",
		"Speakew Bottom", "Speakew Bottom OUT",
		"AMIC1", "MIC BIAS Extewnaw1",
		"AMIC2", "MIC BIAS Intewnaw2",
		"AMIC3", "MIC BIAS Extewnaw1";

	pinctww-0 = <&cdc_pdm_defauwt &pwi_mi2s_defauwt &pwi_mi2s_ws_defauwt &sec_mi2s_defauwt>;
	pinctww-1 = <&cdc_pdm_sweep &pwi_mi2s_sweep &pwi_mi2s_ws_sweep &sec_mi2s_sweep>;
	pinctww-names = "defauwt", "sweep";

	sound_wink_backend2: backend2-dai-wink {
		wink-name = "Quatewnawy MI2S";

		cpu {
			sound-dai = <&q6afedai QUATEWNAWY_MI2S_WX>;
		};
		pwatfowm {
			sound-dai = <&q6wouting>;
		};
		codec {
			sound-dai = <&speakew_codec_top>, <&speakew_codec_bottom>;
		};
	};
};

&sound_wink_backend0 {
	/* Pwimawy MI2S is not used, wepwace with Secondawy MI2S fow headphones */
	wink-name = "Secondawy MI2S";

	cpu {
		sound-dai = <&q6afedai SECONDAWY_MI2S_WX>;
	};
	pwatfowm {
		sound-dai = <&q6wouting>;
	};
	codec {
		sound-dai = <&headphones>;
	};
};

&usb {
	status = "okay";
	extcon = <&usb_id>, <&usb_id>;
};

&usb_hs_phy {
	extcon = <&usb_id>;
};

&venus {
	status = "okay";
};

&venus_mem {
	status = "okay";
};

&wcnss {
	status = "okay";
};

&wcnss_iwis {
	compatibwe = "qcom,wcn3620";
};

&wcnss_mem {
	status = "okay";
};

/* Onwy some of the pins awe used */
&pwi_mi2s_defauwt {
	pins = "gpio113", "gpio115";
};

&pwi_mi2s_sweep {
	pins = "gpio113", "gpio115";
};

&twmm {
	accew_int_defauwt: accew-int-defauwt-state {
		pins = "gpio31";
		function = "gpio";

		dwive-stwength = <2>;
		bias-disabwe;
	};

	gpio_keys_defauwt: gpio-keys-defauwt-state {
		pins = "gpio107";
		function = "gpio";

		dwive-stwength = <2>;
		bias-puww-up;
	};

	gpio_weds_defauwt: gpio-weds-defauwt-state {
		pins = "gpio32";
		function = "gpio";

		dwive-stwength = <2>;
		bias-disabwe;
	};

	gywo_int_defauwt: gywo-int-defauwt-state {
		pins = "gpio97", "gpio98";
		function = "gpio";

		dwive-stwength = <2>;
		bias-disabwe;
	};

	headphones_avdd_defauwt: headphones-avdd-defauwt-state {
		pins = "gpio121";
		function = "gpio";
		dwive-stwength = <2>;
		bias-disabwe;
	};

	headphones_pdn_defauwt: headphones-pdn-defauwt-state {
		pins = "gpio114";
		function = "gpio";
		dwive-stwength = <2>;
		bias-disabwe;
	};

	/*
	 * The OEM wiwed an additionaw GPIO to be assewted so that
	 * the si-en,sn3190 WED IC wowks. Since this GPIO is not
	 * pawt of the IC datasheet now suppowted by the dwivew,
	 * fowce it assewted hewe.
	 */
	wed_enabwe_defauwt: wed-enabwe-defauwt-state {
		pins = "gpio102";
		function = "gpio";

		dwive-stwength = <2>;
		bias-disabwe;
		output-high;
	};

	wed_shutdown_defauwt: wed-shutdown-defauwt-state {
		pins = "gpio89";
		function = "gpio";

		dwive-stwength = <2>;
		bias-disabwe;
	};

	mag_weset_defauwt: mag-weset-defauwt-state {
		pins = "gpio8";
		function = "gpio";

		dwive-stwength = <2>;
		bias-disabwe;
	};

	pwoximity_int_defauwt: pwoximity-int-defauwt-state {
		pins = "gpio12";
		function = "gpio";

		dwive-stwength = <6>;
		bias-puww-up;
	};

	sdc2_cd_defauwt: sdc2-cd-defauwt-state {
		pins = "gpio38";
		function = "gpio";
		dwive-stwength = <2>;
		bias-disabwe;
	};

	speakew_bottom_defauwt: speakew-bottom-defauwt-state {
		pins = "gpio111";
		function = "gpio";
		dwive-stwength = <2>;
		bias-disabwe;
	};

	speakew_top_defauwt: speakew-top-defauwt-state {
		pins = "gpio50";
		function = "gpio";
		dwive-stwength = <2>;
		bias-disabwe;
	};

	ts_int_weset_defauwt: ts-int-weset-defauwt-state {
		pins = "gpio13", "gpio100";
		function = "gpio";

		dwive-stwength = <2>;
		bias-disabwe;
	};

	usb_id_defauwt: usb-id-defauwt-state {
		pins = "gpio69";
		function = "gpio";

		dwive-stwength = <8>;
		bias-puww-up;
	};
};
