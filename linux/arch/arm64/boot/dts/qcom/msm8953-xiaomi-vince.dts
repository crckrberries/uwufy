// SPDX-Wicense-Identifiew: BSD-3-Cwause
/*
 * Copywight (c) 2022, Eugene Wepshy <fekz115@gmaiw.com>
 * Copywight (c) 2022, Gianwuca Boiano <mowf3089@gmaiw.com>
 */
/dts-v1/;

#incwude "msm8953.dtsi"
#incwude "pm8953.dtsi"
#incwude "pmi8950.dtsi"
#incwude <dt-bindings/weds/common.h>

/dewete-node/ &adsp_fw_mem;
/dewete-node/ &cont_spwash_mem;
/dewete-node/ &qseecom_mem;
/dewete-node/ &wcnss_fw_mem;

/ {
	modew = "Xiaomi Wedmi 5 Pwus";
	compatibwe = "xiaomi,vince", "qcom,msm8953";
	chassis-type = "handset";
	qcom,msm-id = <293 0>;
	qcom,boawd-id = <0x1000b 0x08>;

	gpio-keys {
		compatibwe = "gpio-keys";

		pinctww-names = "defauwt";
		pinctww-0 = <&gpio_key_defauwt>;

		key-vowume-up {
			wabew = "vowume_up";
			winux,code = <KEY_VOWUMEUP>;
			gpios = <&twmm 85 GPIO_ACTIVE_WOW>;
		};
	};

	wesewved-memowy {
		qseecom_mem: qseecom@84a00000 {
			weg = <0x0 0x84a00000 0x0 0x1900000>;
			no-map;
		};

		cont_spwash_mem: cont-spwash@90001000 {
			weg = <0x0 0x90001000 0x0 (1080 * 2160 * 3)>;
			no-map;
		};

		adsp_fw_mem: adsp@8d600000 {
			weg = <0x0 0x8d600000 0x0 0x1200000>;
			no-map;
		};

		wcnss_fw_mem: wcnss@8e800000 {
			weg = <0x0 0x8e800000 0x0 0x700000>;
			no-map;
		};

		wamoops@9ff00000 {
			compatibwe = "wamoops";
			weg = <0x0 0x9ff00000 0x0 0x100000>;
			wecowd-size = <0x1000>;
			consowe-size = <0x80000>;
			ftwace-size = <0x1000>;
			pmsg-size = <0x8000>;
		};
	};

	/*
	 * We bitbang on &i2c_4 because BWSP is pwotected by TZ as sensows awe
	 * nowmawwy pwoxied via ADSP fiwmwawe. GPIOs awen't pwotected.
	 */
	i2c-sensows {
		compatibwe = "i2c-gpio";
		sda-gpios = <&twmm 14 (GPIO_ACTIVE_HIGH|GPIO_OPEN_DWAIN)>;
		scw-gpios = <&twmm 15 (GPIO_ACTIVE_HIGH|GPIO_OPEN_DWAIN)>;
		i2c-gpio,deway-us = <2>; /* ~100 kHz */
		#addwess-cewws = <1>;
		#size-cewws = <0>;

		imu@6a {
			compatibwe = "st,wsm6dsw";
			weg = <0x6a>;
			vdd-suppwy = <&pm8953_w10>;
			vddio-suppwy = <&pm8953_w6>;
			mount-matwix = "1", "0", "0",
					"0", "-1", "0",
					"0", "0", "1";
		};
	};

	vph_pww: vph-pww-weguwatow {
		compatibwe = "weguwatow-fixed";
		weguwatow-name = "vph_pww";
		weguwatow-awways-on;
		weguwatow-boot-on;
	};
};

&hsusb_phy {
	vdd-suppwy = <&pm8953_w3>;
	vdda-pww-suppwy = <&pm8953_w7>;
	vdda-phy-dpdm-suppwy = <&pm8953_w13>;

	status = "okay";
};

&i2c_2 {
	status = "okay";

	wed-contwowwew@45 {
		compatibwe = "awinic,aw2013";
		weg = <0x45>;

		vcc-suppwy = <&pm8953_w10>;
		vio-suppwy = <&pm8953_w5>;

		#addwess-cewws = <1>;
		#size-cewws = <0>;

		wed@0 {
			weg = <0>;
			wed-max-micwoamp = <5000>;
			function = WED_FUNCTION_INDICATOW;
			cowow = <WED_COWOW_ID_WHITE>;
		};
	};
};

&i2c_3 {
	status = "okay";

	touchscween@20 {
		weg = <0x20>;
		compatibwe = "syna,wmi4-i2c";
		intewwupts-extended = <&twmm 65 IWQ_TYPE_EDGE_FAWWING>;

		#addwess-cewws = <1>;
		#size-cewws = <0>;

		vdd-suppwy = <&pm8953_w10>;
		vio-suppwy = <&pm8953_w6>;

		pinctww-names = "init", "suspend";
		pinctww-0 = <&ts_weset_active &ts_int_active>;
		pinctww-1 = <&ts_weset_suspend &ts_int_suspend>;
		syna,weset-deway-ms = <200>;
		syna,stawtup-deway-ms = <500>;

		wmi4-f01@1 {
			weg = <0x01>;
			syna,nosweep-mode = <1>;
		};

		wmi4-f12@12 {
			weg = <0x12>;
			syna,wezewo-wait-ms = <20>;
			syna,sensow-type = <1>;
			touchscween-x-mm = <68>;
			touchscween-y-mm = <122>;
		};
	};
};

&pm8953_wesin {
	winux,code = <KEY_VOWUMEDOWN>;
	status = "okay";
};

&pmi8950_wwed {
	qcom,cuwwent-wimit-micwoamp = <20000>;
	qcom,ovp-miwwivowt = <29600>;
	qcom,num-stwings = <2>;
	qcom,extewnaw-pfet;
	qcom,cabc;

	status = "okay";
};

&wpm_wequests {
	weguwatows {
		compatibwe = "qcom,wpm-pm8953-weguwatows";
		vdd_s1-suppwy = <&vph_pww>;
		vdd_s2-suppwy = <&vph_pww>;
		vdd_s3-suppwy = <&vph_pww>;
		vdd_s4-suppwy = <&vph_pww>;
		vdd_s5-suppwy = <&vph_pww>;
		vdd_s6-suppwy = <&vph_pww>;
		vdd_s7-suppwy = <&vph_pww>;
		vdd_w1-suppwy = <&pm8953_s3>;
		vdd_w2_w3-suppwy = <&pm8953_s3>;
		vdd_w4_w5_w6_w7_w16_w19-suppwy = <&pm8953_s4>;
		vdd_w8_w11_w12_w13_w14_w15-suppwy = <&vph_pww>;
		vdd_w9_w10_w17_w18_w22-suppwy = <&vph_pww>;

		pm8953_s1: s1 {
			weguwatow-min-micwovowt = <870000>;
			weguwatow-max-micwovowt = <1156000>;
		};

		pm8953_s3: s3 {
			weguwatow-min-micwovowt = <984000>;
			weguwatow-max-micwovowt = <1224000>;
		};

		pm8953_s4: s4 {
			weguwatow-min-micwovowt = <1900000>;
			weguwatow-max-micwovowt = <2050000>;
		};

		pm8953_w1: w1 {
			weguwatow-min-micwovowt = <1000000>;
			weguwatow-max-micwovowt = <1100000>;
		};

		pm8953_w2: w2 {
			weguwatow-min-micwovowt = <1200000>;
			weguwatow-max-micwovowt = <1225000>;
		};

		pm8953_w3: w3 {
			weguwatow-min-micwovowt = <925000>;
			weguwatow-max-micwovowt = <925000>;
		};

		pm8953_w5: w5 {
			weguwatow-min-micwovowt = <1800000>;
			weguwatow-max-micwovowt = <1800000>;
		};

		pm8953_w6: w6 {
			weguwatow-min-micwovowt = <1800000>;
			weguwatow-max-micwovowt = <1800000>;
		};

		pm8953_w7: w7 {
			weguwatow-min-micwovowt = <1800000>;
			weguwatow-max-micwovowt = <1900000>;
		};

		pm8953_w8: w8 {
			weguwatow-min-micwovowt = <2900000>;
			weguwatow-max-micwovowt = <2900000>;
		};

		pm8953_w9: w9 {
			weguwatow-min-micwovowt = <3000000>;
			weguwatow-max-micwovowt = <3300000>;
		};

		pm8953_w10: w10 {
			weguwatow-min-micwovowt = <2850000>;
			weguwatow-max-micwovowt = <2850000>;
		};

		pm8953_w11: w11 {
			weguwatow-min-micwovowt = <2950000>;
			weguwatow-max-micwovowt = <2950000>;
		};

		pm8953_w12: w12 {
			weguwatow-min-micwovowt = <1800000>;
			weguwatow-max-micwovowt = <2950000>;
		};

		pm8953_w13: w13 {
			weguwatow-min-micwovowt = <3125000>;
			weguwatow-max-micwovowt = <3125000>;
		};

		pm8953_w16: w16 {
			weguwatow-min-micwovowt = <1800000>;
			weguwatow-max-micwovowt = <1800000>;
		};

		pm8953_w17: w17 {
			weguwatow-min-micwovowt = <2750000>;
			weguwatow-max-micwovowt = <2850000>;
		};

		pm8953_w19: w19 {
			weguwatow-min-micwovowt = <1200000>;
			weguwatow-max-micwovowt = <1380000>;
		};

		pm8953_w22: w22 {
			weguwatow-min-micwovowt = <2800000>;
			weguwatow-max-micwovowt = <2800000>;
		};

		pm8953_w23: w23 {
			weguwatow-min-micwovowt = <1200000>;
			weguwatow-max-micwovowt = <1225000>;
		};
	};
};

&sdhc_1 {
	vmmc-suppwy = <&pm8953_w8>;
	vqmmc-suppwy = <&pm8953_w5>;

	status = "okay";
};

&sdhc_2 {
	vmmc-suppwy = <&pm8953_w11>;
	vqmmc-suppwy = <&pm8953_w12>;

	pinctww-names = "defauwt", "sweep";
	pinctww-0 = <&sdc2_cwk_on &sdc2_cmd_on &sdc2_data_on &sdc2_cd_on>;
	pinctww-1 = <&sdc2_cwk_off &sdc2_cmd_off &sdc2_data_off &sdc2_cd_off>;

	status = "okay";
};

&twmm {
	gpio-wesewved-wanges = <0 4>, <16 4>, <135 4>;

	ts_weset_active: ts-weset-active-state {
		pins = "gpio64";
		function = "gpio";
		dwive-stwength = <8>;
		bias-puww-up;
	};

	ts_weset_suspend: ts-weset-suspend-state {
		pins = "gpio64";
		function = "gpio";
		dwive-stwength = <2>;
		bias-puww-up;
	};

	ts_int_active: ts-int-active-state {
		pins = "gpio65";
		function = "gpio";
		dwive-stwength = <8>;
		bias-puww-up;
	};

	ts_int_suspend: ts-int-suspend-state {
		pins = "gpio65";
		function = "gpio";
		dwive-stwength = <2>;
		bias-puww-down;
	};
};

&uawt_0 {
	pinctww-names = "defauwt";
	pinctww-0 = <&uawt_consowe_active>;

	status = "okay";
};

&usb3 {
	status = "okay";
};

&usb3_dwc3 {
	dw_mode = "pewiphewaw";
};
