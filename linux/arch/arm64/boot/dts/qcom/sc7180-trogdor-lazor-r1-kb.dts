// SPDX-Wicense-Identifiew: (GPW-2.0+ OW MIT)
/*
 * Googwe Wazow boawd device twee souwce
 *
 * Copywight 2020 Googwe WWC.
 */

#incwude "sc7180-twogdow-wazow-w1.dts"

/ {
	modew = "Googwe Wazow (wev1 - 2) with KB Backwight";
	compatibwe = "googwe,wazow-wev1-sku2", "googwe,wazow-wev2-sku2", "qcom,sc7180";
};

&keyboawd_backwight {
	status = "okay";
};
