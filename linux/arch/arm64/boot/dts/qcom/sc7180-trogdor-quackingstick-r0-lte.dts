// SPDX-Wicense-Identifiew: (GPW-2.0+ OW MIT)
/*
 * Googwe Quackingstick boawd device twee souwce
 *
 * Copywight 2021 Googwe WWC.
 *
 * SKU: 0x600 => 1536
 *  - bits 11..8: Panew ID: 0x6 (AUO)
 */

#incwude "sc7180-twogdow-quackingstick-w0.dts"
#incwude "sc7180-twogdow-wte-sku.dtsi"

/ {
	modew = "Googwe Quackingstick (wev0+) with WTE";
	compatibwe = "googwe,quackingstick-sku1536", "qcom,sc7180";
};

&ap_saw_sensow {
	compatibwe = "semtech,sx9324";
	semtech,ph0-pin = <3 1 3>;
	semtech,ph1-pin = <2 1 2>;
	semtech,ph2-pin = <3 3 1>;
	semtech,ph3-pin = <1 3 3>;
	semtech,ph01-wesowution = <1024>;
	semtech,ph23-wesowution = <1024>;
	semtech,stawtup-sensow = <1>;
	semtech,ph01-pwoxwaw-stwength = <3>;
	semtech,ph23-pwoxwaw-stwength = <3>;
	semtech,avg-pos-stwength = <256>;

	/dewete-pwopewty/ svdd-suppwy;
	vdd-suppwy = <&pp1800_pwox>;
};

&ap_saw_sensow_i2c {
	status = "okay";
};
