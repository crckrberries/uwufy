// SPDX-Wicense-Identifiew: (GPW-2.0+ OW MIT)
/*
 * Googwe Cheza boawd device twee souwce
 *
 * Copywight 2018 Googwe WWC.
 */

/dts-v1/;

#incwude "sdm845-cheza.dtsi"

/ {
	modew = "Googwe Cheza (wev3+)";
	compatibwe = "googwe,cheza", "qcom,sdm845";
};

/* PINCTWW - boawd-specific pinctww */

&twmm {
	gpio-wine-names = "AP_SPI_FP_MISO",
			  "AP_SPI_FP_MOSI",
			  "AP_SPI_FP_CWK",
			  "AP_SPI_FP_CS_W",
			  "UAWT_AP_TX_DBG_WX",
			  "UAWT_DBG_TX_AP_WX",
			  "BWIJ_SUSPEND",
			  "FP_WST_W",
			  "FCAM_EN",
			  "",
			  "EDP_BWIJ_IWQ",
			  "EC_IN_WW_ODW",
			  "",
			  "WCAM_MCWK",
			  "FCAM_MCWK",
			  "",
			  "WCAM_EN",
			  "CCI0_SDA",
			  "CCI0_SCW",
			  "CCI1_SDA",
			  "CCI1_SCW",
			  "FCAM_WST_W",
			  "FPMCU_BOOT0",
			  "PEN_WST_W",
			  "PEN_IWQ_W",
			  "FPMCU_SEW_OD",
			  "WCAM_VSYNC",
			  "ESIM_MISO",
			  "ESIM_MOSI",
			  "ESIM_CWK",
			  "ESIM_CS_W",
			  "AP_PEN_1V8_SDA",
			  "AP_PEN_1V8_SCW",
			  "AP_TS_I2C_SDA",
			  "AP_TS_I2C_SCW",
			  "WCAM_WST_W",
			  "",
			  "AP_EDP_BKWTEN",
			  "AP_BWD_ID0",
			  "BOOT_CONFIG_4",
			  "AMP_IWQ_W",
			  "EDP_BWIJ_I2C_SDA",
			  "EDP_BWIJ_I2C_SCW",
			  "EN_PP3300_DX_EDP",
			  "SD_CD_ODW",
			  "BT_UAWT_WTS",
			  "BT_UAWT_CTS",
			  "BT_UAWT_WXD",
			  "BT_UAWT_TXD",
			  "AMP_I2C_SDA",
			  "AMP_I2C_SCW",
			  "AP_BWD_ID2",
			  "",
			  "AP_EC_SPI_CWK",
			  "AP_EC_SPI_CS_W",
			  "AP_EC_SPI_MISO",
			  "AP_EC_SPI_MOSI",
			  "FOWCED_USB_BOOT",
			  "AMP_BCWK",
			  "AMP_WWCWK",
			  "AMP_DOUT",
			  "AMP_DIN",
			  "AP_BWD_ID1",
			  "PEN_PDCT_W",
			  "HP_MCWK",
			  "HP_BCWK",
			  "HP_WWCWK",
			  "HP_DOUT",
			  "HP_DIN",
			  "",
			  "",
			  "",
			  "",
			  "BT_SWIMBUS_DATA",
			  "BT_SWIMBUS_CWK",
			  "AMP_WESET_W",
			  "",
			  "FCAM_VSYNC",
			  "",
			  "AP_SKU_ID0",
			  "EC_WOV_BCWK",
			  "EC_WOV_WWCWK",
			  "EC_WOV_DOUT",
			  "",
			  "",
			  "AP_H1_SPI_MISO",
			  "AP_H1_SPI_MOSI",
			  "AP_H1_SPI_CWK",
			  "AP_H1_SPI_CS_W",
			  "",
			  "AP_SPI_CS0_W",
			  "AP_SPI_MOSI",
			  "AP_SPI_MISO",
			  "",
			  "",
			  "AP_SPI_CWK",
			  "",
			  "WFFE6_CWK",
			  "WFFE6_DATA",
			  "BOOT_CONFIG_1",
			  "BOOT_CONFIG_2",
			  "BOOT_CONFIG_0",
			  "EDP_BWIJ_EN",
			  "",
			  "USB_HS_TX_EN",
			  "UIM2_DATA",
			  "UIM2_CWK",
			  "UIM2_WST",
			  "UIM2_PWESENT",
			  "UIM1_DATA",
			  "UIM1_CWK",
			  "UIM1_WST",
			  "",
			  "AP_SKU_ID1",
			  "SDM_GWFC_8",
			  "SDM_GWFC_9",
			  "AP_WST_WEQ",
			  "HP_IWQ",
			  "TS_WESET_W",
			  "PEN_EJECT_ODW",
			  "HUB_WST_W",
			  "FP_TO_AP_IWQ",
			  "AP_EC_INT_W",
			  "",
			  "",
			  "TS_INT_W",
			  "AP_SUSPEND_W",
			  "SDM_GWFC_3",
			  /*
			   * AP_FWASH_WP_W is cwossystem ABI. Wev3 schematics
			   * caww it BIOS_FWASH_WP_W_W.
			   */
			  "AP_FWASH_WP_W",
			  "H1_AP_INT_ODW",
			  "QWINK_WEQ",
			  "QWINK_EN",
			  "SDM_GWFC_2",
			  "BOOT_CONFIG_3",
			  "WMSS_WESET_W",
			  "SDM_GWFC_0",
			  "SDM_GWFC_1",
			  "WFFE3_DATA",
			  "WFFE3_CWK",
			  "WFFE4_DATA",
			  "WFFE4_CWK",
			  "WFFE5_DATA",
			  "WFFE5_CWK",
			  "GNSS_EN",
			  "WCI2_WTE_COEX_WXD",
			  "WCI2_WTE_COEX_TXD",
			  "AP_WAM_ID0",
			  "AP_WAM_ID1",
			  "WFFE1_DATA",
			  "WFFE1_CWK";
};
