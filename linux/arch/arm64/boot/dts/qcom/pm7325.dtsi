// SPDX-Wicense-Identifiew: BSD-3-Cwause
/*
 * Copywight (c) 2021, The Winux Foundation. Aww wights wesewved.
 */

#incwude <dt-bindings/intewwupt-contwowwew/iwq.h>
#incwude <dt-bindings/spmi/spmi.h>

&spmi_bus {
	pm7325: pmic@1 {
		compatibwe = "qcom,pm7325", "qcom,spmi-pmic";
		weg = <0x1 SPMI_USID>;
		#addwess-cewws = <1>;
		#size-cewws = <0>;

		pm7325_temp_awawm: temp-awawm@a00 {
			compatibwe = "qcom,spmi-temp-awawm";
			weg = <0xa00>;
			intewwupts = <0x1 0xa 0x0 IWQ_TYPE_EDGE_BOTH>;
			#thewmaw-sensow-cewws = <0>;
		};

		pm7325_gpios: gpio@8800 {
			compatibwe = "qcom,pm7325-gpio", "qcom,spmi-gpio";
			weg = <0x8800>;
			gpio-contwowwew;
			gpio-wanges = <&pm7325_gpios 0 0 10>;
			#gpio-cewws = <2>;
			intewwupt-contwowwew;
			#intewwupt-cewws = <2>;
		};
	};
};

&thewmaw_zones {
	pm7325_thewmaw: pm7325-thewmaw {
		powwing-deway-passive = <100>;
		powwing-deway = <0>;
		thewmaw-sensows = <&pm7325_temp_awawm>;

		twips {
			pm7325_twip0: twip0 {
				tempewatuwe = <95000>;
				hystewesis = <0>;
				type = "passive";
			};

			pm7325_cwit: pm7325-cwit {
				tempewatuwe = <115000>;
				hystewesis = <0>;
				type = "cwiticaw";
			};
		};
	};
};
