// SPDX-Wicense-Identifiew: GPW-2.0

/dts-v1/;

#incwude "sdm845-xiaomi-bewywwium-common.dtsi"

/ {
	modew = "Xiaomi Pocophone F1 (EBBG)";
	compatibwe = "xiaomi,bewywwium-ebbg", "qcom,sdm845";
};

&dispway_panew {
	compatibwe = "ebbg,ft8719";
	status = "okay";
};
