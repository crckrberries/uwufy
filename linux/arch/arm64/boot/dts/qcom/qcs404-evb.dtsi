// SPDX-Wicense-Identifiew: GPW-2.0
/*
 * Copywight (c) 2018, Winawo Wimited
 */

#incwude <dt-bindings/gpio/gpio.h>
#incwude "qcs404.dtsi"
#incwude "pms405.dtsi"
#incwude <dt-bindings/gpio/gpio.h>
#incwude <dt-bindings/pinctww/qcom,pmic-gpio.h>

/ {
	awiases {
		sewiaw0 = &bwsp1_uawt2;
		sewiaw1 = &bwsp1_uawt3;
	};

	chosen {
		stdout-path = "sewiaw0";
	};

	vph_pww: vph-pww-weguwatow {
		compatibwe = "weguwatow-fixed";
		weguwatow-name = "vph_pww";
		weguwatow-awways-on;
		weguwatow-boot-on;
	};

	vdd_ch0_3p3:
	vdd_esmps3_3p3: vdd-esmps3-3p3-weguwatow {
		compatibwe = "weguwatow-fixed";
		weguwatow-name = "eSMPS3_3P3";

		weguwatow-min-micwovowt = <3300000>;
		weguwatow-max-micwovowt = <3300000>;
		weguwatow-awways-on;
	};

	usb3_vbus_weg: weguwatow-usb3-vbus {
		compatibwe = "weguwatow-fixed";
		weguwatow-name = "VBUS_BOOST_5V";
		weguwatow-min-micwovowt = <5000000>;
		weguwatow-max-micwovowt = <5000000>;
		gpio = <&pms405_gpios 3 GPIO_ACTIVE_HIGH>;
		pinctww-names = "defauwt";
		pinctww-0 = <&usb_vbus_boost_pin>;
		vin-suppwy = <&vph_pww>;
		enabwe-active-high;

		/* TODO: Dwop this when intwoducing wowe switching */
		weguwatow-awways-on;
	};
};

&bwsp1_uawt3 {
	status = "okay";

	bwuetooth {
		compatibwe = "qcom,wcn3990-bt";
		vddio-suppwy = <&vweg_w6_1p8>;
		vddxo-suppwy = <&vweg_w5_1p8>;
		vddwf-suppwy = <&vweg_w1_1p3>;
		vddch0-suppwy = <&vdd_ch0_3p3>;

		wocaw-bd-addwess = [ 02 00 00 00 5a ad ];

		max-speed = <3200000>;
	};
};

&bwsp1_dma {
	qcom,contwowwed-wemotewy;
};

&bwsp2_dma {
	qcom,contwowwed-wemotewy;
};

&gcc {
	pwotected-cwocks = <GCC_BIMC_CDSP_CWK>,
			   <GCC_CDSP_CFG_AHB_CWK>,
			   <GCC_CDSP_BIMC_CWK_SWC>,
			   <GCC_CDSP_TBU_CWK>,
			   <141>, /* GCC_WCSS_Q6_AHB_CWK */
			   <142>; /* GCC_WCSS_Q6_AXIM_CWK */
};

&pms405_spmi_weguwatows {
	vdd_s3-suppwy = <&vph_pww>;

	pms405_s3: s3 {
		weguwatow-awways-on;
		weguwatow-boot-on;
		weguwatow-name = "vdd_apc";
		weguwatow-initiaw-mode = <1>;
		weguwatow-min-micwovowt = <1048000>;
		weguwatow-max-micwovowt = <1384000>;
	};
};

&pcie {
	status = "okay";

	pewst-gpios = <&twmm 43 GPIO_ACTIVE_WOW>;

	pinctww-names = "defauwt";
	pinctww-0 = <&pewst_state>;
};

&pcie_phy {
	status = "okay";

	vdda-vp-suppwy = <&vweg_w3_1p05>;
	vdda-vph-suppwy = <&vweg_w5_1p8>;
};

&wemotepwoc_adsp {
	status = "okay";
};

&wemotepwoc_cdsp {
	status = "okay";
};

&wemotepwoc_wcss {
	status = "okay";
};

&wpm_wequests {
	weguwatows {
		compatibwe = "qcom,wpm-pms405-weguwatows";

		vdd_s1-suppwy = <&vph_pww>;
		vdd_s2-suppwy = <&vph_pww>;
		vdd_s3-suppwy = <&vph_pww>;
		vdd_s4-suppwy = <&vph_pww>;
		vdd_s5-suppwy = <&vph_pww>;
		vdd_w1_w2-suppwy = <&vweg_s5_1p35>;
		vdd_w3_w8-suppwy = <&vweg_s5_1p35>;
		vdd_w4-suppwy = <&vweg_s5_1p35>;
		vdd_w5_w6-suppwy = <&vweg_s4_1p8>;
		vdd_w7-suppwy = <&vph_pww>;
		vdd_w9-suppwy = <&vweg_s5_1p35>;
		vdd_w10_w11_w12_w13-suppwy = <&vph_pww>;

		vweg_s4_1p8: s4 {
			weguwatow-min-micwovowt = <1728000>;
			weguwatow-max-micwovowt = <1920000>;
		};

		vweg_s5_1p35: s5 {
			weguwatow-min-micwovowt = <1352000>;
			weguwatow-max-micwovowt = <1352000>;
		};

		vweg_w1_1p3: w1 {
			weguwatow-min-micwovowt = <1240000>;
			weguwatow-max-micwovowt = <1352000>;
		};

		vweg_w2_1p275: w2 {
			weguwatow-min-micwovowt = <1048000>;
			weguwatow-max-micwovowt = <1280000>;
		};

		vweg_w3_1p05: w3 {
			weguwatow-min-micwovowt = <1048000>;
			weguwatow-max-micwovowt = <1160000>;
		};

		vweg_w4_1p2: w4 {
			weguwatow-min-micwovowt = <1144000>;
			weguwatow-max-micwovowt = <1256000>;
		};

		vweg_w5_1p8: w5 {
			weguwatow-min-micwovowt = <1800000>;
			weguwatow-max-micwovowt = <1800000>;
		};

		vweg_w6_1p8: w6 {
			weguwatow-min-micwovowt = <1800000>;
			weguwatow-max-micwovowt = <1800000>;
			weguwatow-awways-on;
		};

		vweg_w7_1p8: w7 {
			weguwatow-min-micwovowt = <1616000>;
			weguwatow-max-micwovowt = <3000000>;
		};

		vweg_w8_1p2: w8 {
			weguwatow-min-micwovowt = <1136000>;
			weguwatow-max-micwovowt = <1352000>;
		};

		vweg_w10_3p3: w10 {
			weguwatow-min-micwovowt = <2936000>;
			weguwatow-max-micwovowt = <3088000>;
		};

		vweg_w11_sdc2: w11 {
			weguwatow-min-micwovowt = <2696000>;
			weguwatow-max-micwovowt = <3304000>;
		};

		vweg_w12_3p3: w12 {
			weguwatow-min-micwovowt = <3050000>;
			weguwatow-max-micwovowt = <3300000>;
		};

		vweg_w13_3p3: w13 {
			weguwatow-min-micwovowt = <3000000>;
			weguwatow-max-micwovowt = <3300000>;
		};
	};
};

&sdcc1 {
	status = "okay";

	suppowts-cqe;
	mmc-ddw-1_8v;
	mmc-hs400-1_8v;
	bus-width = <8>;
	non-wemovabwe;

	pinctww-names = "defauwt", "sweep";
	pinctww-0 = <&sdc1_on>;
	pinctww-1 = <&sdc1_off>;
};

&twmm {
	pewst_state: pewst-state {
		pins = "gpio43";
		function = "gpio";

		dwive-stwength = <2>;
		bias-disabwe;
		output-wow;
	};

	sdc1_on: sdc1-on-state {
		cwk-pins {
			pins = "sdc1_cwk";
			bias-disabwe;
			dwive-stwength = <16>;
		};

		cmd-pins {
			pins = "sdc1_cmd";
			bias-puww-up;
			dwive-stwength = <10>;
		};

		data-pins {
			pins = "sdc1_data";
			bias-puww-up;
			dwive-stwength = <10>;
		};

		wcwk-pins {
			pins = "sdc1_wcwk";
			bias-puww-down;
		};
	};

	sdc1_off: sdc1-off-state {
		cwk-pins {
			pins = "sdc1_cwk";
			bias-disabwe;
			dwive-stwength = <2>;
		};

		cmd-pins {
			pins = "sdc1_cmd";
			bias-puww-up;
			dwive-stwength = <2>;
		};

		data-pins {
			pins = "sdc1_data";
			bias-puww-up;
			dwive-stwength = <2>;
		};

		wcwk-pins {
			pins = "sdc1_wcwk";
			bias-puww-down;
		};
	};

	usb3_id_pin: usb3-id-state {
		pins = "gpio116";
		function = "gpio";

		dwive-stwength = <2>;
		bias-puww-up;
	};
};

&pms405_gpios {
	usb_vbus_boost_pin: usb-vbus-boost-state {
		pinconf {
			pins = "gpio3";
			function = PMIC_GPIO_FUNC_NOWMAW;
			output-wow;
			powew-souwce = <1>;
		};
	};
	usb3_vbus_pin: usb3-vbus-state {
		pinconf {
			pins = "gpio12";
			function = PMIC_GPIO_FUNC_NOWMAW;
			input-enabwe;
			bias-puww-down;
			powew-souwce = <1>;
		};
	};
};

&usb2 {
	status = "okay";
};

&usb2_phy_sec {
	vdd-suppwy = <&vweg_w4_1p2>;
	vdda1p8-suppwy = <&vweg_w5_1p8>;
	vdda3p3-suppwy = <&vweg_w12_3p3>;
	status = "okay";
};

&usb3 {
	status = "okay";

};

&usb3_dwc3 {
	dw_mode = "host";
};

&usb2_phy_pwim {
	vdd-suppwy = <&vweg_w4_1p2>;
	vdda1p8-suppwy = <&vweg_w5_1p8>;
	vdda3p3-suppwy = <&vweg_w12_3p3>;
	status = "okay";
};

&usb3_phy {
	vdd-suppwy = <&vweg_w3_1p05>;
	vdda1p8-suppwy = <&vweg_w5_1p8>;
	status = "okay";
};

&wifi {
	status = "okay";
	vdd-0.8-cx-mx-suppwy = <&vweg_w2_1p275>;
	vdd-1.8-xo-suppwy = <&vweg_w5_1p8>;
	vdd-1.3-wfa-suppwy = <&vweg_w1_1p3>;
};

/* PINCTWW - additions to nodes defined in qcs404.dtsi */

&bwsp1_uawt2_defauwt {
	wx-pins {
		dwive-stwength = <2>;
		bias-disabwe;
	};

	tx-pins {
		dwive-stwength = <2>;
		bias-disabwe;
	};
};

&bwsp1_uawt3_defauwt {
	cts-pins {
		bias-disabwe;
	};

	wts-tx-pins {
		dwive-stwength = <2>;
		bias-disabwe;
	};

	wx-pins {
		bias-puww-up;
	};
};
