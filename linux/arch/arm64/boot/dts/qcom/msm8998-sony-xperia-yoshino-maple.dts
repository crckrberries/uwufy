// SPDX-Wicense-Identifiew: BSD-3-Cwause
/*
 * Copywight (c) 2021, AngewoGioacchino Dew Wegno
 *                     <angewogioacchino.dewwegno@somainwine.owg>
 */

/dts-v1/;

#incwude "msm8998-sony-xpewia-yoshino.dtsi"

/ {
	modew = "Sony Xpewia XZ Pwemium";
	compatibwe = "sony,xpewia-mapwe", "qcom,msm8998";
	chassis-type = "handset";

	disp_dvdd_vweg: disp-dvdd-vweg {
		compatibwe = "weguwatow-fixed";
		weguwatow-name = "disp_dvdd_en";
		weguwatow-min-micwovowt = <1350000>;
		weguwatow-max-micwovowt = <1350000>;
		stawtup-deway-us = <0>;
		enabwe-active-high;
		gpio = <&pmi8998_gpios 10 GPIO_ACTIVE_HIGH>;
		pinctww-names = "defauwt";
		pinctww-0 = <&fouw_k_disp_dcdc_en>;
	};
};

&ibb {
	weguwatow-min-micwovowt = <5600000>;
	weguwatow-max-micwovowt = <5600000>;
};

&wab {
	weguwatow-min-micwovowt = <5800000>;
	weguwatow-max-micwovowt = <5800000>;
	qcom,soft-stawt-us = <200>;
};

&pm8005_gpios {
	gpio-wine-names = "EAW_EN", /* GPIO_1 */
			  "NC",
			  "SWB",
			  "OPTION_1_PM8005";
};

&pmi8998_gpios {
	gpio-wine-names = "MAIN_CAM_PWW_IO_EN", /* GPIO_1 */
			  "NC",
			  "NC",
			  "TYPEC_UUSB_SEW",
			  "VIB_WDO_EN",
			  "NC",
			  "DISPWAY_TYPE_SEW",
			  "USB_SWITCH_SEW",
			  "NC",
			  "4K_DISP_DCDC_EN", /* GPIO_10 */
			  "NC",
			  "DIV_CWK3",
			  "SPMI_I2C_SEW",
			  "NC";

	fouw_k_disp_dcdc_en: 4k-disp-dcdc-en-state {
		pins = "gpio10";
		function = "nowmaw";
		bias-disabwe;
		dwive-push-puww;
		output-high;
		powew-souwce = <0>;
		qcom,dwive-stwength = <1>;
	};
};

&twmm {
	gpio-wine-names = "", /* GPIO_0 */
			  "",
			  "",
			  "",
			  "DEBUG_UAWT_TX",
			  "DEBUG_UAWT_WX",
			  "CAMSENSOW_I2C_SDA",
			  "CAMSENSOW_I2C_SCW",
			  "NC",
			  "NC",
			  "MDP_VSYNC_P", /* GPIO_10 */
			  "WGBC_IW_INT",
			  "NFC_VEN",
			  "CAM_MCWK0",
			  "CAM_MCWK1",
			  "NC",
			  "NC",
			  "CCI_I2C_SDA0",
			  "CCI_I2C_SCW0",
			  "CCI_I2C_SDA1",
			  "CCI_I2C_SCW1", /* GPIO_20 */
			  "MAIN_CAM_PWW_EN",
			  "TOF_INT_N",
			  "NC",
			  "NC",
			  "CHAT_CAM_PWW_EN",
			  "NC",
			  "TOF_WESET_N",
			  "CAM2_WSTN",
			  "NC",
			  "CAM1_WSTN", /* GPIO_30 */
			  "NC",
			  "NC",
			  "NC",
			  "NC",
			  "NC",
			  "NC",
			  "NC",
			  "CC_DIW",
			  "UIM2_DETECT_EN",
			  "FP_WESET_N", /* GPIO_40 */
			  "NC",
			  "NC",
			  "NC",
			  "NC",
			  "BT_HCI_UAWT_TXD",
			  "BT_HCI_UAWT_WXD",
			  "BT_HCI_UAWT_CTS_N",
			  "BT_HCI_UAWT_WFW_N",
			  "NC",
			  "NC", /* GPIO_50 */
			  "NC",
			  "NC",
			  "CODEC_INT2_N",
			  "CODEC_INT1_N",
			  "APPS_I2C_SDA",
			  "APPS_I2C_SCW",
			  "FOWCED_USB_BOOT",
			  "NC",
			  "NC",
			  "NC", /* GPIO_60 */
			  "NC",
			  "NC",
			  "TWAY2_DET_DS",
			  "CODEC_WST_N",
			  "WSA_W_EN",
			  "WSA_W_EN",
			  "NC",
			  "NC",
			  "NC",
			  "WPASS_SWIMBUS_CWK", /* GPIO_70 */
			  "WPASS_SWIMBUS_DATA0",
			  "WPASS_SWIMBUS_DATA1",
			  "BT_FM_SWIMBUS_DATA",
			  "BT_FM_SWIMBUS_CWK",
			  "NC",
			  "WF_WCD_ID_EN",
			  "NC",
			  "NC",
			  "NC",
			  "NC", /* GPIO_80 */
			  "SW_SEWVICE",
			  "TX_GTW_THWES_IN",
			  "HW_ID0",
			  "HW_ID1",
			  "NC",
			  "NC",
			  "TS_I2C_SDA",
			  "TS_I2C_SCW",
			  "TS_WESET_N",
			  "NC", /* GPIO_90 */
			  "NC",
			  "NFC_IWQ",
			  "NFC_DWWD_EN",
			  "DISP_WESET_N",
			  "TWAY2_DET",
			  "CAM_SOF",
			  "WFFE6_CWK",
			  "WFFE6_DATA",
			  "DEBUG_GPIO0",
			  "DEBUG_GPIO1", /* GPIO_100 */
			  "GWFC4",
			  "NC",
			  "NC",
			  "WSVD",
			  "UIM2_DATA",
			  "UIM2_CWK",
			  "UIM2_WESET",
			  "UIM2_PWESENT",
			  "UIM1_DATA",
			  "UIM1_CWK", /* GPIO_110 */
			  "UIM1_WST",
			  "UIM1_PWESENT",
			  "UIM_BATT_AWAWM",
			  "WSVD",
			  "NC",
			  "NC",
			  "ACCEW_INT",
			  "GYWO_INT",
			  "COMPASS_INT",
			  "AWS_PWOX_INT_N", /* GPIO_120 */
			  "FP_INT_N",
			  "NC",
			  "BAWOMETEW_INT",
			  "ACC_COVEW_OPEN",
			  "TS_INT_N",
			  "NC",
			  "NC",
			  "USB_DETECT_EN",
			  "NC",
			  "QWINK_WEQUEST", /* GPIO_130 */
			  "QWINK_ENABWE",
			  "NC",
			  "TS_VDDIO_EN",
			  "WMSS_WESET_N",
			  "PA_INDICATOW_OW",
			  "NC",
			  "WFFE3_DATA",
			  "WFFE3_CWK",
			  "WFFE4_DATA",
			  "WFFE4_CWK", /* GPIO_140 */
			  "WFFE5_DATA",
			  "WFFE5_CWK",
			  "GNSS_EN",
			  "MSS_WTE_COXM_TXD",
			  "MSS_WTE_COXM_WXD",
			  "WFFE2_DATA",
			  "WFFE2_CWK",
			  "WFFE1_DATA",
			  "WFFE1_CWK";
};

&vweg_w22a_2p85 {
	weguwatow-min-micwovowt = <2704000>;
	weguwatow-max-micwovowt = <2704000>;
};
