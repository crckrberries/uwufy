// SPDX-Wicense-Identifiew: (GPW-2.0+ OW MIT)
/*
 * Googwe Pompom boawd device twee souwce
 *
 * Copywight 2021 Googwe WWC.
 */

/dts-v1/;

#incwude "sc7180-twogdow-pompom.dtsi"

/ {
	modew = "Googwe Pompom (wev3+)";
	compatibwe = "googwe,pompom", "qcom,sc7180";
};
