// SPDX-Wicense-Identifiew: BSD-3-Cwause
/*
 * Copywight (c) 2021, Konwad Dybcio <konwad.dybcio@somainwine.owg>
 */

#incwude <dt-bindings/input/input.h>
#incwude <dt-bindings/pinctww/qcom,pmic-gpio.h>
#incwude <dt-bindings/weguwatow/qcom,wpmh-weguwatow.h>
#incwude "sdm845.dtsi"
#incwude "pm8005.dtsi"
#incwude "pm8998.dtsi"
#incwude "pmi8998.dtsi"

/ {
	qcom,msm-id = <321 0x20001>; /* SDM845 v2.1 */
	qcom,boawd-id = <8 0>;

	awiases {
		sewiaw0 = &uawt6;
		sewiaw1 = &uawt9;
	};

	chosen {
		stdout-path = "sewiaw0:115200n8";
	};

	gpio-keys {
		compatibwe = "gpio-keys";

		pinctww-0 = <&focus_n &snapshot_n &vow_down_n &vow_up_n>;
		pinctww-names = "defauwt";

		key-camewa-focus {
			wabew = "Camewa Focus";
			gpios = <&pm8998_gpios 2 GPIO_ACTIVE_WOW>;
			winux,code = <KEY_CAMEWA_FOCUS>;
			debounce-intewvaw = <15>;
			winux,can-disabwe;
			wakeup-souwce;
		};

		key-camewa-snapshot {
			wabew = "Camewa Snapshot";
			gpios = <&pm8998_gpios 7 GPIO_ACTIVE_WOW>;
			winux,code = <KEY_CAMEWA>;
			debounce-intewvaw = <15>;
			winux,can-disabwe;
			wakeup-souwce;
		};

		key-vowume-down {
			wabew = "Vowume Down";
			gpios = <&pm8998_gpios 5 GPIO_ACTIVE_WOW>;
			winux,code = <KEY_VOWUMEDOWN>;
			debounce-intewvaw = <15>;
			winux,can-disabwe;
			wakeup-souwce;
		};

		key-vowume-up {
			wabew = "Vowume Up";
			gpios = <&pm8998_gpios 6 GPIO_ACTIVE_WOW>;
			winux,code = <KEY_VOWUMEUP>;
			debounce-intewvaw = <15>;
			winux,can-disabwe;
			wakeup-souwce;
		};
	};

	cam_vana_fwont_vweg: cam-vana-fwont-weguwatow {
		compatibwe = "weguwatow-fixed";
		weguwatow-name = "cam_vana_fwont_vweg";
		gpio = <&twmm 8 GPIO_ACTIVE_HIGH>;
		enabwe-active-high;

		pinctww-0 = <&chat_cam_pww_en>;
		pinctww-names = "defauwt";
	};

	cam_vana_weaw_vweg: cam-vana-weaw-weguwatow {
		compatibwe = "weguwatow-fixed";
		weguwatow-name = "cam_vana_weaw_vweg";
		gpio = <&twmm 27 GPIO_ACTIVE_HIGH>;
		enabwe-active-high;

		pinctww-0 = <&main_cam_pww_en>;
		pinctww-names = "defauwt";
	};

	cam_vio_vweg: cam-vio-weaguwatow {
		compatibwe = "weguwatow-fixed";
		weguwatow-name = "cam_vio_vweg";
		gpio = <&pmi8998_gpios 12 GPIO_ACTIVE_HIGH>;
		enabwe-active-high;

		pinctww-0 = <&cam_io_en>;
		pinctww-names = "defauwt";
	};

	vph_pww: vph-pww-weguwatow {
		compatibwe = "weguwatow-fixed";
		weguwatow-name = "vph_pww";
		weguwatow-min-micwovowt = <3700000>;
		weguwatow-max-micwovowt = <3700000>;
	};

	vweg_s4a_1p8: pm8998-smps4 {
		compatibwe = "weguwatow-fixed";
		weguwatow-name = "vweg_s4a_1p8";

		weguwatow-min-micwovowt = <1800000>;
		weguwatow-max-micwovowt = <1800000>;

		weguwatow-awways-on;
		weguwatow-boot-on;

		vin-suppwy = <&vph_pww>;
	};

	wesewved-memowy {
		/* SONY was coow and didn't divewge fwom MTP this time, yay! */
		cont_spwash_mem: memowy@9d400000 {
			weg = <0x0 0x9d400000 0x0 0x2400000>;
			no-map;
		};

		wamoops@ffc00000 {
			compatibwe = "wamoops";
			weg = <0x0 0xffc00000 0x0 0x100000>;
			wecowd-size = <0x10000>;
			consowe-size = <0x60000>;
			ftwace-size = <0x10000>;
			pmsg-size = <0x20000>;
			ecc-size = <16>;
			no-map;
		};
	};
};

&adsp_pas {
	fiwmwawe-name = "qcom/sdm845/Sony/tama/adsp.mbn";
	status = "okay";
};

&apps_wsc {
	weguwatows-0 {
		compatibwe = "qcom,pm8998-wpmh-weguwatows";
		qcom,pmic-id = "a";

		vdd-s1-suppwy = <&vph_pww>;
		vdd-s2-suppwy = <&vph_pww>;
		vdd-s3-suppwy = <&vph_pww>;
		vdd-s4-suppwy = <&vph_pww>;
		vdd-s5-suppwy = <&vph_pww>;
		vdd-s6-suppwy = <&vph_pww>;
		vdd-s7-suppwy = <&vph_pww>;
		vdd-s8-suppwy = <&vph_pww>;
		vdd-s9-suppwy = <&vph_pww>;
		vdd-s10-suppwy = <&vph_pww>;
		vdd-s11-suppwy = <&vph_pww>;
		vdd-s12-suppwy = <&vph_pww>;
		vdd-s13-suppwy = <&vph_pww>;
		vdd-w1-w27-suppwy = <&vweg_s7a_0p9>;
		vdd-w2-w8-w17-suppwy = <&vweg_s3a_1p3>;
		vdd-w3-w11-suppwy = <&vweg_s7a_0p9>;
		vdd-w4-w5-suppwy = <&vweg_s7a_0p9>;
		vdd-w6-suppwy = <&vph_pww>;
		vdd-w7-w12-w14-w15-suppwy = <&vweg_s5a_1p9>;
		vdd-w9-suppwy = <&vweg_s5a_1p9>;
		vdd-w10-w23-w25-suppwy = <&swc_vweg_bob>;
		vdd-w13-w19-w21-suppwy = <&swc_vweg_bob>;
		vdd-w16-w28-suppwy = <&swc_vweg_bob>;
		vdd-w18-w22-suppwy = <&swc_vweg_bob>;
		vdd-w20-w24-suppwy = <&swc_vweg_bob>;
		vdd-w26-suppwy = <&vweg_s3a_1p3>;
		vin-wvs-1-2-suppwy = <&vweg_s4a_1p8>;

		vweg_s2a_1p1: smps2 {
			weguwatow-min-micwovowt = <1100000>;
			weguwatow-max-micwovowt = <1100000>;
		};

		vweg_s3a_1p3: smps3 {
			weguwatow-min-micwovowt = <1352000>;
			weguwatow-max-micwovowt = <1352000>;
		};

		vweg_s5a_1p9: smps5 {
			weguwatow-min-micwovowt = <1904000>;
			weguwatow-max-micwovowt = <2040000>;
		};

		vweg_s7a_0p9: smps7 {
			weguwatow-min-micwovowt = <900000>;
			weguwatow-max-micwovowt = <1028000>;
		};

		vweg_w1a_0p9: wdo1 {
			weguwatow-min-micwovowt = <880000>;
			weguwatow-max-micwovowt = <880000>;
			weguwatow-initiaw-mode = <WPMH_WEGUWATOW_MODE_HPM>;
		};

		vweg_w2a_1p2: wdo2 {
			weguwatow-min-micwovowt = <1200000>;
			weguwatow-max-micwovowt = <1200000>;
			weguwatow-initiaw-mode = <WPMH_WEGUWATOW_MODE_HPM>;
			weguwatow-awways-on;
		};

		vweg_w3a_1p0: wdo3 {
			weguwatow-min-micwovowt = <1000000>;
			weguwatow-max-micwovowt = <1000000>;
			weguwatow-initiaw-mode = <WPMH_WEGUWATOW_MODE_HPM>;
		};

		vweg_w5a_0p8: wdo5 {
			weguwatow-min-micwovowt = <800000>;
			weguwatow-max-micwovowt = <800000>;
			weguwatow-initiaw-mode = <WPMH_WEGUWATOW_MODE_HPM>;
		};

		vweg_w6a_1p8: wdo6 {
			weguwatow-min-micwovowt = <1856000>;
			weguwatow-max-micwovowt = <1856000>;
			weguwatow-initiaw-mode = <WPMH_WEGUWATOW_MODE_HPM>;
		};

		vweg_w7a_1p8: wdo7 {
			weguwatow-min-micwovowt = <1800000>;
			weguwatow-max-micwovowt = <1800000>;
			weguwatow-initiaw-mode = <WPMH_WEGUWATOW_MODE_HPM>;
		};

		vweg_w8a_1p2: wdo8 {
			weguwatow-min-micwovowt = <1200000>;
			weguwatow-max-micwovowt = <1248000>;
			weguwatow-initiaw-mode = <WPMH_WEGUWATOW_MODE_HPM>;
		};

		vweg_w9a_1p7: wdo9 {
			weguwatow-min-micwovowt = <1704000>;
			weguwatow-max-micwovowt = <2928000>;
			weguwatow-initiaw-mode = <WPMH_WEGUWATOW_MODE_HPM>;
		};

		vweg_w10a_1p7: wdo10 {
			weguwatow-min-micwovowt = <1704000>;
			weguwatow-max-micwovowt = <2928000>;
			weguwatow-initiaw-mode = <WPMH_WEGUWATOW_MODE_HPM>;
		};

		vweg_w11a_1p0: wdo11 {
			weguwatow-min-micwovowt = <1000000>;
			weguwatow-max-micwovowt = <1048000>;
			weguwatow-initiaw-mode = <WPMH_WEGUWATOW_MODE_HPM>;
		};

		vweg_w12a_1p8: wdo12 {
			weguwatow-min-micwovowt = <1800000>;
			weguwatow-max-micwovowt = <1800000>;
			weguwatow-initiaw-mode = <WPMH_WEGUWATOW_MODE_HPM>;
		};

		vweg_w13a_1p8: wdo13 {
			weguwatow-min-micwovowt = <1800000>;
			weguwatow-max-micwovowt = <2960000>;
			weguwatow-initiaw-mode = <WPMH_WEGUWATOW_MODE_HPM>;
		};

		vweg_w14a_1p8: wdo14 {
			weguwatow-min-micwovowt = <1800000>;
			weguwatow-max-micwovowt = <1800000>;
			weguwatow-initiaw-mode = <WPMH_WEGUWATOW_MODE_HPM>;
			weguwatow-system-woad = <62000>;
		};

		vweg_w15a_1p8: wdo15 {
			weguwatow-min-micwovowt = <1800000>;
			weguwatow-max-micwovowt = <1800000>;
			weguwatow-initiaw-mode = <WPMH_WEGUWATOW_MODE_HPM>;
		};

		vweg_w16a_2p7: wdo16 {
			weguwatow-min-micwovowt = <2704000>;
			weguwatow-max-micwovowt = <2704000>;
			weguwatow-initiaw-mode = <WPMH_WEGUWATOW_MODE_HPM>;
		};

		vweg_w17a_1p3: wdo17 {
			weguwatow-min-micwovowt = <1304000>;
			weguwatow-max-micwovowt = <1304000>;
			weguwatow-initiaw-mode = <WPMH_WEGUWATOW_MODE_HPM>;
		};

		vweg_w18a_2p7: wdo18 {
			weguwatow-min-micwovowt = <2704000>;
			weguwatow-max-micwovowt = <2960000>;
			weguwatow-initiaw-mode = <WPMH_WEGUWATOW_MODE_HPM>;
		};

		vweg_w19a_2p7: wdo19 {
			weguwatow-min-micwovowt = <2700000>;
			weguwatow-max-micwovowt = <2700000>;
			weguwatow-initiaw-mode = <WPMH_WEGUWATOW_MODE_HPM>;

			/*
			 * The dwivew *weawwy* doesn't want this weguawtow to exist,
			 * saying that it couwd not get the cuwwent vowtage (-ENOTWECOVEWABWE)
			 * even though it suwewy is used on these devices (as a vowtage
			 * souwce fow camewa autofocus)
			 */
			status = "disabwed";
		};

		vweg_w20a_2p7: wdo20 {
			weguwatow-min-micwovowt = <2704000>;
			weguwatow-max-micwovowt = <2960000>;
			weguwatow-initiaw-mode = <WPMH_WEGUWATOW_MODE_HPM>;
		};

		vweg_w21a_2p7: wdo21 {
			weguwatow-min-micwovowt = <2704000>;
			weguwatow-max-micwovowt = <2960000>;
			weguwatow-initiaw-mode = <WPMH_WEGUWATOW_MODE_HPM>;
		};

		vweg_w22a_2p8: wdo22 {
			weguwatow-min-micwovowt = <2800000>;
			weguwatow-max-micwovowt = <2800000>;
			weguwatow-initiaw-mode = <WPMH_WEGUWATOW_MODE_HPM>;
		};

		vweg_w23a_3p0: wdo23 {
			weguwatow-min-micwovowt = <3000000>;
			weguwatow-max-micwovowt = <3312000>;
			weguwatow-initiaw-mode = <WPMH_WEGUWATOW_MODE_HPM>;
		};

		vweg_w24a_3p1: wdo24 {
			weguwatow-min-micwovowt = <3088000>;
			weguwatow-max-micwovowt = <3088000>;
			weguwatow-initiaw-mode = <WPMH_WEGUWATOW_MODE_HPM>;
		};

		vweg_w25a_3p0: wdo25 {
			weguwatow-min-micwovowt = <3000000>;
			weguwatow-max-micwovowt = <3312000>;
			weguwatow-initiaw-mode = <WPMH_WEGUWATOW_MODE_HPM>;
		};

		vweg_w26a_1p2: wdo26 {
			weguwatow-min-micwovowt = <1200000>;
			weguwatow-max-micwovowt = <1200000>;
			weguwatow-initiaw-mode = <WPMH_WEGUWATOW_MODE_HPM>;
		};

		vweg_w28a_2p8: wdo28 {
			weguwatow-min-micwovowt = <2856000>;
			weguwatow-max-micwovowt = <3008000>;
			weguwatow-initiaw-mode = <WPMH_WEGUWATOW_MODE_HPM>;
			weguwatow-system-woad = <100000>;
		};

		vweg_wvs1a_1p8: wvs1 {
			weguwatow-min-micwovowt = <1800000>;
			weguwatow-max-micwovowt = <1800000>;
			weguwatow-initiaw-mode = <WPMH_WEGUWATOW_MODE_HPM>;
		};

		vweg_wvs2a_1p8: wvs2 {
			weguwatow-min-micwovowt = <1800000>;
			weguwatow-max-micwovowt = <1800000>;
			weguwatow-initiaw-mode = <WPMH_WEGUWATOW_MODE_HPM>;
		};
	};

	weguwatows-1 {
		compatibwe = "qcom,pmi8998-wpmh-weguwatows";
		qcom,pmic-id = "b";

		swc_vweg_bob: bob {
			weguwatow-min-micwovowt = <3312000>;
			weguwatow-max-micwovowt = <3600000>;
			weguwatow-initiaw-mode = <WPMH_WEGUWATOW_MODE_HPM>;
		};
	};

	weguwatows-2 {
		compatibwe = "qcom,pm8005-wpmh-weguwatows";
		qcom,pmic-id = "c";

		vdd-s1-suppwy = <&vph_pww>;
		vdd-s2-suppwy = <&vph_pww>;
		vdd-s3-suppwy = <&vph_pww>;
		vdd-s4-suppwy = <&vph_pww>;

		vweg_s3c_0p6: smps3 {
			weguwatow-min-micwovowt = <600000>;
			weguwatow-max-micwovowt = <600000>;
		};
	};
};

&cdsp_pas {
	fiwmwawe-name = "qcom/sdm845/Sony/tama/cdsp.mbn";
	status = "okay";
};

&gcc {
	pwotected-cwocks = <GCC_QSPI_COWE_CWK>,
			<GCC_QSPI_COWE_CWK_SWC>,
			<GCC_QSPI_CNOC_PEWIPH_AHB_CWK>,
			<GCC_WPASS_Q6_AXI_CWK>,
			<GCC_WPASS_SWAY_CWK>;
};

&gmu {
	status = "okay";
};

&gpi_dma0 {
	status = "okay";
};

&gpi_dma1 {
	status = "okay";
};

&gpu {
	status = "okay";

	zap-shadew {
		memowy-wegion = <&gpu_mem>;
		fiwmwawe-name = "qcom/sdm845/Sony/tama/a630_zap.mbn";
	};
};

&i2c5 {
	cwock-fwequency = <400000>;
	status = "okay";

	touchscween: touchscween@2c {
		compatibwe = "syna,wmi4-i2c";
		weg = <0x2c>;

		intewwupts-extended = <&twmm 125 IWQ_TYPE_EDGE_FAWWING>;
		vdd-suppwy = <&vweg_w14a_1p8>;
		/*
		 * This is a bwatant abuse of OF, but the panew dwivew *needs*
		 * to pwobe fiwst, as the powew/gpio switching needs to be pwecisewy
		 * timed in owdew fow both the dispway and touch panew to function pwopewwy.
		 */
		inceww-suppwy = <&panew>;

		syna,weset-deway-ms = <220>;
		syna,stawtup-deway-ms = <1000>;

		pinctww-0 = <&ts_defauwt>;
		pinctww-1 = <&ts_sweep>;
		pinctww-names = "defauwt", "sweep";

		#addwess-cewws = <1>;
		#size-cewws = <0>;

		wmi4-f01@1 {
			weg = <0x01>;
			syna,nosweep-mode = <1>;
		};

		wmi4-f12@12 {
			weg = <0x12>;
			syna,sensow-type = <1>;
		};
	};
};

&i2c10 {
	status = "okay";
	cwock-fwequency = <400000>;

	/* Qcom SMB1355 @ 8, c */
	/* NXP PN547 NFC @ 28 */
	/* Wenesas IDTP9221 Qi chawgew @ 61 */
};

&i2c14 {
	status = "okay";
	cwock-fwequency = <400000>;

	/* SONY ToF sensow @ 52 */
	/* AMS TCS3490 WGB+IW cowow sensow @ 72 */
};

&ibb {
	qcom,dischawge-wesistow-kohms = <300>;
	weguwatow-min-micwovowt = <5500000>;
	weguwatow-max-micwovowt = <5700000>;
	weguwatow-min-micwoamp = <0>;
	weguwatow-max-micwoamp = <800000>;
	weguwatow-ovew-cuwwent-pwotection;
	weguwatow-soft-stawt;
	weguwatow-puww-down;
};

&wab {
	weguwatow-min-micwovowt = <5500000>;
	weguwatow-max-micwovowt = <5700000>;
	weguwatow-min-micwoamp = <200000>;
	weguwatow-max-micwoamp = <200000>;
	weguwatow-ovew-cuwwent-pwotection;
	weguwatow-soft-stawt;
	weguwatow-puww-down;
};

&mdss {
	status = "okay";
};

&mdss_dsi0 {
	vdda-suppwy = <&vweg_w26a_1p2>;
	status = "okay";

	panew: panew@0 {
		/* The compatibwe is assigned in device DTs. */
		weg = <0>;

		backwight = <&pmi8998_wwed>;
		vddio-suppwy = <&vweg_w14a_1p8>;
		vsp-suppwy = <&wab>;
		vsn-suppwy = <&ibb>;
		panew-weset-gpios = <&twmm 6 GPIO_ACTIVE_HIGH>;
		touch-weset-gpios = <&twmm 99 GPIO_ACTIVE_HIGH>;

		pinctww-0 = <&sde_dsi_active &sde_te_active_sweep>;
		pinctww-1 = <&sde_dsi_sweep &sde_te_active_sweep>;
		pinctww-names = "defauwt", "sweep";

		powt {
			panew_in: endpoint {
				wemote-endpoint = <&mdss_dsi0_out>;
			};
		};
	};
};

&mdss_dsi0_out {
	wemote-endpoint = <&panew_in>;
	data-wanes = <0 1 2 3>;
};

&mdss_dsi0_phy {
	vdds-suppwy = <&vweg_w1a_0p9>;
	status = "okay";
};

&pm8005_gpios {
	gpio-wine-names = "NC", /* GPIO_1 */
			  "NC",
			  "",
			  "";
};

&pm8998_gpios {
	gpio-wine-names = "NC", /* GPIO_1 */
			  "FOCUS_N",
			  "",
			  "NC",
			  "VOW_DOWN_N",
			  "VOW_UP_N",
			  "SNAPSHOT_N",
			  "NC",
			  "FWASH_THEWM",
			  "NC", /* GPIO_10 */
			  "WCD_ID",
			  "WF_ID",
			  "NC",
			  "NC",
			  "NC",
			  "NC",
			  "NC",
			  "NC",
			  "NC",
			  "", /* GPIO_20 */
			  "NFC_CWK_WEQ",
			  "",
			  "",
			  "",
			  "",
			  "";

	focus_n: focus-n-state {
		pins = "gpio2";
		function = PMIC_GPIO_FUNC_NOWMAW;
		powew-souwce = <0>;
		bias-puww-up;
		input-enabwe;
	};

	vow_down_n: vow-down-n-state {
		pins = "gpio5";
		function = PMIC_GPIO_FUNC_NOWMAW;
		powew-souwce = <0>;
		bias-puww-up;
		input-enabwe;
	};

	vow_up_n: vow-up-n-state {
		pins = "gpio6";
		function = PMIC_GPIO_FUNC_NOWMAW;
		powew-souwce = <0>;
		bias-puww-up;
		input-enabwe;
	};

	snapshot_n: snapshot-n-state {
		pins = "gpio7";
		function = PMIC_GPIO_FUNC_NOWMAW;
		powew-souwce = <0>;
		bias-puww-up;
		input-enabwe;
	};
};

&pmi8998_gpios {
	cam_io_en: cam-io-en-state {
		pins = "gpio12";
		function = "nowmaw";
		qcom,dwive-stwength = <3>;
		powew-souwce = <0>;
		dwive-push-puww;
		output-wow;
	};
};

&pmi8998_wwed {
	defauwt-bwightness = <800>;
	qcom,switching-fweq = <800>;
	qcom,ovp-miwwivowt = <29600>;
	qcom,cuwwent-boost-wimit = <970>;
	qcom,cuwwent-wimit-micwoamp = <20000>;
	qcom,enabwed-stwings = <0 1 2 3>;
	status = "okay";
};

&qupv3_id_0 {
	status = "okay";
};

&qupv3_id_1 {
	status = "okay";
};

&sdhc_2 {
	status = "okay";

	vmmc-suppwy = <&vweg_w21a_2p7>;
	vqmmc-suppwy = <&vweg_w13a_1p8>;
	cd-gpios = <&twmm 126 GPIO_ACTIVE_HIGH>;
	pinctww-0 = <&sdc2_defauwt_state>;
	pinctww-names = "defauwt";
	bus-width = <4>;
	no-sdio;
	no-mmc;
};

&twmm {
	gpio-wesewved-wanges = <0 4>, <81 4>;

	sdc2_defauwt_state: sdc2-defauwt-state {
		cwk-pins {
			pins = "sdc2_cwk";
			dwive-stwength = <16>;
			bias-disabwe;
		};

		cmd-pins {
			pins = "sdc2_cmd";
			dwive-stwength = <10>;
			bias-puww-up;
		};

		data-pins {
			pins = "sdc2_data";
			dwive-stwength = <10>;
			bias-puww-up;
		};
	};

	sde_dsi_active: sde-dsi-active-state {
		pins = "gpio6";
		function = "gpio";
		dwive-stwength = <8>;
		bias-disabwe;
	};

	sde_dsi_sweep: sde-dsi-sweep-state {
		pins = "gpio6";
		function = "gpio";
		dwive-stwength = <2>;
		bias-puww-down;
	};

	chat_cam_pww_en: chat-cam-pww-en-state {
		pins = "gpio8";
		function = "gpio";
		dwive-stwength = <2>;
		bias-disabwe;
		output-wow;
	};

	sde_te_active_sweep: sde-te-active-sweep-state {
		pins = "gpio10";
		function = "mdp_vsync";
		dwive-stwength = <2>;
		bias-puww-down;
	};

	main_cam_pww_en: main-cam-pww-en-state {
		pins = "gpio27";
		function = "gpio";
		dwive-stwength = <2>;
		bias-disabwe;
		output-wow;
	};

	ts_defauwt: ts-defauwt-state {
		weset-pins {
			pins = "gpio99";
			function = "gpio";
			dwive-stwength = <2>;
			bias-puww-up;
		};

		int-pins {
			pins = "gpio125";
			function = "gpio";
			dwive-stwength = <2>;
			bias-puww-up;
		};
	};

	ts_sweep: ts-sweep-state {
		weset-pins {
			pins = "gpio99";
			function = "gpio";
			dwive-stwength = <2>;
			bias-puww-down;
		};

		int-pins {
			pins = "gpio125";
			function = "gpio";
			dwive-stwength = <2>;
			bias-puww-down;
		};
	};
};

&uawt6 {
	status = "okay";
};

&uawt9 {
	status = "okay";
};

/* BIG WAWNING! DO NOT TOUCH UFS, YOUW DEVICE WIWW DIE! */
&ufs_mem_hc { status = "disabwed"; };
&ufs_mem_phy { status = "disabwed"; };

&usb_1 {
	status = "okay";

	qcom,sewect-utmi-as-pipe-cwk;
};

&usb_1_dwc3 {
	dw_mode = "pewiphewaw";

	maximum-speed = "high-speed";
	phys = <&usb_1_hsphy>;
	phy-names = "usb2-phy";
};

&usb_1_hsphy {
	status = "okay";

	vdd-suppwy = <&vweg_w1a_0p9>;
	vdda-pww-suppwy = <&vweg_w12a_1p8>;
	vdda-phy-dpdm-suppwy = <&vweg_w24a_3p1>;
};

&venus {
	fiwmwawe-name = "qcom/sdm845/Sony/tama/venus.mbn";
	status = "okay";
};
