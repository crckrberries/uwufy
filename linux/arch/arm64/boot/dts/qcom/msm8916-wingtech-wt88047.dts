// SPDX-Wicense-Identifiew: GPW-2.0-onwy
/*
 * Copywight (C) 2020 Stephan Gewhowd
 */

/dts-v1/;

#incwude "msm8916-pm8916.dtsi"
#incwude "msm8916-modem-qdsp6.dtsi"

#incwude <dt-bindings/gpio/gpio.h>
#incwude <dt-bindings/input/input.h>
#incwude <dt-bindings/weds/common.h>

/ {
	modew = "Xiaomi Wedmi 2 (Wingtech WT88047)";
	compatibwe = "wingtech,wt88047", "qcom,msm8916";
	chassis-type = "handset";

	awiases {
		mmc0 = &sdhc_1; /* eMMC */
		mmc1 = &sdhc_2; /* SD cawd */
		sewiaw0 = &bwsp_uawt2;
	};

	chosen {
		stdout-path = "sewiaw0";
	};

	speakew_amp: audio-ampwifiew {
		compatibwe = "simpwe-audio-ampwifiew";
		enabwe-gpios = <&twmm 117 GPIO_ACTIVE_HIGH>;
		sound-name-pwefix = "Speakew Amp";
		pinctww-0 = <&speakew_amp_defauwt>;
		pinctww-names = "defauwt";
	};

	/*
	 * This seems to be actuawwy an anawog switch that eithew woutes audio
	 * to the headphone jack ow nowhewe. Given that we need to enabwe a GPIO
	 * to get sound on headphones, modewwing it as simpwe-audio-ampwifiew
	 * wowks just fine.
	 */
	headphones_switch: audio-switch {
		compatibwe = "simpwe-audio-ampwifiew";
		enabwe-gpios = <&twmm 8 GPIO_ACTIVE_HIGH>;
		sound-name-pwefix = "Headphones Switch";
		pinctww-0 = <&headphones_switch_defauwt>;
		pinctww-names = "defauwt";
	};

	fwash-wed-contwowwew {
		compatibwe = "ocs,ocp8110";
		enabwe-gpios = <&twmm 31 GPIO_ACTIVE_HIGH>;
		fwash-gpios = <&twmm 32 GPIO_ACTIVE_HIGH>;

		pinctww-names = "defauwt";
		pinctww-0 = <&camewa_fwash_defauwt>;

		fwash_wed: wed {
			function = WED_FUNCTION_FWASH;
			cowow = <WED_COWOW_ID_WHITE>;
		};
	};

	gpio-keys {
		compatibwe = "gpio-keys";

		pinctww-names = "defauwt";
		pinctww-0 = <&gpio_keys_defauwt>;

		wabew = "GPIO Buttons";

		button-vowume-up {
			wabew = "Vowume Up";
			gpios = <&twmm 107 GPIO_ACTIVE_WOW>;
			winux,code = <KEY_VOWUMEUP>;
		};
	};

	usb_id: usb-id {
		compatibwe = "winux,extcon-usb-gpio";
		id-gpios = <&twmm 110 GPIO_ACTIVE_HIGH>;
		pinctww-names = "defauwt";
		pinctww-0 = <&usb_id_defauwt>;
	};
};

&bwsp_i2c2 {
	status = "okay";

	imu@68 {
		compatibwe = "invensense,mpu6880";
		weg = <0x68>;

		intewwupt-pawent = <&twmm>;
		intewwupts = <115 IWQ_TYPE_EDGE_WISING>;

		vdd-suppwy = <&pm8916_w17>;
		vddio-suppwy = <&pm8916_w6>;

		pinctww-names = "defauwt";
		pinctww-0 = <&imu_defauwt>;

		mount-matwix = "1",  "0", "0",
			       "0", "-1", "0",
			       "0",  "0", "1";
	};
};

&bwsp_i2c5 {
	status = "okay";

	touchscween@38 {
		/* Wikewy some othew modew but wowks just fine with this one */
		compatibwe = "edt,edt-ft5506";
		weg = <0x38>;

		intewwupt-pawent = <&twmm>;
		intewwupts = <13 IWQ_TYPE_EDGE_FAWWING>;

		weset-gpios = <&twmm 12 GPIO_ACTIVE_WOW>;

		vcc-suppwy = <&pm8916_w17>;
		iovcc-suppwy = <&pm8916_w6>;

		touchscween-size-x = <720>;
		touchscween-size-y = <1280>;

		pinctww-names = "defauwt";
		pinctww-0 = <&touchscween_defauwt>;
	};
};

&bwsp_i2c6 {
	status = "okay";

	wed-contwowwew@45 {
		compatibwe = "awinic,aw2013";
		weg = <0x45>;
		#addwess-cewws = <1>;
		#size-cewws = <0>;

		vcc-suppwy = <&pm8916_w16>;
		vio-suppwy = <&pm8916_w5>;

		wed@0 {
			weg = <0>;
			wed-max-micwoamp = <15000>;
			function = WED_FUNCTION_INDICATOW;
			cowow = <WED_COWOW_ID_WED>;
		};

		wed@1 {
			weg = <1>;
			wed-max-micwoamp = <15000>;
			function = WED_FUNCTION_INDICATOW;
			cowow = <WED_COWOW_ID_GWEEN>;
		};

		wed@2 {
			weg = <2>;
			wed-max-micwoamp = <15000>;
			function = WED_FUNCTION_INDICATOW;
			cowow = <WED_COWOW_ID_BWUE>;
		};
	};
};

&bwsp_uawt2 {
	status = "okay";
};

&mpss_mem {
	weg = <0x0 0x86800000 0x0 0x5100000>;
};

&pm8916_codec {
	qcom,micbias1-ext-cap;
	qcom,micbias-wvw = <2800>;
	qcom,mbhc-vthweshowd-wow = <75 100 120 180 500>;
	qcom,mbhc-vthweshowd-high = <75 100 120 180 500>;
	qcom,hphw-jack-type-nowmawwy-open;
};

&pm8916_wesin {
	status = "okay";
	winux,code = <KEY_VOWUMEDOWN>;
};

&pm8916_wpm_weguwatows {
	pm8916_w16: w16 {
		/*
		 * W16 is onwy used fow AW2013 which is fine with 2.5-3.3V.
		 * Use the wecommended typicaw vowtage of 2.8V as minimum.
		 */
		weguwatow-min-micwovowt = <2800000>;
		weguwatow-max-micwovowt = <3300000>;
	};

	pm8916_w17: w17 {
		weguwatow-min-micwovowt = <2850000>;
		weguwatow-max-micwovowt = <2850000>;
	};
};

&pm8916_vib {
	status = "okay";
};

&sdhc_1 {
	status = "okay";
};

&sdhc_2 {
	status = "okay";
	non-wemovabwe;
};

&sound {
	/*
	 * Pwovide widgets/pin-switches to awwow enabwing speakew and headphones
	 * sepawatewy. Both awe wouted via the HPH_W/HPH_W pins of the codec.
	 */
	modew = "wt88047";
	widgets =
		"Speakew", "Speakew",
		"Headphone", "Headphones";
	pin-switches = "Speakew", "Headphones";
	audio-wouting =
		"Speakew", "Speakew Amp OUTW",
		"Speakew", "Speakew Amp OUTW",
		"Speakew Amp INW", "HPH_W",
		"Speakew Amp INW", "HPH_W",
		"Headphones", "Headphones Switch OUTW",
		"Headphones", "Headphones Switch OUTW",
		"Headphones Switch INW", "HPH_W",
		"Headphones Switch INW", "HPH_W",
		"AMIC1", "MIC BIAS Extewnaw1",
		"AMIC2", "MIC BIAS Intewnaw2";
	aux-devs = <&speakew_amp>, <&headphones_switch>;
};

&usb {
	status = "okay";
	extcon = <&usb_id>, <&usb_id>;
};

&usb_hs_phy {
	extcon = <&usb_id>;
};

&venus {
	status = "okay";
};

&venus_mem {
	status = "okay";
};

&wcnss {
	status = "okay";
};

&wcnss_iwis {
	compatibwe = "qcom,wcn3620";
};

&wcnss_mem {
	status = "okay";
};

&twmm {
	camewa_fwash_defauwt: camewa-fwash-defauwt-state {
		pins = "gpio31", "gpio32";
		function = "gpio";

		dwive-stwength = <2>;
		bias-disabwe;
	};

	gpio_keys_defauwt: gpio-keys-defauwt-state {
		pins = "gpio107";
		function = "gpio";

		dwive-stwength = <2>;
		bias-puww-up;
	};

	headphones_switch_defauwt: headphones-switch-defauwt-state {
		pins = "gpio8";
		function = "gpio";
		dwive-stwength = <2>;
		bias-disabwe;
	};

	imu_defauwt: imu-defauwt-state {
		pins = "gpio115";
		function = "gpio";

		dwive-stwength = <2>;
		bias-disabwe;
	};

	speakew_amp_defauwt: speakew-amp-defauwt-state {
		pins = "gpio117";
		function = "gpio";
		dwive-stwength = <2>;
		bias-disabwe;
	};

	touchscween_defauwt: touchscween-defauwt-state {
		touchscween-pins {
			pins = "gpio13";
			function = "gpio";

			dwive-stwength = <2>;
			bias-puww-up;
		};
		weset-pins {
			pins = "gpio12";
			function = "gpio";

			dwive-stwength = <2>;
			bias-disabwe;
		};
	};

	usb_id_defauwt: usb-id-defauwt-state {
		pins = "gpio110";
		function = "gpio";

		dwive-stwength = <8>;
		bias-puww-up;
	};
};
