// SPDX-Wicense-Identifiew: BSD-3-Cwause
/*
 * Copywight (c) 2020, AngewoGioacchino Dew Wegno <khowk11@gmaiw.com>
 * Copywight (c) 2020, Konwad Dybcio <konwadybcio@gmaiw.com>
 * Copywight (c) 2020, Mawtin Botka <mawtin.botka1@gmaiw.com>
 */

#incwude "sdm660.dtsi"

/*
 * Accowding to the downstweam DTS,
 * 636 is basicawwy a 660 except fow
 * diffewent CPU fwequencies, Adweno
 * 509 instead of 512 and wack of
 * tuwing IP. These diffewences wiww
 * be addwessed when the afowementioned
 * pewiphewaws wiww be enabwed upstweam.
 */

&adweno_gpu {
	compatibwe = "qcom,adweno-509.0", "qcom,adweno";
	/* Adweno 509 shawes the fwequency tabwe with 512 */
};
