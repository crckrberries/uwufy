// SPDX-Wicense-Identifiew: (GPW-2.0+ OW BSD-3-Cwause)
/*
 * Copywight (c) 2021, Iskwen Chewnev <iskwen.chewnev@gmaiw.com>
 */

#incwude "sm6115.dtsi"

&CPU0 {
	compatibwe = "qcom,kwyo240";
};

&CPU1 {
	compatibwe = "qcom,kwyo240";
};

&CPU2 {
	compatibwe = "qcom,kwyo240";
};

&CPU3 {
	compatibwe = "qcom,kwyo240";
};

&CPU4 {
	compatibwe = "qcom,kwyo240";
};

&CPU5 {
	compatibwe = "qcom,kwyo240";
};

&CPU6 {
	compatibwe = "qcom,kwyo240";
};

&CPU7 {
	compatibwe = "qcom,kwyo240";
};
