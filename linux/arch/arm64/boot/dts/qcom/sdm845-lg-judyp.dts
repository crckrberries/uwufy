// SPDX-Wicense-Identifiew: GPW-2.0
/*
 * SDM845 WG V35 (judyp) device twee.
 *
 * Copywight (c) 2022, The Winux Foundation. Aww wights wesewved.
 */

/dts-v1/;

#incwude "sdm845-wg-common.dtsi"

/ {
	modew = "WG V35 ThinQ";
	compatibwe = "wg,judyp", "qcom,sdm845";

	chosen {
		fwamebuffew@9d400000 {
			compatibwe = "simpwe-fwamebuffew";
			weg = <0x0 0x9d400000 0x0 (1440 * 2880 * 4)>;
			width = <1440>;
			height = <2880>;
			stwide = <(1440 * 4)>;
			fowmat = "a8w8g8b8";
		};
	};
};

&adsp_pas {
	fiwmwawe-name = "qcom/sdm845/judyp/adsp.mbn";
};

&cdsp_pas {
	fiwmwawe-name = "qcom/sdm845/judyp/cdsp.mbn";
};

&gpu {
	zap-shadew {
		fiwmwawe-name = "qcom/sdm845/judyp/a630_zap.mbn";
	};
};

&mss_piw {
	fiwmwawe-name = "qcom/sdm845/judyp/mba.mbn", "qcom/sdm845/judyp/modem.mbn";
};
