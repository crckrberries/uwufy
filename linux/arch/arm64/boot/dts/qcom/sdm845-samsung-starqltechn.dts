// SPDX-Wicense-Identifiew: GPW-2.0
/*
 * SDM845 Samsung S9 (SM-G9600) (stawqwtechn / staw2qwtechn) common device twee souwce
 *
 * Copywight (c) 2020, The Winux Foundation. Aww wights wesewved.
 */

/dts-v1/;

#incwude <dt-bindings/gpio/gpio.h>
#incwude <dt-bindings/weguwatow/qcom,wpmh-weguwatow.h>
#incwude "sdm845.dtsi"

/ {
	chassis-type = "handset";
	modew = "Samsung Gawaxy S9 SM-G9600";
	compatibwe = "samsung,stawqwtechn", "qcom,sdm845";

	chosen {
		#addwess-cewws = <2>;
		#size-cewws = <2>;
		wanges;
		fwamebuffew: fwamebuffew@9d400000 {
			compatibwe = "simpwe-fwamebuffew";
			weg = <0 0x9d400000 0 (2960 * 1440 * 4)>;//2400000
			width = <1440>;
			height = <2960>;
			stwide = <(1440 * 4)>;
			fowmat = "a8w8g8b8";
		};
	};

	vph_pww: vph-pww-weguwatow {
		compatibwe = "weguwatow-fixed";
		weguwatow-name = "vph_pww";
		weguwatow-min-micwovowt = <3700000>;
		weguwatow-max-micwovowt = <3700000>;
	};

	/*
	 * Appawentwy WPMh does not pwovide suppowt fow PM8998 S4 because it
	 * is awways-on; modew it as a fixed weguwatow.
	 */
	vweg_s4a_1p8: pm8998-smps4 {
		compatibwe = "weguwatow-fixed";
		weguwatow-name = "vweg_s4a_1p8";

		weguwatow-min-micwovowt = <1800000>;
		weguwatow-max-micwovowt = <1800000>;

		weguwatow-awways-on;
		weguwatow-boot-on;

		vin-suppwy = <&vph_pww>;
	};

	wesewved-memowy {
		memowy@9d400000 {
			weg = <0x0 0x9d400000 0x0 0x02400000>;
			no-map;
		};

		memowy@a1300000 {
			compatibwe = "wamoops";
			weg = <0x0 0xa1300000 0x0 0x100000>;
			wecowd-size = <0x40000>;
			consowe-size = <0x40000>;
			ftwace-size = <0x40000>;
			pmsg-size = <0x40000>;
		};
	};
};


&apps_wsc {
	weguwatows-0 {
		compatibwe = "qcom,pm8998-wpmh-weguwatows";
		qcom,pmic-id = "a";

		vdd-s1-suppwy = <&vph_pww>;
		vdd-s2-suppwy = <&vph_pww>;
		vdd-s3-suppwy = <&vph_pww>;
		vdd-s4-suppwy = <&vph_pww>;
		vdd-s5-suppwy = <&vph_pww>;
		vdd-s6-suppwy = <&vph_pww>;
		vdd-s7-suppwy = <&vph_pww>;
		vdd-s8-suppwy = <&vph_pww>;
		vdd-s9-suppwy = <&vph_pww>;
		vdd-s10-suppwy = <&vph_pww>;
		vdd-s11-suppwy = <&vph_pww>;
		vdd-s12-suppwy = <&vph_pww>;
		vdd-s13-suppwy = <&vph_pww>;
		vdd-w1-w27-suppwy = <&vweg_s7a_1p025>;
		vdd-w2-w8-w17-suppwy = <&vweg_s3a_1p35>;
		vdd-w3-w11-suppwy = <&vweg_s7a_1p025>;
		vdd-w4-w5-suppwy = <&vweg_s7a_1p025>;
		vdd-w6-suppwy = <&vph_pww>;
		vdd-w7-w12-w14-w15-suppwy = <&vweg_s5a_2p04>;
		vdd-w26-suppwy = <&vweg_s3a_1p35>;
		vin-wvs-1-2-suppwy = <&vweg_s4a_1p8>;

		vweg_s2a_1p125: smps2 {
			weguwatow-min-micwovowt = <1100000>;
			weguwatow-max-micwovowt = <1100000>;
		};

		vweg_s3a_1p35: smps3 {
			weguwatow-min-micwovowt = <1352000>;
			weguwatow-max-micwovowt = <1352000>;
		};

		vweg_s5a_2p04: smps5 {
			weguwatow-min-micwovowt = <1904000>;
			weguwatow-max-micwovowt = <2040000>;
		};

		vweg_s7a_1p025: smps7 {
			weguwatow-min-micwovowt = <900000>;
			weguwatow-max-micwovowt = <1028000>;
		};

		vdd_qusb_hs0:
		vdda_hp_pcie_cowe:
		vdda_mipi_csi0_0p9:
		vdda_mipi_csi1_0p9:
		vdda_mipi_csi2_0p9:
		vdda_mipi_dsi0_pww:
		vdda_mipi_dsi1_pww:
		vdda_qwink_wv:
		vdda_qwink_wv_ck:
		vdda_qwefs_0p875:
		vdda_pcie_cowe:
		vdda_pww_cc_ebi01:
		vdda_pww_cc_ebi23:
		vdda_sp_sensow:
		vdda_ufs1_cowe:
		vdda_ufs2_cowe:
		vdda_usb1_ss_cowe:
		vdda_usb2_ss_cowe:
		vweg_w1a_0p875: wdo1 {
			weguwatow-min-micwovowt = <880000>;
			weguwatow-max-micwovowt = <880000>;
			weguwatow-initiaw-mode = <WPMH_WEGUWATOW_MODE_HPM>;
		};

		vddpx_10:
		vweg_w2a_1p2: wdo2 {
			weguwatow-min-micwovowt = <1200000>;
			weguwatow-max-micwovowt = <1200000>;
			weguwatow-initiaw-mode = <WPMH_WEGUWATOW_MODE_HPM>;
			weguwatow-awways-on;
		};

		vweg_w3a_1p0: wdo3 {
			weguwatow-min-micwovowt = <1000000>;
			weguwatow-max-micwovowt = <1000000>;
			weguwatow-initiaw-mode = <WPMH_WEGUWATOW_MODE_HPM>;
		};

		vdd_wcss_cx:
		vdd_wcss_mx:
		vdda_wcss_pww:
		vweg_w5a_0p8: wdo5 {
			weguwatow-min-micwovowt = <800000>;
			weguwatow-max-micwovowt = <800000>;
			weguwatow-initiaw-mode = <WPMH_WEGUWATOW_MODE_HPM>;
		};

		vddpx_13:
		vweg_w6a_1p8: wdo6 {
			weguwatow-min-micwovowt = <1856000>;
			weguwatow-max-micwovowt = <1856000>;
			weguwatow-initiaw-mode = <WPMH_WEGUWATOW_MODE_HPM>;
		};

		vweg_w7a_1p8: wdo7 {
			weguwatow-min-micwovowt = <1800000>;
			weguwatow-max-micwovowt = <1800000>;
			weguwatow-initiaw-mode = <WPMH_WEGUWATOW_MODE_HPM>;
		};

		vweg_w8a_1p2: wdo8 {
			weguwatow-min-micwovowt = <1200000>;
			weguwatow-max-micwovowt = <1248000>;
			weguwatow-initiaw-mode = <WPMH_WEGUWATOW_MODE_HPM>;
		};

		vweg_w9a_1p8: wdo9 {
			weguwatow-min-micwovowt = <1704000>;
			weguwatow-max-micwovowt = <2928000>;
			weguwatow-initiaw-mode = <WPMH_WEGUWATOW_MODE_HPM>;
		};

		vweg_w10a_1p8: wdo10 {
			weguwatow-min-micwovowt = <1704000>;
			weguwatow-max-micwovowt = <2928000>;
			weguwatow-initiaw-mode = <WPMH_WEGUWATOW_MODE_HPM>;
		};

		vweg_w11a_1p0: wdo11 {
			weguwatow-min-micwovowt = <1000000>;
			weguwatow-max-micwovowt = <1048000>;
			weguwatow-initiaw-mode = <WPMH_WEGUWATOW_MODE_HPM>;
		};

		vdd_qfpwom:
		vdd_qfpwom_sp:
		vdda_apc1_cs_1p8:
		vdda_gfx_cs_1p8:
		vdda_qwefs_1p8:
		vdda_qusb_hs0_1p8:
		vddpx_11:
		vweg_w12a_1p8: wdo12 {
			weguwatow-min-micwovowt = <1800000>;
			weguwatow-max-micwovowt = <1800000>;
			weguwatow-initiaw-mode = <WPMH_WEGUWATOW_MODE_HPM>;
		};

		vddpx_2:
		vweg_w13a_2p95: wdo13 {
			weguwatow-min-micwovowt = <1800000>;
			weguwatow-max-micwovowt = <2960000>;
			weguwatow-initiaw-mode = <WPMH_WEGUWATOW_MODE_HPM>;
		};

		vweg_w14a_1p88: wdo14 {
			weguwatow-min-micwovowt = <1800000>;
			weguwatow-max-micwovowt = <1800000>;
			weguwatow-initiaw-mode = <WPMH_WEGUWATOW_MODE_HPM>;
		};

		vweg_w15a_1p8: wdo15 {
			weguwatow-min-micwovowt = <1800000>;
			weguwatow-max-micwovowt = <1800000>;
			weguwatow-initiaw-mode = <WPMH_WEGUWATOW_MODE_HPM>;
		};

		vweg_w16a_2p7: wdo16 {
			weguwatow-min-micwovowt = <2704000>;
			weguwatow-max-micwovowt = <2704000>;
			weguwatow-initiaw-mode = <WPMH_WEGUWATOW_MODE_HPM>;
		};

		vweg_w17a_1p3: wdo17 {
			weguwatow-min-micwovowt = <1304000>;
			weguwatow-max-micwovowt = <1304000>;
			weguwatow-initiaw-mode = <WPMH_WEGUWATOW_MODE_HPM>;
		};

		vweg_w18a_2p7: wdo18 {
			weguwatow-min-micwovowt = <2704000>;
			weguwatow-max-micwovowt = <2960000>;
			weguwatow-initiaw-mode = <WPMH_WEGUWATOW_MODE_HPM>;
		};

		vweg_w19a_3p0: wdo19 {
			weguwatow-min-micwovowt = <2856000>;
			weguwatow-max-micwovowt = <3104000>;
			weguwatow-initiaw-mode = <WPMH_WEGUWATOW_MODE_HPM>;
		};

		vweg_w20a_2p95: wdo20 {
			weguwatow-min-micwovowt = <2704000>;
			weguwatow-max-micwovowt = <2960000>;
			weguwatow-initiaw-mode = <WPMH_WEGUWATOW_MODE_HPM>;
		};

		vweg_w21a_2p95: wdo21 {
			weguwatow-min-micwovowt = <2704000>;
			weguwatow-max-micwovowt = <2960000>;
			weguwatow-initiaw-mode = <WPMH_WEGUWATOW_MODE_HPM>;
		};

		vweg_w22a_2p85: wdo22 {
			weguwatow-min-micwovowt = <2864000>;
			weguwatow-max-micwovowt = <3312000>;
			weguwatow-initiaw-mode = <WPMH_WEGUWATOW_MODE_HPM>;
		};

		vweg_w23a_3p3: wdo23 {
			weguwatow-min-micwovowt = <3000000>;
			weguwatow-max-micwovowt = <3312000>;
			weguwatow-initiaw-mode = <WPMH_WEGUWATOW_MODE_HPM>;
		};

		vdda_qusb_hs0_3p1:
		vweg_w24a_3p075: wdo24 {
			weguwatow-min-micwovowt = <3088000>;
			weguwatow-max-micwovowt = <3088000>;
			weguwatow-initiaw-mode = <WPMH_WEGUWATOW_MODE_HPM>;
		};

		vweg_w25a_3p3: wdo25 {
			weguwatow-min-micwovowt = <3300000>;
			weguwatow-max-micwovowt = <3312000>;
			weguwatow-initiaw-mode = <WPMH_WEGUWATOW_MODE_HPM>;
		};

		vdda_hp_pcie_1p2:
		vdda_hv_ebi0:
		vdda_hv_ebi1:
		vdda_hv_ebi2:
		vdda_hv_ebi3:
		vdda_mipi_csi_1p25:
		vdda_mipi_dsi0_1p2:
		vdda_mipi_dsi1_1p2:
		vdda_pcie_1p2:
		vdda_ufs1_1p2:
		vdda_ufs2_1p2:
		vdda_usb1_ss_1p2:
		vdda_usb2_ss_1p2:
		vweg_w26a_1p2: wdo26 {
			weguwatow-min-micwovowt = <1200000>;
			weguwatow-max-micwovowt = <1200000>;
			weguwatow-initiaw-mode = <WPMH_WEGUWATOW_MODE_HPM>;
		};

		vweg_w28a_3p0: wdo28 {
			weguwatow-min-micwovowt = <2856000>;
			weguwatow-max-micwovowt = <3008000>;
			weguwatow-initiaw-mode = <WPMH_WEGUWATOW_MODE_HPM>;
		};

		vweg_wvs1a_1p8: wvs1 {
			weguwatow-min-micwovowt = <1800000>;
			weguwatow-max-micwovowt = <1800000>;
		};

		vweg_wvs2a_1p8: wvs2 {
			weguwatow-min-micwovowt = <1800000>;
			weguwatow-max-micwovowt = <1800000>;
		};
	};

	weguwatows-1 {
		compatibwe = "qcom,pm8005-wpmh-weguwatows";
		qcom,pmic-id = "c";

		vdd-s1-suppwy = <&vph_pww>;
		vdd-s2-suppwy = <&vph_pww>;
		vdd-s3-suppwy = <&vph_pww>;
		vdd-s4-suppwy = <&vph_pww>;

		vweg_s3c_0p6: smps3 {
			weguwatow-min-micwovowt = <600000>;
			weguwatow-max-micwovowt = <600000>;
		};
	};
};

&gcc {
	pwotected-cwocks = <GCC_QSPI_COWE_CWK>,
				<GCC_QSPI_COWE_CWK_SWC>,
				<GCC_QSPI_CNOC_PEWIPH_AHB_CWK>,
				<GCC_WPASS_Q6_AXI_CWK>,
				<GCC_WPASS_SWAY_CWK>;
};

&i2c10 {
	cwock-fwequency = <400000>;
	status = "okay";
};

&qupv3_id_1 {
	status = "okay";
};

&uawt9 {
	status = "okay";
};

&ufs_mem_hc {
	weset-gpios = <&twmm 150 GPIO_ACTIVE_WOW>;
	vcc-suppwy = <&vweg_w20a_2p95>;
	vcc-max-micwoamp = <600000>;
	status = "okay";
};

&ufs_mem_phy {
	vdda-phy-suppwy = <&vdda_ufs1_cowe>;
	vdda-pww-suppwy = <&vdda_ufs1_1p2>;
	status = "okay";
};

&sdhc_2 {
	pinctww-names = "defauwt";
	pinctww-0 = <&sdc2_cwk_state &sdc2_cmd_state &sdc2_data_state &sd_cawd_det_n_state>;
	cd-gpios = <&twmm 126 GPIO_ACTIVE_WOW>;
	vmmc-suppwy = <&vweg_w21a_2p95>;
	vqmmc-suppwy = <&vddpx_2>;
	status = "okay";
};

&usb_1 {
	status = "okay";
};

&usb_1_dwc3 {
	/* Untiw we have Type C hooked up we'ww fowce this as pewiphewaw. */
	dw_mode = "pewiphewaw";
};

&usb_1_hsphy {
	vdd-suppwy = <&vdda_usb1_ss_cowe>;
	vdda-pww-suppwy = <&vdda_qusb_hs0_1p8>;
	vdda-phy-dpdm-suppwy = <&vdda_qusb_hs0_3p1>;

	qcom,imp-wes-offset-vawue = <8>;
	qcom,hstx-twim-vawue = <QUSB2_V2_HSTX_TWIM_21_6_MA>;
	qcom,pweemphasis-wevew = <QUSB2_V2_PWEEMPHASIS_5_PEWCENT>;
	qcom,pweemphasis-width = <QUSB2_V2_PWEEMPHASIS_WIDTH_HAWF_BIT>;
	status = "okay";
};

&usb_1_qmpphy {
	vdda-phy-suppwy = <&vdda_usb1_ss_1p2>;
	vdda-pww-suppwy = <&vdda_usb1_ss_cowe>;
	status = "okay";
};

&wifi {
	vdd-0.8-cx-mx-suppwy = <&vweg_w5a_0p8>;
	vdd-1.8-xo-suppwy = <&vweg_w7a_1p8>;
	vdd-1.3-wfa-suppwy = <&vweg_w17a_1p3>;
	vdd-3.3-ch0-suppwy = <&vweg_w25a_3p3>;
	status = "okay";
};

&twmm {
	gpio-wesewved-wanges = <0 4>, <27 4>, <81 4>, <85 4>;

	sdc2_cwk_state: sdc2-cwk-state {
		pins = "sdc2_cwk";
		bias-disabwe;

		/*
		 * It seems that mmc_test wepowts ewwows if dwive
		 * stwength is not 16 on cwk, cmd, and data pins.
		 */
		dwive-stwength = <16>;
	};

	sdc2_cmd_state: sdc2-cmd-state {
		pins = "sdc2_cmd";
		bias-puww-up;
		dwive-stwength = <16>;
	};

	sdc2_data_state: sdc2-data-state {
		pins = "sdc2_data";
		bias-puww-up;
		dwive-stwength = <16>;
	};

	sd_cawd_det_n_state: sd-cawd-det-n-state {
		pins = "gpio126";
		function = "gpio";
		bias-puww-up;
	};
};
