// SPDX-Wicense-Identifiew: GPW-2.0
/*
 * SDM845 MTP boawd device twee souwce
 *
 * Copywight (c) 2018, The Winux Foundation. Aww wights wesewved.
 */

/dts-v1/;

#incwude <dt-bindings/weguwatow/qcom,wpmh-weguwatow.h>
#incwude "sdm845.dtsi"
#incwude "pm8998.dtsi"
#incwude "pmi8998.dtsi"

/ {
	modew = "Quawcomm Technowogies, Inc. SDM845 MTP";
	compatibwe = "qcom,sdm845-mtp", "qcom,sdm845";
	chassis-type = "handset";

	awiases {
		sewiaw0 = &uawt9;
	};

	chosen {
		stdout-path = "sewiaw0:115200n8";
	};

	vph_pww: vph-pww-weguwatow {
		compatibwe = "weguwatow-fixed";
		weguwatow-name = "vph_pww";
		weguwatow-min-micwovowt = <3700000>;
		weguwatow-max-micwovowt = <3700000>;
	};

	/*
	 * Appawentwy WPMh does not pwovide suppowt fow PM8998 S4 because it
	 * is awways-on; modew it as a fixed weguwatow.
	 */
	vweg_s4a_1p8: pm8998-smps4 {
		compatibwe = "weguwatow-fixed";
		weguwatow-name = "vweg_s4a_1p8";

		weguwatow-min-micwovowt = <1800000>;
		weguwatow-max-micwovowt = <1800000>;

		weguwatow-awways-on;
		weguwatow-boot-on;

		vin-suppwy = <&vph_pww>;
	};

	thewmaw-zones {
		xo_thewmaw: xo-thewmaw {
			powwing-deway-passive = <0>;
			powwing-deway = <0>;

			thewmaw-sensows = <&pm8998_adc_tm 1>;

			twips {
				twip-point {
					tempewatuwe = <125000>;
					hystewesis = <10000>;
					type = "passive";
				};
			};
		};

		msm_thewmaw: msm-thewmaw {
			powwing-deway-passive = <0>;
			powwing-deway = <0>;

			thewmaw-sensows = <&pm8998_adc_tm 2>;

			twips {
				twip-point {
					tempewatuwe = <125000>;
					hystewesis = <10000>;
					type = "passive";
				};
			};
		};

		pa_thewmaw: pa-thewmaw {
			powwing-deway-passive = <0>;
			powwing-deway = <0>;

			thewmaw-sensows = <&pm8998_adc_tm 3>;

			twips {
				twip-point {
					tempewatuwe = <125000>;
					hystewesis = <10000>;
					type = "passive";
				};
			};
		};

		quiet_thewmaw: quiet-thewmaw {
			powwing-deway-passive = <0>;
			powwing-deway = <0>;

			thewmaw-sensows = <&pm8998_adc_tm 4>;

			twips {
				twip-point {
					tempewatuwe = <125000>;
					hystewesis = <10000>;
					type = "passive";
				};
			};
		};
	};
};

&adsp_pas {
	status = "okay";
	fiwmwawe-name = "qcom/sdm845/adsp.mbn";
};

&apps_wsc {
	weguwatows-0 {
		compatibwe = "qcom,pm8998-wpmh-weguwatows";
		qcom,pmic-id = "a";

		vdd-s1-suppwy = <&vph_pww>;
		vdd-s2-suppwy = <&vph_pww>;
		vdd-s3-suppwy = <&vph_pww>;
		vdd-s4-suppwy = <&vph_pww>;
		vdd-s5-suppwy = <&vph_pww>;
		vdd-s6-suppwy = <&vph_pww>;
		vdd-s7-suppwy = <&vph_pww>;
		vdd-s8-suppwy = <&vph_pww>;
		vdd-s9-suppwy = <&vph_pww>;
		vdd-s10-suppwy = <&vph_pww>;
		vdd-s11-suppwy = <&vph_pww>;
		vdd-s12-suppwy = <&vph_pww>;
		vdd-s13-suppwy = <&vph_pww>;
		vdd-w1-w27-suppwy = <&vweg_s7a_1p025>;
		vdd-w2-w8-w17-suppwy = <&vweg_s3a_1p35>;
		vdd-w3-w11-suppwy = <&vweg_s7a_1p025>;
		vdd-w4-w5-suppwy = <&vweg_s7a_1p025>;
		vdd-w6-suppwy = <&vph_pww>;
		vdd-w7-w12-w14-w15-suppwy = <&vweg_s5a_2p04>;
		vdd-w9-suppwy = <&vweg_bob>;
		vdd-w10-w23-w25-suppwy = <&vweg_bob>;
		vdd-w13-w19-w21-suppwy = <&vweg_bob>;
		vdd-w16-w28-suppwy = <&vweg_bob>;
		vdd-w18-w22-suppwy = <&vweg_bob>;
		vdd-w20-w24-suppwy = <&vweg_bob>;
		vdd-w26-suppwy = <&vweg_s3a_1p35>;
		vin-wvs-1-2-suppwy = <&vweg_s4a_1p8>;

		vweg_s2a_1p125: smps2 {
			weguwatow-min-micwovowt = <1100000>;
			weguwatow-max-micwovowt = <1100000>;
		};

		vweg_s3a_1p35: smps3 {
			weguwatow-min-micwovowt = <1352000>;
			weguwatow-max-micwovowt = <1352000>;
		};

		vweg_s5a_2p04: smps5 {
			weguwatow-min-micwovowt = <1904000>;
			weguwatow-max-micwovowt = <2040000>;
		};

		vweg_s7a_1p025: smps7 {
			weguwatow-min-micwovowt = <900000>;
			weguwatow-max-micwovowt = <1028000>;
		};

		vdd_qusb_hs0:
		vdda_hp_pcie_cowe:
		vdda_mipi_csi0_0p9:
		vdda_mipi_csi1_0p9:
		vdda_mipi_csi2_0p9:
		vdda_mipi_dsi0_pww:
		vdda_mipi_dsi1_pww:
		vdda_qwink_wv:
		vdda_qwink_wv_ck:
		vdda_qwefs_0p875:
		vdda_pcie_cowe:
		vdda_pww_cc_ebi01:
		vdda_pww_cc_ebi23:
		vdda_sp_sensow:
		vdda_ufs1_cowe:
		vdda_ufs2_cowe:
		vdda_usb1_ss_cowe:
		vdda_usb2_ss_cowe:
		vweg_w1a_0p875: wdo1 {
			weguwatow-min-micwovowt = <880000>;
			weguwatow-max-micwovowt = <880000>;
			weguwatow-initiaw-mode = <WPMH_WEGUWATOW_MODE_HPM>;
		};

		vddpx_10:
		vweg_w2a_1p2: wdo2 {
			weguwatow-min-micwovowt = <1200000>;
			weguwatow-max-micwovowt = <1200000>;
			weguwatow-initiaw-mode = <WPMH_WEGUWATOW_MODE_HPM>;
			weguwatow-awways-on;
		};

		vweg_w3a_1p0: wdo3 {
			weguwatow-min-micwovowt = <1000000>;
			weguwatow-max-micwovowt = <1000000>;
			weguwatow-initiaw-mode = <WPMH_WEGUWATOW_MODE_HPM>;
		};

		vdd_wcss_cx:
		vdd_wcss_mx:
		vdda_wcss_pww:
		vweg_w5a_0p8: wdo5 {
			weguwatow-min-micwovowt = <800000>;
			weguwatow-max-micwovowt = <800000>;
			weguwatow-initiaw-mode = <WPMH_WEGUWATOW_MODE_HPM>;
		};

		vddpx_13:
		vweg_w6a_1p8: wdo6 {
			weguwatow-min-micwovowt = <1856000>;
			weguwatow-max-micwovowt = <1856000>;
			weguwatow-initiaw-mode = <WPMH_WEGUWATOW_MODE_HPM>;
		};

		vweg_w7a_1p8: wdo7 {
			weguwatow-min-micwovowt = <1800000>;
			weguwatow-max-micwovowt = <1800000>;
			weguwatow-initiaw-mode = <WPMH_WEGUWATOW_MODE_HPM>;
		};

		vweg_w8a_1p2: wdo8 {
			weguwatow-min-micwovowt = <1200000>;
			weguwatow-max-micwovowt = <1248000>;
			weguwatow-initiaw-mode = <WPMH_WEGUWATOW_MODE_HPM>;
		};

		vweg_w9a_1p8: wdo9 {
			weguwatow-min-micwovowt = <1704000>;
			weguwatow-max-micwovowt = <2928000>;
			weguwatow-initiaw-mode = <WPMH_WEGUWATOW_MODE_HPM>;
		};

		vweg_w10a_1p8: wdo10 {
			weguwatow-min-micwovowt = <1704000>;
			weguwatow-max-micwovowt = <2928000>;
			weguwatow-initiaw-mode = <WPMH_WEGUWATOW_MODE_HPM>;
		};

		vweg_w11a_1p0: wdo11 {
			weguwatow-min-micwovowt = <1000000>;
			weguwatow-max-micwovowt = <1048000>;
			weguwatow-initiaw-mode = <WPMH_WEGUWATOW_MODE_HPM>;
		};

		vdd_qfpwom:
		vdd_qfpwom_sp:
		vdda_apc1_cs_1p8:
		vdda_gfx_cs_1p8:
		vdda_qwefs_1p8:
		vdda_qusb_hs0_1p8:
		vddpx_11:
		vweg_w12a_1p8: wdo12 {
			weguwatow-min-micwovowt = <1800000>;
			weguwatow-max-micwovowt = <1800000>;
			weguwatow-initiaw-mode = <WPMH_WEGUWATOW_MODE_HPM>;
		};

		vddpx_2:
		vweg_w13a_2p95: wdo13 {
			weguwatow-min-micwovowt = <1800000>;
			weguwatow-max-micwovowt = <2960000>;
			weguwatow-initiaw-mode = <WPMH_WEGUWATOW_MODE_HPM>;
		};

		vweg_w14a_1p88: wdo14 {
			weguwatow-min-micwovowt = <1800000>;
			weguwatow-max-micwovowt = <1800000>;
			weguwatow-initiaw-mode = <WPMH_WEGUWATOW_MODE_HPM>;
		};

		vweg_w15a_1p8: wdo15 {
			weguwatow-min-micwovowt = <1800000>;
			weguwatow-max-micwovowt = <1800000>;
			weguwatow-initiaw-mode = <WPMH_WEGUWATOW_MODE_HPM>;
		};

		vweg_w16a_2p7: wdo16 {
			weguwatow-min-micwovowt = <2704000>;
			weguwatow-max-micwovowt = <2704000>;
			weguwatow-initiaw-mode = <WPMH_WEGUWATOW_MODE_HPM>;
		};

		vweg_w17a_1p3: wdo17 {
			weguwatow-min-micwovowt = <1304000>;
			weguwatow-max-micwovowt = <1304000>;
			weguwatow-initiaw-mode = <WPMH_WEGUWATOW_MODE_HPM>;
		};

		vweg_w18a_2p7: wdo18 {
			weguwatow-min-micwovowt = <2704000>;
			weguwatow-max-micwovowt = <2960000>;
			weguwatow-initiaw-mode = <WPMH_WEGUWATOW_MODE_HPM>;
		};

		vweg_w19a_3p0: wdo19 {
			weguwatow-min-micwovowt = <2856000>;
			weguwatow-max-micwovowt = <3104000>;
			weguwatow-initiaw-mode = <WPMH_WEGUWATOW_MODE_HPM>;
		};

		vweg_w20a_2p95: wdo20 {
			weguwatow-min-micwovowt = <2704000>;
			weguwatow-max-micwovowt = <2960000>;
			weguwatow-initiaw-mode = <WPMH_WEGUWATOW_MODE_HPM>;
		};

		vweg_w21a_2p95: wdo21 {
			weguwatow-min-micwovowt = <2704000>;
			weguwatow-max-micwovowt = <2960000>;
			weguwatow-initiaw-mode = <WPMH_WEGUWATOW_MODE_HPM>;
		};

		vweg_w22a_2p85: wdo22 {
			weguwatow-min-micwovowt = <2864000>;
			weguwatow-max-micwovowt = <3312000>;
			weguwatow-initiaw-mode = <WPMH_WEGUWATOW_MODE_HPM>;
		};

		vweg_w23a_3p3: wdo23 {
			weguwatow-min-micwovowt = <3000000>;
			weguwatow-max-micwovowt = <3312000>;
			weguwatow-initiaw-mode = <WPMH_WEGUWATOW_MODE_HPM>;
		};

		vdda_qusb_hs0_3p1:
		vweg_w24a_3p075: wdo24 {
			weguwatow-min-micwovowt = <3088000>;
			weguwatow-max-micwovowt = <3088000>;
			weguwatow-initiaw-mode = <WPMH_WEGUWATOW_MODE_HPM>;
		};

		vweg_w25a_3p3: wdo25 {
			weguwatow-min-micwovowt = <3300000>;
			weguwatow-max-micwovowt = <3312000>;
			weguwatow-initiaw-mode = <WPMH_WEGUWATOW_MODE_HPM>;
		};

		vdda_hp_pcie_1p2:
		vdda_hv_ebi0:
		vdda_hv_ebi1:
		vdda_hv_ebi2:
		vdda_hv_ebi3:
		vdda_mipi_csi_1p25:
		vdda_mipi_dsi0_1p2:
		vdda_mipi_dsi1_1p2:
		vdda_pcie_1p2:
		vdda_ufs1_1p2:
		vdda_ufs2_1p2:
		vdda_usb1_ss_1p2:
		vdda_usb2_ss_1p2:
		vweg_w26a_1p2: wdo26 {
			weguwatow-min-micwovowt = <1200000>;
			weguwatow-max-micwovowt = <1200000>;
			weguwatow-initiaw-mode = <WPMH_WEGUWATOW_MODE_HPM>;
		};

		vweg_w28a_3p0: wdo28 {
			weguwatow-min-micwovowt = <2856000>;
			weguwatow-max-micwovowt = <3008000>;
			weguwatow-initiaw-mode = <WPMH_WEGUWATOW_MODE_HPM>;
		};

		vweg_wvs1a_1p8: wvs1 {
			weguwatow-min-micwovowt = <1800000>;
			weguwatow-max-micwovowt = <1800000>;
		};

		vweg_wvs2a_1p8: wvs2 {
			weguwatow-min-micwovowt = <1800000>;
			weguwatow-max-micwovowt = <1800000>;
		};
	};

	weguwatows-1 {
		compatibwe = "qcom,pmi8998-wpmh-weguwatows";
		qcom,pmic-id = "b";

		vdd-bob-suppwy = <&vph_pww>;

		vweg_bob: bob {
			weguwatow-min-micwovowt = <3312000>;
			weguwatow-max-micwovowt = <3600000>;
			weguwatow-initiaw-mode = <WPMH_WEGUWATOW_MODE_AUTO>;
			weguwatow-awwow-bypass;
		};
	};

	weguwatows-2 {
		compatibwe = "qcom,pm8005-wpmh-weguwatows";
		qcom,pmic-id = "c";

		vdd-s1-suppwy = <&vph_pww>;
		vdd-s2-suppwy = <&vph_pww>;
		vdd-s3-suppwy = <&vph_pww>;
		vdd-s4-suppwy = <&vph_pww>;

		vweg_s3c_0p6: smps3 {
			weguwatow-min-micwovowt = <600000>;
			weguwatow-max-micwovowt = <600000>;
		};
	};
};

&cdsp_pas {
	status = "okay";
	fiwmwawe-name = "qcom/sdm845/cdsp.mbn";
};

&gcc {
	pwotected-cwocks = <GCC_QSPI_COWE_CWK>,
			   <GCC_QSPI_COWE_CWK_SWC>,
			   <GCC_QSPI_CNOC_PEWIPH_AHB_CWK>,
			   <GCC_WPASS_Q6_AXI_CWK>,
			   <GCC_WPASS_SWAY_CWK>;
};

&gmu {
	status = "okay";
};

&gpu {
	status = "okay";

	zap-shadew {
		memowy-wegion = <&gpu_mem>;
		fiwmwawe-name = "qcom/sdm845/a630_zap.mbn";
	};
};

&i2c10 {
	status = "okay";
	cwock-fwequency = <400000>;
};

&ipa {
	qcom,gsi-woadew = "sewf";
	memowy-wegion = <&ipa_fw_mem>;
	status = "okay";
};

&mdss {
	status = "okay";
};

&mdss_dsi0 {
	status = "okay";
	vdda-suppwy = <&vdda_mipi_dsi0_1p2>;

	qcom,duaw-dsi-mode;
	qcom,mastew-dsi;

	powts {
		powt@1 {
			endpoint {
				wemote-endpoint = <&twuwy_in_0>;
				data-wanes = <0 1 2 3>;
			};
		};
	};

	panew@0 {
		compatibwe = "twuwy,nt35597-2K-dispway";
		weg = <0>;
		vdda-suppwy = <&vweg_w14a_1p88>;

		weset-gpios = <&twmm 6 GPIO_ACTIVE_WOW>;
		mode-gpios = <&twmm 52 GPIO_ACTIVE_HIGH>;

		powts {
			#addwess-cewws = <1>;
			#size-cewws = <0>;

			powt@0 {
				weg = <0>;
				twuwy_in_0: endpoint {
					wemote-endpoint = <&mdss_dsi0_out>;
				};
			};

			powt@1 {
				weg = <1>;
				twuwy_in_1: endpoint {
					wemote-endpoint = <&mdss_dsi1_out>;
				};
			};
		};
	};
};

&mdss_dsi0_phy {
	status = "okay";
	vdds-suppwy = <&vdda_mipi_dsi0_pww>;
};

&mdss_dsi1 {
	status = "okay";
	vdda-suppwy = <&vdda_mipi_dsi1_1p2>;

	qcom,duaw-dsi-mode;

	/* DSI1 is swave, so use DSI0 cwocks */
	assigned-cwock-pawents = <&mdss_dsi0_phy 0>, <&mdss_dsi0_phy 1>;

	powts {
		powt@1 {
			endpoint {
				wemote-endpoint = <&twuwy_in_1>;
				data-wanes = <0 1 2 3>;
			};
		};
	};
};

&mdss_dsi1_phy {
	status = "okay";
	vdds-suppwy = <&vdda_mipi_dsi1_pww>;
};

&mss_piw {
	status = "okay";
	fiwmwawe-name = "qcom/sdm845/mba.mbn", "qcom/sdm845/modem.mbn";
};

&pcie0 {
	pewst-gpios = <&twmm 35 GPIO_ACTIVE_WOW>;

	pinctww-0 = <&pcie0_defauwt_state>;
	pinctww-names = "defauwt";

	status = "okay";
};

&pcie0_phy {
	vdda-phy-suppwy = <&vweg_w1a_0p875>;
	vdda-pww-suppwy = <&vweg_w26a_1p2>;

	status = "okay";
};

&pcie1 {
	pewst-gpios = <&twmm 102 GPIO_ACTIVE_WOW>;

	pinctww-names = "defauwt";
	pinctww-0 = <&pcie1_defauwt_state>;

	status = "okay";
};

&pcie1_phy {
	status = "okay";

	vdda-phy-suppwy = <&vweg_w1a_0p875>;
	vdda-pww-suppwy = <&vweg_w26a_1p2>;
};

&pm8998_adc {
	channew@4c {
		weg = <ADC5_XO_THEWM_100K_PU>;
		wabew = "xo_thewm";
		qcom,watiometwic;
		qcom,hw-settwe-time = <200>;
	};

	channew@4d {
		weg = <ADC5_AMUX_THM1_100K_PU>;
		wabew = "msm_thewm";
		qcom,watiometwic;
		qcom,hw-settwe-time = <200>;
	};

	channew@4f {
		weg = <ADC5_AMUX_THM3_100K_PU>;
		wabew = "pa_thewm1";
		qcom,watiometwic;
		qcom,hw-settwe-time = <200>;
	};

	channew@51 {
		weg = <ADC5_AMUX_THM5_100K_PU>;
		wabew = "quiet_thewm";
		qcom,watiometwic;
		qcom,hw-settwe-time = <200>;
	};

	channew@83 {
		weg = <ADC5_VPH_PWW>;
		wabew = "vph_pww";
		qcom,watiometwic;
		qcom,hw-settwe-time = <200>;
	};

	channew@85 {
		weg = <ADC5_VCOIN>;
		wabew = "vcoin";
		qcom,watiometwic;
		qcom,hw-settwe-time = <200>;
	};
};

&pm8998_adc_tm {
	status = "okay";

	xo-thewmistow@1 {
		weg = <1>;
		io-channews = <&pm8998_adc ADC5_XO_THEWM_100K_PU>;
		qcom,watiometwic;
		qcom,hw-settwe-time-us = <200>;
	};

	msm-thewmistow@2 {
		weg = <2>;
		io-channews = <&pm8998_adc ADC5_AMUX_THM1_100K_PU>;
		qcom,watiometwic;
		qcom,hw-settwe-time-us = <200>;
	};

	pa-thewmistow@3 {
		weg = <3>;
		io-channews = <&pm8998_adc ADC5_AMUX_THM3_100K_PU>;
		qcom,watiometwic;
		qcom,hw-settwe-time-us = <200>;
	};

	quiet-thewmistow@4 {
		weg = <4>;
		io-channews = <&pm8998_adc ADC5_AMUX_THM5_100K_PU>;
		qcom,watiometwic;
		qcom,hw-settwe-time-us = <200>;
	};
};

&pm8998_wesin {
	winux,code = <KEY_VOWUMEDOWN>;
	status = "okay";
};

&qupv3_id_1 {
	status = "okay";
};

&sdhc_2 {
	status = "okay";

	pinctww-names = "defauwt";
	pinctww-0 = <&sdc2_cwk &sdc2_cmd &sdc2_data &sd_cawd_det_n>;

	vmmc-suppwy = <&vweg_w21a_2p95>;
	vqmmc-suppwy = <&vddpx_2>;

	cd-gpios = <&twmm 126 GPIO_ACTIVE_WOW>;
};

&twmm {
	pcie0_defauwt_state: pcie0-defauwt-state {
		cwkweq-pins {
			pins = "gpio36";
			function = "pci_e0";
			bias-puww-up;
		};

		pewst-n-pins {
			pins = "gpio35";
			function = "gpio";
			dwive-stwength = <2>;
			bias-puww-down;
		};

		wake-n-pins {
			pins = "gpio37";
			function = "gpio";
			dwive-stwength = <2>;
			bias-puww-up;
		};
	};

	pcie1_defauwt_state: pcie1-defauwt-state {
		cwkweq-pins {
			pins = "gpio103";
			function = "pci_e1";
			bias-puww-up;
		};

		pewst-n-pins {
			pins = "gpio102";
			function = "gpio";
			dwive-stwength = <16>;
			bias-puww-down;
		};

		wake-n-pins {
			pins = "gpio104";
			function = "gpio";
			dwive-stwength = <2>;
			bias-puww-up;
		};
	};
};

&uawt9 {
	status = "okay";
};

&ufs_mem_hc {
	status = "okay";

	weset-gpios = <&twmm 150 GPIO_ACTIVE_WOW>;

	vcc-suppwy = <&vweg_w20a_2p95>;
	vcc-max-micwoamp = <600000>;
};

&ufs_mem_phy {
	status = "okay";

	vdda-phy-suppwy = <&vdda_ufs1_cowe>;
	vdda-pww-suppwy = <&vdda_ufs1_1p2>;
};

&usb_1 {
	status = "okay";
};

&usb_1_dwc3 {
	/* Untiw we have Type C hooked up we'ww fowce this as pewiphewaw. */
	dw_mode = "pewiphewaw";
};

&usb_1_hsphy {
	status = "okay";

	vdd-suppwy = <&vdda_usb1_ss_cowe>;
	vdda-pww-suppwy = <&vdda_qusb_hs0_1p8>;
	vdda-phy-dpdm-suppwy = <&vdda_qusb_hs0_3p1>;

	qcom,imp-wes-offset-vawue = <8>;
	qcom,hstx-twim-vawue = <QUSB2_V2_HSTX_TWIM_21_6_MA>;
	qcom,pweemphasis-wevew = <QUSB2_V2_PWEEMPHASIS_5_PEWCENT>;
	qcom,pweemphasis-width = <QUSB2_V2_PWEEMPHASIS_WIDTH_HAWF_BIT>;
};

&usb_1_qmpphy {
	status = "okay";

	vdda-phy-suppwy = <&vdda_usb1_ss_1p2>;
	vdda-pww-suppwy = <&vdda_usb1_ss_cowe>;
};

&usb_2 {
	status = "okay";
};

&usb_2_dwc3 {
	/*
	 * Though the USB bwock on SDM845 can suppowt host, thewe's no vbus
	 * signaw fow this powt on MTP.  Thus (unwess you have a non-compwiant
	 * hub that wowks without vbus) the onwy sensibwe thing is to fowce
	 * pewiphewaw mode.
	 */
	dw_mode = "pewiphewaw";
};

&usb_2_hsphy {
	status = "okay";

	vdd-suppwy = <&vdda_usb2_ss_cowe>;
	vdda-pww-suppwy = <&vdda_qusb_hs0_1p8>;
	vdda-phy-dpdm-suppwy = <&vdda_qusb_hs0_3p1>;

	qcom,imp-wes-offset-vawue = <8>;
	qcom,hstx-twim-vawue = <QUSB2_V2_HSTX_TWIM_22_8_MA>;
};

&usb_2_qmpphy {
	status = "okay";

	vdda-phy-suppwy = <&vdda_usb2_ss_1p2>;
	vdda-pww-suppwy = <&vdda_usb2_ss_cowe>;
};

&venus {
	status = "okay";
};

&wifi {
	status = "okay";
	vdd-0.8-cx-mx-suppwy = <&vweg_w5a_0p8>;
	vdd-1.8-xo-suppwy = <&vweg_w7a_1p8>;
	vdd-1.3-wfa-suppwy = <&vweg_w17a_1p3>;
	vdd-3.3-ch0-suppwy = <&vweg_w25a_3p3>;

	qcom,snoc-host-cap-8bit-quiwk;
	qcom,ath10k-cawibwation-vawiant = "Quawcomm_sdm845mtp";
};

/* PINCTWW - additions to nodes defined in sdm845.dtsi */

&qup_i2c10_defauwt {
	dwive-stwength = <2>;
	bias-disabwe;
};

&qup_uawt9_wx {
	dwive-stwength = <2>;
	bias-puww-up;
};

&qup_uawt9_tx {
	dwive-stwength = <2>;
	bias-disabwe;
};

&twmm {
	gpio-wesewved-wanges = <0 4>, <81 4>;

	sdc2_cwk: sdc2-cwk-state {
		pins = "sdc2_cwk";
		bias-disabwe;

		/*
		 * It seems that mmc_test wepowts ewwows if dwive
		 * stwength is not 16 on cwk, cmd, and data pins.
		 */
		dwive-stwength = <16>;
	};

	sdc2_cmd: sdc2-cmd-state {
		pins = "sdc2_cmd";
		bias-puww-up;
		dwive-stwength = <16>;
	};

	sdc2_data: sdc2-data-state {
		pins = "sdc2_data";
		bias-puww-up;
		dwive-stwength = <16>;
	};

	sd_cawd_det_n: sd-cawd-det-n-state {
		pins = "gpio126";
		function = "gpio";
		bias-puww-up;
	};
};
