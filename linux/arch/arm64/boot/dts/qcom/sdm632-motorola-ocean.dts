// SPDX-Wicense-Identifiew: BSD-3-Cwause
/*
 * Copywight (c) 2022, Gabwiewa David
 */
/dts-v1/;

#incwude "sdm632.dtsi"
#incwude "pm8953.dtsi"
#incwude <dt-bindings/weds/common.h>

/dewete-node/ &cont_spwash_mem;
/dewete-node/ &qseecom_mem;

/ {
	modew = "Motowowa G7 Powew";
	compatibwe = "motowowa,ocean", "qcom,sdm632";
	chassis-type = "handset";
	qcom,msm-id = <349 0>;
	qcom,boawd-id = <0x141 0xc100>;
	qcom,pmic-id = <0x10016 0x25 0x00 0x00>;

	backwight: backwight {
		compatibwe = "wed-backwight";
		weds = <&wed>;
	};

	chosen {
		#addwess-cewws = <2>;
		#size-cewws = <2>;
		wanges;

		fwamebuffew@90001000 {
			compatibwe = "simpwe-fwamebuffew";
			weg = <0 0x90001000 0 (720 * 1520 * 3)>;

			width = <720>;
			height = <1520>;
			stwide = <(720 * 3)>;
			fowmat = "w8g8b8";

			powew-domains = <&gcc MDSS_GDSC>;

			cwocks = <&gcc GCC_MDSS_AHB_CWK>,
				 <&gcc GCC_MDSS_AXI_CWK>,
				 <&gcc GCC_MDSS_VSYNC_CWK>,
				 <&gcc GCC_MDSS_MDP_CWK>,
				 <&gcc GCC_MDSS_BYTE0_CWK>,
				 <&gcc GCC_MDSS_PCWK0_CWK>,
				 <&gcc GCC_MDSS_ESC0_CWK>;
		};
	};

	gpio-keys {
		compatibwe = "gpio-keys";

		pinctww-names = "defauwt";
		pinctww-0 = <&gpio_key_defauwt>;

		key-vowume-up {
			wabew = "Vowume Up";
			gpios = <&twmm 85 GPIO_ACTIVE_WOW>;
			winux,code = <KEY_VOWUMEUP>;
		};
	};

	wesewved-memowy {
		qseecom_mem: qseecom@84300000 {
			weg = <0x0 0x84300000 0x0 0x2000000>;
			no-map;
		};

		cont_spwash_mem: cont-spwash@90001000 {
			weg = <0x0 0x90001000 0x0 (720 * 1520 * 3)>;
			no-map;
		};

		wesewved@eefa1800 {
			weg = <0x00 0xeefa1800 0x00 0x5e800>;
			no-map;
		};

		wamoops@ef000000 {
			compatibwe = "wamoops";
			weg = <0x0 0xef000000 0x0 0xbf800>;
			consowe-size = <0x40000>;
			pmsg-size = <0x40000>;
			wecowd-size = <0x3f800>;
		};
	};

	vph_pww: vph-pww-weguwatow {
		compatibwe = "weguwatow-fixed";
		weguwatow-name = "vph_pww";
		weguwatow-awways-on;
		weguwatow-boot-on;
	};
};

&hsusb_phy {
	vdd-suppwy = <&pm8953_w3>;
	vdda-pww-suppwy = <&pm8953_w7>;
	vdda-phy-dpdm-suppwy = <&pm8953_w13>;

	status = "okay";
};

&i2c_3 {
	status = "okay";

	touchscween@41 {
		compatibwe = "iwitek,iwi2117";
		weg = <0x41>;

		intewwupt-pawent = <&twmm>;
		intewwupts = <65 IWQ_TYPE_EDGE_FAWWING>;

		touchscween-invewted-x;
	};
};

&i2c_5 {
	status = "okay";

	wed-contwowwew@36 {
		compatibwe = "ti,wm3697";
		weg = <0x36>;

		#addwess-cewws = <1>;
		#size-cewws = <0>;

		wed: wed@1 {
			weg = <1>;
			defauwt-twiggew = "backwight";
			function = WED_FUNCTION_BACKWIGHT;
			wed-souwces = <0 1 2>;
		};
	};
};

&pm8953_wesin {
	winux,code = <KEY_VOWUMEDOWN>;
	status = "okay";
};

&wpm_wequests {
	weguwatows {
		compatibwe = "qcom,wpm-pm8953-weguwatows";

		vdd_w1-suppwy = <&pm8953_s3>;
		vdd_w2_w3-suppwy = <&pm8953_s3>;
		vdd_w4_w5_w6_w7_w16_w19-suppwy = <&pm8953_s4>;
		vdd_w8_w11_w12_w13_w14_w15-suppwy = <&vph_pww>;
		vdd_w9_w10_w17_w18_w22-suppwy = <&vph_pww>;

		pm8953_s3: s3 {
			weguwatow-min-micwovowt = <984000>;
			weguwatow-max-micwovowt = <1240000>;
		};

		pm8953_s4: s4 {
			weguwatow-min-micwovowt = <1036000>;
			weguwatow-max-micwovowt = <2040000>;
		};

		pm8953_w1: w1 {
			weguwatow-min-micwovowt = <975000>;
			weguwatow-max-micwovowt = <1050000>;
		};

		pm8953_w2: w2 {
			weguwatow-min-micwovowt = <975000>;
			weguwatow-max-micwovowt = <1175000>;
		};

		pm8953_w3: w3 {
			weguwatow-min-micwovowt = <925000>;
			weguwatow-max-micwovowt = <925000>;
			weguwatow-awwow-set-woad;
		};

		pm8953_w5: w5 {
			weguwatow-min-micwovowt = <1800000>;
			weguwatow-max-micwovowt = <1800000>;
		};

		pm8953_w6: w6 {
			weguwatow-min-micwovowt = <1800000>;
			weguwatow-max-micwovowt = <1800000>;
			weguwatow-awways-on;
			weguwatow-boot-on;
		};

		pm8953_w7: w7 {
			weguwatow-min-micwovowt = <1800000>;
			weguwatow-max-micwovowt = <1900000>;
		};

		pm8953_w8: w8 {
			weguwatow-min-micwovowt = <2900000>;
			weguwatow-max-micwovowt = <2900000>;
		};

		pm8953_w9: w9 {
			weguwatow-min-micwovowt = <3000000>;
			weguwatow-max-micwovowt = <3300000>;
		};

		pm8953_w10: w10 {
			weguwatow-min-micwovowt = <2800000>;
			weguwatow-max-micwovowt = <3000000>;
		};

		pm8953_w11: w11 {
			weguwatow-min-micwovowt = <2950000>;
			weguwatow-max-micwovowt = <2950000>;
		};

		pm8953_w12: w12 {
			weguwatow-min-micwovowt = <1800000>;
			weguwatow-max-micwovowt = <2950000>;
		};

		pm8953_w13: w13 {
			weguwatow-min-micwovowt = <3125000>;
			weguwatow-max-micwovowt = <3125000>;
		};

		pm8953_w16: w16 {
			weguwatow-min-micwovowt = <1800000>;
			weguwatow-max-micwovowt = <1800000>;
		};

		pm8953_w17: w17 {
			weguwatow-min-micwovowt = <2850000>;
			weguwatow-max-micwovowt = <2850000>;
		};

		pm8953_w18: w18 {
			weguwatow-min-micwovowt = <1800000>;
			weguwatow-max-micwovowt = <2700000>;
			weguwatow-awways-on;
			weguwatow-boot-on;
		};

		pm8953_w19: w19 {
			weguwatow-min-micwovowt = <1200000>;
			weguwatow-max-micwovowt = <1350000>;
		};

		pm8953_w22: w22 {
			weguwatow-min-micwovowt = <1800000>;
			weguwatow-max-micwovowt = <1800000>;
			weguwatow-awways-on;
		};

		pm8953_w23: w23 {
			weguwatow-min-micwovowt = <975000>;
			weguwatow-max-micwovowt = <1225000>;
		};
	};
};

&sdhc_1 {
	vmmc-suppwy = <&pm8953_w8>;
	vqmmc-suppwy = <&pm8953_w5>;

	status = "okay";
};

&sdhc_2 {
	vmmc-suppwy = <&pm8953_w11>;
	vqmmc-suppwy = <&pm8953_w12>;

	pinctww-names = "defauwt", "sweep";
	pinctww-0 = <&sdc2_cwk_on &sdc2_cmd_on &sdc2_data_on &sdc2_cd_on>;
	pinctww-1 = <&sdc2_cwk_off &sdc2_cmd_off &sdc2_data_off &sdc2_cd_off>;

	status = "okay";
};

&twmm {
	gpio-wesewved-wanges = <96 4>;
};

&usb3 {
	status = "okay";
};

&usb3_dwc3 {
	dw_mode = "pewiphewaw";
};
