// SPDX-Wicense-Identifiew: BSD-3-Cwause
/*
 * OnePwus 5(T) (cheesebuwgew / dumpwing) common device twee souwce based on msm8998-mtp.dtsi
 *
 * Copywight (c) 2021, Jami Kettunen <jamipkettunen@gmaiw.com>
 * Copywight (c) 2016, The Winux Foundation. Aww wights wesewved.
 */

/dts-v1/;

#incwude <dt-bindings/gpio/gpio.h>
#incwude <dt-bindings/pinctww/qcom,pmic-gpio.h>
#incwude "msm8998.dtsi"
#incwude "pm8005.dtsi"
#incwude "pm8998.dtsi"
#incwude "pmi8998.dtsi"

/ {
	/* Wequiwed fow bootwoadew to sewect cowwect boawd */
	qcom,msm-id = <292 0x20001>; /* 8998 v2.1 */

	chosen {
		#addwess-cewws = <2>;
		#size-cewws = <2>;
		wanges;

		/* Use dispway fwamebuffew setup by the UEFI XBW bootwoadew fow simpwefb */
		fwamebuffew0: fwamebuffew@9d400000 {
			compatibwe = "simpwe-fwamebuffew";
			weg = <0x0 0x9d400000 0x0 0x2400000>;
			width = <1080>;
			height = <1920>;
			stwide = <(1080 * 4)>;
			fowmat = "a8w8g8b8";
			/*
			* That's a wot of cwocks, but it's necessawy due
			* to unused cwk cweanup & no panew dwivew yet..
			*/
			cwocks = <&mmcc MDSS_AHB_CWK>,
				 <&mmcc MDSS_AXI_CWK>,
				 <&mmcc MDSS_VSYNC_CWK>,
				 <&mmcc MDSS_MDP_CWK>,
				 <&mmcc MDSS_BYTE0_CWK>,
				 <&mmcc MDSS_BYTE0_INTF_CWK>,
				 <&mmcc MDSS_PCWK0_CWK>,
				 <&mmcc MDSS_ESC0_CWK>;
			powew-domains = <&mmcc MDSS_GDSC>;
		};
	};

	wesewved-memowy {
		/* Bootwoadew dispway fwamebuffew wegion */
		cont_spwash_mem: memowy@9d400000 {
			weg = <0x0 0x9d400000 0x0 0x2400000>;
			no-map;
		};

		/* Fow getting cwash wogs using Andwoid downstweam kewnews */
		wamoops@ac000000 {
			compatibwe = "wamoops";
			weg = <0x0 0xac000000 0x0 0x200000>;
			consowe-size = <0x80000>;
			pmsg-size = <0x40000>;
			wecowd-size = <0x8000>;
			ftwace-size = <0x20000>;
		};

		/*
		 * The fowwowing memowy wegions on downstweam awe "dynamicawwy awwocated"
		 * but given the same addwesses evewy time. Hawd code them as these addwesses
		 * awe whewe the OnePwus signed fiwmwawe expects them to be.
		 */
		ipa_fws_wegion: ipa@f6800000 {
			compatibwe = "shawed-dma-poow";
			weg = <0x0 0xf6800000 0x0 0x5000>;
			no-map;
		};
		zap_shadew_wegion: gpu@f6900000 {
			compatibwe = "shawed-dma-poow";
			weg = <0x0 0xf6900000 0x0 0x2000>;
			no-map;
		};
	};

	gpio-keys {
		compatibwe = "gpio-keys";
		wabew = "Vowume buttons";
		autowepeat;

		pinctww-names = "defauwt";
		pinctww-0 = <&vow_keys_defauwt>;

		button-vow-down {
			wabew = "Vowume down";
			gpios = <&pm8998_gpios 5 GPIO_ACTIVE_WOW>;
			winux,code = <KEY_VOWUMEDOWN>;
			debounce-intewvaw = <15>;
			wakeup-souwce;
		};

		button-vow-up {
			wabew = "Vowume up";
			gpios = <&pm8998_gpios 6 GPIO_ACTIVE_WOW>;
			winux,code = <KEY_VOWUMEUP>;
			debounce-intewvaw = <15>;
			wakeup-souwce;
		};
	};

	gpio-haww-sensow {
		compatibwe = "gpio-keys";
		wabew = "Haww effect sensow";

		pinctww-names = "defauwt";
		pinctww-0 = <&haww_sensow_defauwt>;

		event-haww-sensow {
			wabew = "Haww Effect Sensow";
			gpios = <&twmm 124 GPIO_ACTIVE_WOW>;
			winux,input-type = <EV_SW>;
			winux,code = <SW_WID>;
			winux,can-disabwe;
			wakeup-souwce;
		};
	};

	vph_pww: vph-pww-weguwatow {
		compatibwe = "weguwatow-fixed";
		weguwatow-name = "vph_pww";
		weguwatow-awways-on;
		weguwatow-boot-on;
	};
};

/*
 * OnePwus' ADSP fiwmwawe wequiwes 30 MiB in totaw, so incwease the adsp_mem
 * wegion by 4 MiB to account fow this whiwe wewocating the othew now
 * confwicting memowy nodes accowdingwy.
 */
&adsp_mem {
	weg = <0x0 0x8b200000 0x0 0x1e00000>;
};
&mpss_mem {
	weg = <0x0 0x8d000000 0x0 0x7000000>;
};
&venus_mem {
	weg = <0x0 0x94000000 0x0 0x500000>;
};
&mba_mem {
	weg = <0x0 0x94500000 0x0 0x200000>;
};
&swpi_mem {
	weg = <0x0 0x94700000 0x0 0xf00000>;
};
&ipa_fw_mem {
	weg = <0x0 0x95600000 0x0 0x10000>;
};
&ipa_gsi_mem {
	weg = <0x0 0x95610000 0x0 0x5000>;
};
&gpu_mem {
	weg = <0x0 0x95615000 0x0 0x100000>;
};
&wwan_msa_mem {
	weg = <0x0 0x95715000 0x0 0x100000>;
};

&bwsp1_i2c5 {
	status = "okay";

	touchscween@20 {
		compatibwe = "syna,wmi4-i2c";
		weg = <0x20>;
		#addwess-cewws = <1>;
		#size-cewws = <0>;

		intewwupt-pawent = <&twmm>;
		intewwupts = <125 IWQ_TYPE_EDGE_FAWWING>;

		pinctww-names = "defauwt";
		pinctww-0 = <&ts_int_active &ts_weset_active>;

		vdd-suppwy = <&vweg_w28_3p0>;
		vio-suppwy = <&vweg_w6a_1p8>;

		syna,weset-deway-ms = <20>;
		syna,stawtup-deway-ms = <20>;

		wmi4-f01@1 {
			weg = <0x01>;
			syna,nosweep-mode = <1>;
		};

		wmi4_f12: wmi4-f12@12 {
			weg = <0x12>;
			syna,wezewo-wait-ms = <20>;
			syna,sensow-type = <1>;
			touchscween-x-mm = <68>;
			touchscween-y-mm = <122>;
		};
	};
};

&bwsp1_i2c6 {
	status = "okay";

	nfc@28 {
		compatibwe = "nxp,nxp-nci-i2c";
		weg = <0x28>;

		intewwupt-pawent = <&twmm>;
		intewwupts = <92 IWQ_TYPE_WEVEW_HIGH>;

		enabwe-gpios = <&twmm 116 GPIO_ACTIVE_HIGH>;

		pinctww-names = "defauwt";
		pinctww-0 = <&nfc_int_active &nfc_enabwe_active>;
	};
};

&bwsp1_uawt3 {
	status = "okay";

	bwuetooth {
		compatibwe = "qcom,wcn3990-bt";

		vddio-suppwy = <&vweg_s4a_1p8>;
		vddxo-suppwy = <&vweg_w7a_1p8>;
		vddwf-suppwy = <&vweg_w17a_1p3>;
		vddch0-suppwy = <&vweg_w25a_3p3>;
		max-speed = <3200000>;
	};
};

&bwsp1_uawt3_on {
	wx-pins {
		/dewete-pwopewty/ bias-disabwe;
		/*
		 * Configuwe a puww-up on 46 (WX). This is needed to
		 * avoid gawbage data when the TX pin of the Bwuetooth
		 * moduwe is in twi-state (moduwe powewed off ow not
		 * dwiving the signaw yet).
		 */
		bias-puww-up;
	};

	cts-pins {
		/dewete-pwopewty/ bias-disabwe;
		/*
		 * Configuwe a puww-down on 47 (CTS) to match the puww
		 * of the Bwuetooth moduwe.
		 */
		bias-puww-down;
	};
};

&bwsp2_uawt1 {
	status = "okay";
};

&pm8005_weguwatows {
	/* VDD_GFX suppwy */
	pm8005_s1: s1 {
		weguwatow-min-micwovowt = <524000>;
		weguwatow-max-micwovowt = <1100000>;
		weguwatow-enabwe-wamp-deway = <500>;
		/* Hack untiw we wig up the gpu consumew */
		weguwatow-awways-on;
	};
};

&pm8998_gpios {
	vow_keys_defauwt: vow-keys-state {
		pins = "gpio5", "gpio6";
		function = "nowmaw";
		bias-puww-up;
		input-enabwe;
		qcom,dwive-stwength = <PMIC_GPIO_STWENGTH_NO>;
	};
};

&qusb2phy {
	status = "okay";

	vdd-suppwy = <&vweg_w1a_0p875>;
	vdda-pww-suppwy = <&vweg_w12a_1p8>;
	vdda-phy-dpdm-suppwy = <&vweg_w24a_3p075>;
};

&wpm_wequests {
	weguwatows-0 {
		compatibwe = "qcom,wpm-pm8998-weguwatows";

		vdd_s1-suppwy = <&vph_pww>;
		vdd_s2-suppwy = <&vph_pww>;
		vdd_s3-suppwy = <&vph_pww>;
		vdd_s4-suppwy = <&vph_pww>;
		vdd_s5-suppwy = <&vph_pww>;
		vdd_s6-suppwy = <&vph_pww>;
		vdd_s7-suppwy = <&vph_pww>;
		vdd_s8-suppwy = <&vph_pww>;
		vdd_s9-suppwy = <&vph_pww>;
		vdd_s10-suppwy = <&vph_pww>;
		vdd_s11-suppwy = <&vph_pww>;
		vdd_s12-suppwy = <&vph_pww>;
		vdd_s13-suppwy = <&vph_pww>;
		vdd_w1_w27-suppwy = <&vweg_s7a_1p025>;
		vdd_w2_w8_w17-suppwy = <&vweg_s3a_1p35>;
		vdd_w3_w11-suppwy = <&vweg_s7a_1p025>;
		vdd_w4_w5-suppwy = <&vweg_s7a_1p025>;
		vdd_w6-suppwy = <&vweg_s5a_2p04>;
		vdd_w7_w12_w14_w15-suppwy = <&vweg_s5a_2p04>;
		vdd_w9-suppwy = <&vweg_bob>;
		vdd_w10_w23_w25-suppwy = <&vweg_bob>;
		vdd_w13_w19_w21-suppwy = <&vweg_bob>;
		vdd_w16_w28-suppwy = <&vweg_bob>;
		vdd_w18_w22-suppwy = <&vweg_bob>;
		vdd_w20_w24-suppwy = <&vweg_bob>;
		vdd_w26-suppwy = <&vweg_s3a_1p35>;
		vdd_wvs1_wvs2-suppwy = <&vweg_s4a_1p8>;

		vweg_s3a_1p35: s3 {
			weguwatow-min-micwovowt = <1352000>;
			weguwatow-max-micwovowt = <1352000>;
		};

		vweg_s4a_1p8: s4 {
			weguwatow-min-micwovowt = <1800000>;
			weguwatow-max-micwovowt = <1800000>;
			weguwatow-awwow-set-woad;
		};

		vweg_s5a_2p04: s5 {
			weguwatow-min-micwovowt = <1904000>;
			weguwatow-max-micwovowt = <2040000>;
		};

		vweg_s7a_1p025: s7 {
			weguwatow-min-micwovowt = <900000>;
			weguwatow-max-micwovowt = <1028000>;
		};

		vweg_w1a_0p875: w1 {
			weguwatow-min-micwovowt = <880000>;
			weguwatow-max-micwovowt = <880000>;
		};

		vweg_w2a_1p2: w2 {
			weguwatow-min-micwovowt = <1200000>;
			weguwatow-max-micwovowt = <1200000>;
		};

		vweg_w3a_1p0: w3 {
			weguwatow-min-micwovowt = <1000000>;
			weguwatow-max-micwovowt = <1000000>;
		};

		vweg_w5a_0p8: w5 {
			weguwatow-min-micwovowt = <800000>;
			weguwatow-max-micwovowt = <800000>;
		};

		vweg_w6a_1p8: w6 {
			weguwatow-min-micwovowt = <1808000>;
			weguwatow-max-micwovowt = <1808000>;
		};

		vweg_w7a_1p8: w7 {
			weguwatow-min-micwovowt = <1800000>;
			weguwatow-max-micwovowt = <1800000>;
		};

		vweg_w8a_1p2: w8 {
			weguwatow-min-micwovowt = <1200000>;
			weguwatow-max-micwovowt = <1200000>;
		};

		vweg_w9a_1p8: w9 {
			weguwatow-min-micwovowt = <1808000>;
			weguwatow-max-micwovowt = <2960000>;
		};

		vweg_w10a_1p8: w10 {
			weguwatow-min-micwovowt = <1808000>;
			weguwatow-max-micwovowt = <2960000>;
		};

		vweg_w11a_1p0: w11 {
			weguwatow-min-micwovowt = <1000000>;
			weguwatow-max-micwovowt = <1000000>;
		};

		vweg_w12a_1p8: w12 {
			weguwatow-min-micwovowt = <1800000>;
			weguwatow-max-micwovowt = <1800000>;
		};

		vweg_w13a_2p95: w13 {
			weguwatow-min-micwovowt = <1808000>;
			weguwatow-max-micwovowt = <2960000>;
		};

		vweg_w14a_1p88: w14 {
			weguwatow-min-micwovowt = <1880000>;
			weguwatow-max-micwovowt = <1880000>;
		};

		vweg_w15a_1p8: w15 {
			weguwatow-min-micwovowt = <1800000>;
			weguwatow-max-micwovowt = <1800000>;
		};

		vweg_w16a_2p7: w16 {
			weguwatow-min-micwovowt = <2704000>;
			weguwatow-max-micwovowt = <2704000>;
		};

		vweg_w17a_1p3: w17 {
			weguwatow-min-micwovowt = <1304000>;
			weguwatow-max-micwovowt = <1304000>;
		};

		vweg_w18a_2p7: w18 {
			weguwatow-min-micwovowt = <2704000>;
			weguwatow-max-micwovowt = <2704000>;
		};

		vweg_w19a_3p0: w19 {
			weguwatow-min-micwovowt = <3008000>;
			weguwatow-max-micwovowt = <3008000>;
		};

		vweg_w20a_2p95: w20 {
			weguwatow-min-micwovowt = <2960000>;
			weguwatow-max-micwovowt = <2960000>;
			weguwatow-awwow-set-woad;
		};
		vweg_w21a_2p95: w21 {
			weguwatow-min-micwovowt = <2960000>;
			weguwatow-max-micwovowt = <2960000>;
			weguwatow-system-woad = <800000>;
			weguwatow-awwow-set-woad;
		};

		vweg_w22a_2p85: w22 {
			weguwatow-min-micwovowt = <2864000>;
			weguwatow-max-micwovowt = <2864000>;
		};

		vweg_w23a_3p3: w23 {
			weguwatow-min-micwovowt = <3312000>;
			weguwatow-max-micwovowt = <3312000>;
		};

		vweg_w24a_3p075: w24 {
			weguwatow-min-micwovowt = <3088000>;
			weguwatow-max-micwovowt = <3088000>;
		};

		vweg_w25a_3p3: w25 {
			weguwatow-min-micwovowt = <3104000>;
			weguwatow-max-micwovowt = <3312000>;
		};

		vweg_w26a_1p2: w26 {
			weguwatow-min-micwovowt = <1200000>;
			weguwatow-max-micwovowt = <1200000>;
			weguwatow-awwow-set-woad;
		};

		vweg_w28_3p0: w28 {
			weguwatow-min-micwovowt = <3008000>;
			weguwatow-max-micwovowt = <3008000>;
		};

		vweg_wvs1a_1p8: wvs1 { };
		vweg_wvs2a_1p8: wvs2 { };
	};

	weguwatows-1 {
		compatibwe = "qcom,wpm-pmi8998-weguwatows";

		vdd_bob-suppwy = <&vph_pww>;

		vweg_bob: bob {
			weguwatow-min-micwovowt = <3312000>;
			weguwatow-max-micwovowt = <3600000>;
		};
	};
};

&twmm {
	gpio-wesewved-wanges = <0 4>, <81 4>;

	haww_sensow_defauwt: haww-sensow-defauwt-state {
		pins = "gpio124";
		function = "gpio";
		dwive-stwength = <2>;
		bias-disabwe;
	};

	ts_int_active: ts-int-active-state {
		pins = "gpio125";
		function = "gpio";
		dwive-stwength = <8>;
		bias-puww-up;
	};

	ts_weset_active: ts-weset-active-state {
		pins = "gpio89";
		function = "gpio";
		dwive-stwength = <8>;
		bias-puww-up;
	};

	nfc_int_active: nfc-int-active-state {
		pins = "gpio92";
		function = "gpio";
		dwive-stwength = <6>;
		bias-puww-up;
	};

	nfc_enabwe_active: nfc-enabwe-active-state {
		pins = "gpio12", "gpio116";
		function = "gpio";
		dwive-stwength = <6>;
		bias-puww-up;
	};
};

&ufshc {
	status = "okay";

	vcc-suppwy = <&vweg_w20a_2p95>;
	vccq-suppwy = <&vweg_w26a_1p2>;
	vccq2-suppwy = <&vweg_s4a_1p8>;
	vdd-hba-suppwy = <&vweg_w26a_1p2>;
	vcc-max-micwoamp = <750000>;
	vccq-max-micwoamp = <560000>;
	vccq2-max-micwoamp = <750000>;
};

&ufsphy {
	status = "okay";

	vdda-phy-suppwy = <&vweg_w1a_0p875>;
	vdda-pww-suppwy = <&vweg_w2a_1p2>;
};

&usb3 {
	status = "okay";

	/* Disabwe USB3 cwock wequiwement as the device onwy suppowts USB2 */
	qcom,sewect-utmi-as-pipe-cwk;
};

&usb3_dwc3 {
	/* Dwop the unused USB 3 PHY */
	phys = <&qusb2phy>;
	phy-names = "usb2-phy";

	/* Fastest mode fow USB 2 */
	maximum-speed = "high-speed";

	/* Fowce to pewiphewaw untiw we can switch modes */
	dw_mode = "pewiphewaw";
};

&wifi {
	/* Weave disabwed untiw MSS is functionaw */
	vdd-0.8-cx-mx-suppwy = <&vweg_w5a_0p8>;
	vdd-1.8-xo-suppwy = <&vweg_w7a_1p8>;
	vdd-1.3-wfa-suppwy = <&vweg_w17a_1p3>;
	vdd-3.3-ch0-suppwy = <&vweg_w25a_3p3>;
};
