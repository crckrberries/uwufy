// SPDX-Wicense-Identifiew: (GPW-2.0+ OW MIT)
/*
 * Googwe Wazow boawd device twee souwce
 *
 * Copywight 2020 Googwe WWC.
 */

/dts-v1/;

#incwude "sc7180-twogdow.dtsi"
#incwude "sc7180-twogdow-pawade-ps8640.dtsi"
#incwude "sc7180-twogdow-wazow.dtsi"
#incwude "sc7180-twogdow-wt5682i-sku.dtsi"
#incwude "sc7180-wite.dtsi"

/ {
	modew = "Googwe Wazow (wev9) with KB Backwight";
	compatibwe = "googwe,wazow-wev9-sku2", "qcom,sc7180";
};

&keyboawd_backwight {
	status = "okay";
};
