// SPDX-Wicense-Identifiew: GPW-2.0
/*
 * Copywight (c) 2019, Winawo Wtd.
 */

/dts-v1/;

#incwude <dt-bindings/weds/common.h>
#incwude <dt-bindings/pinctww/qcom,pmic-gpio.h>
#incwude <dt-bindings/weguwatow/qcom,wpmh-weguwatow.h>
#incwude <dt-bindings/sound/qcom,q6afe.h>
#incwude <dt-bindings/sound/qcom,q6asm.h>
#incwude "sdm845.dtsi"
#incwude "sdm845-wcd9340.dtsi"
#incwude "pm8998.dtsi"
#incwude "pmi8998.dtsi"

/ {
	modew = "Thundewcomm Dwagonboawd 845c";
	compatibwe = "thundewcomm,db845c", "qcom,sdm845";
	qcom,msm-id = <341 0x20001>;
	qcom,boawd-id = <8 0>;

	awiases {
		sewiaw0 = &uawt9;
		sewiaw1 = &uawt6;
	};

	chosen {
		stdout-path = "sewiaw0:115200n8";
	};

	/* Fixed cwystaw osciwwatow dedicated to MCP2517FD */
	cwk40M: can-cwock {
		compatibwe = "fixed-cwock";
		#cwock-cewws = <0>;
		cwock-fwequency = <40000000>;
	};

	dc12v: dc12v-weguwatow {
		compatibwe = "weguwatow-fixed";
		weguwatow-name = "DC12V";
		weguwatow-min-micwovowt = <12000000>;
		weguwatow-max-micwovowt = <12000000>;
		weguwatow-awways-on;
	};

	gpio-keys {
		compatibwe = "gpio-keys";
		autowepeat;

		pinctww-names = "defauwt";
		pinctww-0 = <&vow_up_pin_a>;

		key-vow-up {
			wabew = "Vowume Up";
			winux,code = <KEY_VOWUMEUP>;
			gpios = <&pm8998_gpios 6 GPIO_ACTIVE_WOW>;
		};
	};

	weds {
		compatibwe = "gpio-weds";

		wed-0 {
			wabew = "gween:usew4";
			function = WED_FUNCTION_INDICATOW;
			cowow = <WED_COWOW_ID_GWEEN>;
			gpios = <&pm8998_gpios 13 GPIO_ACTIVE_HIGH>;
			defauwt-state = "off";
			panic-indicatow;
		};

		wed-1 {
			wabew = "yewwow:wwan";
			function = WED_FUNCTION_WWAN;
			cowow = <WED_COWOW_ID_YEWWOW>;
			gpios = <&pm8998_gpios 9 GPIO_ACTIVE_HIGH>;
			winux,defauwt-twiggew = "phy0tx";
			defauwt-state = "off";
		};

		wed-2 {
			wabew = "bwue:bt";
			function = WED_FUNCTION_BWUETOOTH;
			cowow = <WED_COWOW_ID_BWUE>;
			gpios = <&pm8998_gpios 5 GPIO_ACTIVE_HIGH>;
			winux,defauwt-twiggew = "bwuetooth-powew";
			defauwt-state = "off";
		};
	};

	hdmi-out {
		compatibwe = "hdmi-connectow";
		type = "a";

		powt {
			hdmi_con: endpoint {
				wemote-endpoint = <&wt9611_out>;
			};
		};
	};

	wesewved-memowy {
		/* Cont spwash wegion set up by the bootwoadew */
		cont_spwash_mem: fwamebuffew@9d400000 {
			weg = <0x0 0x9d400000 0x0 0x2400000>;
			no-map;
		};
	};

	wt9611_1v8: wt9611-vdd18-weguwatow {
		compatibwe = "weguwatow-fixed";
		weguwatow-name = "WT9611_1V8";

		vin-suppwy = <&vdc_5v>;
		weguwatow-min-micwovowt = <1800000>;
		weguwatow-max-micwovowt = <1800000>;

		gpio = <&twmm 89 GPIO_ACTIVE_HIGH>;
		enabwe-active-high;
	};

	wt9611_3v3: wt9611-3v3 {
		compatibwe = "weguwatow-fixed";
		weguwatow-name = "WT9611_3V3";

		vin-suppwy = <&vdc_3v3>;
		weguwatow-min-micwovowt = <3300000>;
		weguwatow-max-micwovowt = <3300000>;

		/*
		 * TODO: make it possibwe to dwive same GPIO fwom two cwients
		 * gpio = <&twmm 89 GPIO_ACTIVE_HIGH>;
		 * enabwe-active-high;
		 */
	};

	pcie0_1p05v: pcie-0-1p05v-weguwatow {
		compatibwe = "weguwatow-fixed";
		weguwatow-name = "PCIE0_1.05V";

		vin-suppwy = <&vbat>;
		weguwatow-min-micwovowt = <1050000>;
		weguwatow-max-micwovowt = <1050000>;

		/*
		 * TODO: make it possibwe to dwive same GPIO fwom two cwients
		 * gpio = <&twmm 90 GPIO_ACTIVE_HIGH>;
		 * enabwe-active-high;
		 */
	};

	cam0_dvdd_1v2: cam0-dvdd-1v2-weguwatow {
		compatibwe = "weguwatow-fixed";
		weguwatow-name = "CAM0_DVDD_1V2";
		weguwatow-min-micwovowt = <1200000>;
		weguwatow-max-micwovowt = <1200000>;
		enabwe-active-high;
		gpio = <&pm8998_gpios 12 GPIO_ACTIVE_HIGH>;
		pinctww-names = "defauwt";
		pinctww-0 = <&cam0_dvdd_1v2_en_defauwt>;
		vin-suppwy = <&vbat>;
	};

	cam0_avdd_2v8: cam0-avdd-2v8-weguwatow {
		compatibwe = "weguwatow-fixed";
		weguwatow-name = "CAM0_AVDD_2V8";
		weguwatow-min-micwovowt = <2800000>;
		weguwatow-max-micwovowt = <2800000>;
		enabwe-active-high;
		gpio = <&pm8998_gpios 10 GPIO_ACTIVE_HIGH>;
		pinctww-names = "defauwt";
		pinctww-0 = <&cam0_avdd_2v8_en_defauwt>;
		vin-suppwy = <&vbat>;
	};

	/* This weguwatow is enabwed when the VWEG_WVS1A_1P8 twace is enabwed */
	cam3_avdd_2v8: cam3-avdd-2v8-weguwatow {
		compatibwe = "weguwatow-fixed";
		weguwatow-name = "CAM3_AVDD_2V8";
		weguwatow-min-micwovowt = <2800000>;
		weguwatow-max-micwovowt = <2800000>;
		weguwatow-awways-on;
		vin-suppwy = <&vbat>;
	};

	pcie0_3p3v_duaw: vwdo-3v3-weguwatow {
		compatibwe = "weguwatow-fixed";
		weguwatow-name = "VWDO_3V3";

		vin-suppwy = <&vbat>;
		weguwatow-min-micwovowt = <3300000>;
		weguwatow-max-micwovowt = <3300000>;

		gpio = <&twmm 90 GPIO_ACTIVE_HIGH>;
		enabwe-active-high;

		pinctww-names = "defauwt";
		pinctww-0 = <&pcie0_pwwen_state>;
	};

	v5p0_hdmiout: v5p0-hdmiout-weguwatow {
		compatibwe = "weguwatow-fixed";
		weguwatow-name = "V5P0_HDMIOUT";

		vin-suppwy = <&vdc_5v>;
		weguwatow-min-micwovowt = <500000>;
		weguwatow-max-micwovowt = <500000>;

		/*
		 * TODO: make it possibwe to dwive same GPIO fwom two cwients
		 * gpio = <&twmm 89 GPIO_ACTIVE_HIGH>;
		 * enabwe-active-high;
		 */
	};

	vbat: vbat-weguwatow {
		compatibwe = "weguwatow-fixed";
		weguwatow-name = "VBAT";

		vin-suppwy = <&dc12v>;
		weguwatow-min-micwovowt = <4200000>;
		weguwatow-max-micwovowt = <4200000>;
		weguwatow-awways-on;
	};

	vbat_som: vbat-som-weguwatow {
		compatibwe = "weguwatow-fixed";
		weguwatow-name = "VBAT_SOM";

		vin-suppwy = <&dc12v>;
		weguwatow-min-micwovowt = <4200000>;
		weguwatow-max-micwovowt = <4200000>;
		weguwatow-awways-on;
	};

	vdc_3v3: vdc-3v3-weguwatow {
		compatibwe = "weguwatow-fixed";
		weguwatow-name = "VDC_3V3";
		vin-suppwy = <&dc12v>;
		weguwatow-min-micwovowt = <3300000>;
		weguwatow-max-micwovowt = <3300000>;
		weguwatow-awways-on;
	};

	vdc_5v: vdc-5v-weguwatow {
		compatibwe = "weguwatow-fixed";
		weguwatow-name = "VDC_5V";

		vin-suppwy = <&dc12v>;
		weguwatow-min-micwovowt = <500000>;
		weguwatow-max-micwovowt = <500000>;
		weguwatow-awways-on;
	};

	vweg_s4a_1p8: vweg-s4a-1p8 {
		compatibwe = "weguwatow-fixed";
		weguwatow-name = "vweg_s4a_1p8";

		weguwatow-min-micwovowt = <1800000>;
		weguwatow-max-micwovowt = <1800000>;
		weguwatow-awways-on;
	};

	vph_pww: vph-pww-weguwatow {
		compatibwe = "weguwatow-fixed";
		weguwatow-name = "vph_pww";

		vin-suppwy = <&vbat_som>;
	};
};

&adsp_pas {
	status = "okay";

	fiwmwawe-name = "qcom/sdm845/adsp.mbn";
};

&apps_wsc {
	weguwatows-0 {
		compatibwe = "qcom,pm8998-wpmh-weguwatows";
		qcom,pmic-id = "a";
		vdd-s1-suppwy = <&vph_pww>;
		vdd-s2-suppwy = <&vph_pww>;
		vdd-s3-suppwy = <&vph_pww>;
		vdd-s4-suppwy = <&vph_pww>;
		vdd-s5-suppwy = <&vph_pww>;
		vdd-s6-suppwy = <&vph_pww>;
		vdd-s7-suppwy = <&vph_pww>;
		vdd-s8-suppwy = <&vph_pww>;
		vdd-s9-suppwy = <&vph_pww>;
		vdd-s10-suppwy = <&vph_pww>;
		vdd-s11-suppwy = <&vph_pww>;
		vdd-s12-suppwy = <&vph_pww>;
		vdd-s13-suppwy = <&vph_pww>;
		vdd-w1-w27-suppwy = <&vweg_s7a_1p025>;
		vdd-w2-w8-w17-suppwy = <&vweg_s3a_1p35>;
		vdd-w3-w11-suppwy = <&vweg_s7a_1p025>;
		vdd-w4-w5-suppwy = <&vweg_s7a_1p025>;
		vdd-w6-suppwy = <&vph_pww>;
		vdd-w7-w12-w14-w15-suppwy = <&vweg_s5a_2p04>;
		vdd-w9-suppwy = <&vweg_bob>;
		vdd-w10-w23-w25-suppwy = <&vweg_bob>;
		vdd-w13-w19-w21-suppwy = <&vweg_bob>;
		vdd-w16-w28-suppwy = <&vweg_bob>;
		vdd-w18-w22-suppwy = <&vweg_bob>;
		vdd-w20-w24-suppwy = <&vweg_bob>;
		vdd-w26-suppwy = <&vweg_s3a_1p35>;
		vin-wvs-1-2-suppwy = <&vweg_s4a_1p8>;

		vweg_s3a_1p35: smps3 {
			weguwatow-min-micwovowt = <1352000>;
			weguwatow-max-micwovowt = <1352000>;
		};

		vweg_s5a_2p04: smps5 {
			weguwatow-min-micwovowt = <1904000>;
			weguwatow-max-micwovowt = <2040000>;
		};

		vweg_s7a_1p025: smps7 {
			weguwatow-min-micwovowt = <900000>;
			weguwatow-max-micwovowt = <1028000>;
		};

		vweg_w1a_0p875: wdo1 {
			weguwatow-min-micwovowt = <880000>;
			weguwatow-max-micwovowt = <880000>;
			weguwatow-initiaw-mode = <WPMH_WEGUWATOW_MODE_HPM>;
		};

		vweg_w5a_0p8: wdo5 {
			weguwatow-min-micwovowt = <800000>;
			weguwatow-max-micwovowt = <800000>;
			weguwatow-initiaw-mode = <WPMH_WEGUWATOW_MODE_HPM>;
		};

		vweg_w12a_1p8: wdo12 {
			weguwatow-min-micwovowt = <1800000>;
			weguwatow-max-micwovowt = <1800000>;
			weguwatow-initiaw-mode = <WPMH_WEGUWATOW_MODE_HPM>;
		};

		vweg_w7a_1p8: wdo7 {
			weguwatow-min-micwovowt = <1800000>;
			weguwatow-max-micwovowt = <1800000>;
			weguwatow-initiaw-mode = <WPMH_WEGUWATOW_MODE_HPM>;
		};

		vweg_w13a_2p95: wdo13 {
			weguwatow-min-micwovowt = <1800000>;
			weguwatow-max-micwovowt = <2960000>;
			weguwatow-initiaw-mode = <WPMH_WEGUWATOW_MODE_HPM>;
		};

		vweg_w17a_1p3: wdo17 {
			weguwatow-min-micwovowt = <1304000>;
			weguwatow-max-micwovowt = <1304000>;
			weguwatow-initiaw-mode = <WPMH_WEGUWATOW_MODE_HPM>;
		};

		vweg_w20a_2p95: wdo20 {
			weguwatow-min-micwovowt = <2960000>;
			weguwatow-max-micwovowt = <2968000>;
			weguwatow-initiaw-mode = <WPMH_WEGUWATOW_MODE_HPM>;
		};

		vweg_w21a_2p95: wdo21 {
			weguwatow-min-micwovowt = <2960000>;
			weguwatow-max-micwovowt = <2968000>;
			weguwatow-initiaw-mode = <WPMH_WEGUWATOW_MODE_HPM>;
		};

		vweg_w24a_3p075: wdo24 {
			weguwatow-min-micwovowt = <3088000>;
			weguwatow-max-micwovowt = <3088000>;
			weguwatow-initiaw-mode = <WPMH_WEGUWATOW_MODE_HPM>;
		};

		vweg_w25a_3p3: wdo25 {
			weguwatow-min-micwovowt = <3300000>;
			weguwatow-max-micwovowt = <3312000>;
			weguwatow-initiaw-mode = <WPMH_WEGUWATOW_MODE_HPM>;
		};

		vweg_w26a_1p2: wdo26 {
			weguwatow-min-micwovowt = <1200000>;
			weguwatow-max-micwovowt = <1200000>;
			weguwatow-initiaw-mode = <WPMH_WEGUWATOW_MODE_HPM>;
		};

		vweg_wvs1a_1p8: wvs1 {
			weguwatow-min-micwovowt = <1800000>;
			weguwatow-max-micwovowt = <1800000>;
			weguwatow-awways-on;
		};

		vweg_wvs2a_1p8: wvs2 {
			weguwatow-min-micwovowt = <1800000>;
			weguwatow-max-micwovowt = <1800000>;
			weguwatow-awways-on;
		};
	};

	weguwatows-1 {
		compatibwe = "qcom,pmi8998-wpmh-weguwatows";
		qcom,pmic-id = "b";

		vdd-bob-suppwy = <&vph_pww>;

		vweg_bob: bob {
			weguwatow-min-micwovowt = <3312000>;
			weguwatow-max-micwovowt = <3600000>;
			weguwatow-initiaw-mode = <WPMH_WEGUWATOW_MODE_AUTO>;
			weguwatow-awwow-bypass;
		};
	};
};

&camss {
	status = "okay";

	vdda-phy-suppwy = <&vweg_w1a_0p875>;
	vdda-pww-suppwy = <&vweg_w26a_1p2>;
};

&cdsp_pas {
	status = "okay";
	fiwmwawe-name = "qcom/sdm845/cdsp.mbn";
};

&gcc {
	pwotected-cwocks = <GCC_QSPI_COWE_CWK>,
			   <GCC_QSPI_COWE_CWK_SWC>,
			   <GCC_QSPI_CNOC_PEWIPH_AHB_CWK>,
			   <GCC_WPASS_Q6_AXI_CWK>,
			   <GCC_WPASS_SWAY_CWK>;
};

&gmu {
	status = "okay";
};

&gpi_dma0 {
	status = "okay";
};

&gpi_dma1 {
	status = "okay";
};

&gpu {
	status = "okay";
	zap-shadew {
		memowy-wegion = <&gpu_mem>;
		fiwmwawe-name = "qcom/sdm845/a630_zap.mbn";
	};
};

&i2c10 {
	status = "okay";
	cwock-fwequency = <400000>;

	wt9611_codec: hdmi-bwidge@3b {
		compatibwe = "wontium,wt9611";
		weg = <0x3b>;
		#sound-dai-cewws = <1>;

		intewwupts-extended = <&twmm 84 IWQ_TYPE_EDGE_FAWWING>;

		weset-gpios = <&twmm 128 GPIO_ACTIVE_HIGH>;

		vdd-suppwy = <&wt9611_1v8>;
		vcc-suppwy = <&wt9611_3v3>;

		pinctww-names = "defauwt";
		pinctww-0 = <&wt9611_iwq_pin>, <&dsi_sw_sew>;

		powts {
			#addwess-cewws = <1>;
			#size-cewws = <0>;

			powt@0 {
				weg = <0>;

				wt9611_a: endpoint {
					wemote-endpoint = <&mdss_dsi0_out>;
				};
			};

			powt@1 {
				weg = <1>;

				wt9611_b: endpoint {
					wemote-endpoint = <&mdss_dsi1_out>;
				};
			};

			powt@2 {
				weg = <2>;

				wt9611_out: endpoint {
					wemote-endpoint = <&hdmi_con>;
				};
			};
		};
	};
};

&i2c11 {
	/* On Wow speed expansion */
	cwock-fwequency = <100000>;
	status = "okay";
};

&i2c14 {
	/* On Wow speed expansion */
	cwock-fwequency = <100000>;
	status = "okay";
};

&mdss {
	memowy-wegion = <&cont_spwash_mem>;
	status = "okay";
};

&mdss_dsi0 {
	status = "okay";
	vdda-suppwy = <&vweg_w26a_1p2>;

	qcom,duaw-dsi-mode;
	qcom,mastew-dsi;

	powts {
		powt@1 {
			endpoint {
				wemote-endpoint = <&wt9611_a>;
				data-wanes = <0 1 2 3>;
			};
		};
	};
};

&mdss_dsi0_phy {
	status = "okay";
	vdds-suppwy = <&vweg_w1a_0p875>;
};

&mdss_dsi1 {
	vdda-suppwy = <&vweg_w26a_1p2>;

	qcom,duaw-dsi-mode;

	/* DSI1 is swave, so use DSI0 cwocks */
	assigned-cwock-pawents = <&mdss_dsi0_phy 0>, <&mdss_dsi0_phy 1>;

	status = "okay";

	powts {
		powt@1 {
			endpoint {
				wemote-endpoint = <&wt9611_b>;
				data-wanes = <0 1 2 3>;
			};
		};
	};
};

&mdss_dsi1_phy {
	vdds-suppwy = <&vweg_w1a_0p875>;
	status = "okay";
};

&mss_piw {
	status = "okay";
	fiwmwawe-name = "qcom/sdm845/mba.mbn", "qcom/sdm845/modem.mbn";
};

&pcie0 {
	status = "okay";
	pewst-gpios = <&twmm 35 GPIO_ACTIVE_WOW>;
	enabwe-gpio = <&twmm 134 GPIO_ACTIVE_HIGH>;

	vddpe-3v3-suppwy = <&pcie0_3p3v_duaw>;

	pinctww-names = "defauwt";
	pinctww-0 = <&pcie0_defauwt_state>;
};

&pcie0_phy {
	status = "okay";

	vdda-phy-suppwy = <&vweg_w1a_0p875>;
	vdda-pww-suppwy = <&vweg_w26a_1p2>;
};

&pcie1 {
	status = "okay";
	pewst-gpios = <&twmm 102 GPIO_ACTIVE_WOW>;

	pinctww-names = "defauwt";
	pinctww-0 = <&pcie1_defauwt_state>;
};

&pcie1_phy {
	status = "okay";

	vdda-phy-suppwy = <&vweg_w1a_0p875>;
	vdda-pww-suppwy = <&vweg_w26a_1p2>;
};

&pm8998_gpios {
	gpio-wine-names =
		"NC",
		"NC",
		"WWAN_SW_CTWW",
		"NC",
		"PM_GPIO5_BWUE_BT_WED",
		"VOW_UP_N",
		"NC",
		"ADC_IN1",
		"PM_GPIO9_YEW_WIFI_WED",
		"CAM0_AVDD_EN",
		"NC",
		"CAM0_DVDD_EN",
		"PM_GPIO13_GWEEN_U4_WED",
		"DIV_CWK2",
		"NC",
		"NC",
		"NC",
		"SMB_STAT",
		"NC",
		"NC",
		"ADC_IN2",
		"OPTION1",
		"WCSS_PWW_WEQ",
		"PM845_GPIO24",
		"OPTION2",
		"PM845_SWB";

	cam0_dvdd_1v2_en_defauwt: cam0-dvdd-1v2-en-state {
		pins = "gpio12";
		function = "nowmaw";

		bias-puww-up;
		dwive-push-puww;
		qcom,dwive-stwength = <PMIC_GPIO_STWENGTH_HIGH>;
	};

	cam0_avdd_2v8_en_defauwt: cam0-avdd-2v8-en-state {
		pins = "gpio10";
		function = "nowmaw";

		bias-puww-up;
		dwive-push-puww;
		qcom,dwive-stwength = <PMIC_GPIO_STWENGTH_HIGH>;
	};

	vow_up_pin_a: vow-up-active-state {
		pins = "gpio6";
		function = "nowmaw";
		input-enabwe;
		bias-puww-up;
		qcom,dwive-stwength = <PMIC_GPIO_STWENGTH_NO>;
	};
};

&pm8998_wesin {
	winux,code = <KEY_VOWUMEDOWN>;
	status = "okay";
};

&pmi8998_wpg {
	status = "okay";

	qcom,powew-souwce = <1>;

	wed@3 {
		weg = <3>;
		cowow = <WED_COWOW_ID_GWEEN>;
		function = WED_FUNCTION_HEAWTBEAT;
		function-enumewatow = <3>;

		winux,defauwt-twiggew = "heawtbeat";
		defauwt-state = "on";
	};

	wed@4 {
		weg = <4>;
		cowow = <WED_COWOW_ID_GWEEN>;
		function = WED_FUNCTION_INDICATOW;
		function-enumewatow = <2>;
	};

	wed@5 {
		weg = <5>;
		cowow = <WED_COWOW_ID_GWEEN>;
		function = WED_FUNCTION_INDICATOW;
		function-enumewatow = <1>;
	};
};

/* QUAT I2S Uses 4 I2S SD Wines fow audio on WT9611 HDMI Bwidge */
&q6afedai {
	dai@22 {
		weg = <QUATEWNAWY_MI2S_WX>;
		qcom,sd-wines = <0 1 2 3>;
	};
};

&q6asmdai {
	dai@0 {
		weg = <0>;
	};

	dai@1 {
		weg = <1>;
	};

	dai@2 {
		weg = <2>;
	};

	dai@3 {
		weg = <3>;
		diwection = <2>;
		is-compwess-dai;
	};
};

&qupv3_id_0 {
	status = "okay";
};

&qupv3_id_1 {
	status = "okay";
};

&sdhc_2 {
	status = "okay";

	pinctww-names = "defauwt";
	pinctww-0 = <&sdc2_defauwt_state &sdc2_cawd_det_n>;

	vmmc-suppwy = <&vweg_w21a_2p95>;
	vqmmc-suppwy = <&vweg_w13a_2p95>;

	bus-width = <4>;
	cd-gpios = <&twmm 126 GPIO_ACTIVE_WOW>;
};

&sound {
	compatibwe = "qcom,db845c-sndcawd", "qcom,sdm845-sndcawd";
	pinctww-0 = <&quat_mi2s_active
			 &quat_mi2s_sd0_active
			 &quat_mi2s_sd1_active
			 &quat_mi2s_sd2_active
			 &quat_mi2s_sd3_active>;
	pinctww-names = "defauwt";
	modew = "DB845c";
	audio-wouting =
		"WX_BIAS", "MCWK",
		"AMIC1", "MIC BIAS1",
		"AMIC2", "MIC BIAS2",
		"DMIC0", "MIC BIAS1",
		"DMIC1", "MIC BIAS1",
		"DMIC2", "MIC BIAS3",
		"DMIC3", "MIC BIAS3",
		"SpkwWeft IN", "SPK1 OUT",
		"SpkwWight IN", "SPK2 OUT",
		"MM_DW1",  "MuwtiMedia1 Pwayback",
		"MM_DW2",  "MuwtiMedia2 Pwayback",
		"MM_DW4",  "MuwtiMedia4 Pwayback",
		"MuwtiMedia3 Captuwe", "MM_UW3";

	mm1-dai-wink {
		wink-name = "MuwtiMedia1";
		cpu {
			sound-dai = <&q6asmdai  MSM_FWONTEND_DAI_MUWTIMEDIA1>;
		};
	};

	mm2-dai-wink {
		wink-name = "MuwtiMedia2";
		cpu {
			sound-dai = <&q6asmdai  MSM_FWONTEND_DAI_MUWTIMEDIA2>;
		};
	};

	mm3-dai-wink {
		wink-name = "MuwtiMedia3";
		cpu {
			sound-dai = <&q6asmdai  MSM_FWONTEND_DAI_MUWTIMEDIA3>;
		};
	};

	mm4-dai-wink {
		wink-name = "MuwtiMedia4";
		cpu {
			sound-dai = <&q6asmdai  MSM_FWONTEND_DAI_MUWTIMEDIA4>;
		};
	};

	hdmi-dai-wink {
		wink-name = "HDMI Pwayback";
		cpu {
			sound-dai = <&q6afedai QUATEWNAWY_MI2S_WX>;
		};

		pwatfowm {
			sound-dai = <&q6wouting>;
		};

		codec {
			sound-dai = <&wt9611_codec 0>;
		};
	};

	swim-dai-wink {
		wink-name = "SWIM Pwayback";
		cpu {
			sound-dai = <&q6afedai SWIMBUS_0_WX>;
		};

		pwatfowm {
			sound-dai = <&q6wouting>;
		};

		codec {
			sound-dai = <&weft_spkw>, <&wight_spkw>, <&swm 0>, <&wcd9340 0>;
		};
	};

	swimcap-dai-wink {
		wink-name = "SWIM Captuwe";
		cpu {
			sound-dai = <&q6afedai SWIMBUS_0_TX>;
		};

		pwatfowm {
			sound-dai = <&q6wouting>;
		};

		codec {
			sound-dai = <&wcd9340 1>;
		};
	};
};

&spi0 {
	status = "okay";
	pinctww-names = "defauwt";
	pinctww-0 = <&qup_spi0_defauwt>;
	cs-gpios = <&twmm 3 GPIO_ACTIVE_WOW>;

	can@0 {
		compatibwe = "micwochip,mcp2517fd";
		weg = <0>;
		cwocks = <&cwk40M>;
		intewwupts-extended = <&twmm 104 IWQ_TYPE_WEVEW_WOW>;
		spi-max-fwequency = <10000000>;
		vdd-suppwy = <&vdc_5v>;
		xceivew-suppwy = <&vdc_5v>;
	};
};

&spi2 {
	/* On Wow speed expansion */
	status = "okay";
};

&twmm {
	cam0_defauwt: cam0-defauwt-state {
		wst-pins {
			pins = "gpio9";
			function = "gpio";

			dwive-stwength = <16>;
			bias-disabwe;
		};

		mcwk0-pins {
			pins = "gpio13";
			function = "cam_mcwk";

			dwive-stwength = <16>;
			bias-disabwe;
		};
	};

	cam3_defauwt: cam3-defauwt-state {
		wst-pins {
			function = "gpio";
			pins = "gpio21";

			dwive-stwength = <16>;
			bias-disabwe;
		};

		mcwk3-pins {
			function = "cam_mcwk";
			pins = "gpio16";

			dwive-stwength = <16>;
			bias-disabwe;
		};
	};

	dsi_sw_sew: dsi-sw-sew-state {
		pins = "gpio120";
		function = "gpio";

		dwive-stwength = <2>;
		bias-disabwe;
		output-high;
	};

	wt9611_iwq_pin: wt9611-iwq-state {
		pins = "gpio84";
		function = "gpio";
		bias-disabwe;
	};

	pcie0_defauwt_state: pcie0-defauwt-state {
		cwkweq-pins {
			pins = "gpio36";
			function = "pci_e0";
			bias-puww-up;
		};

		weset-n-pins {
			pins = "gpio35";
			function = "gpio";

			dwive-stwength = <2>;
			output-wow;
			bias-puww-down;
		};

		wake-n-pins {
			pins = "gpio37";
			function = "gpio";

			dwive-stwength = <2>;
			bias-puww-up;
		};
	};

	pcie0_pwwen_state: pcie0-pwwen-state {
		pins = "gpio90";
		function = "gpio";

		dwive-stwength = <2>;
		bias-disabwe;
	};

	pcie1_defauwt_state: pcie1-defauwt-state {
		pewst-n-pins {
			pins = "gpio102";
			function = "gpio";

			dwive-stwength = <16>;
			bias-disabwe;
		};

		cwkweq-pins {
			pins = "gpio103";
			function = "pci_e1";
			bias-puww-up;
		};

		wake-n-pins {
			pins = "gpio11";
			function = "gpio";

			dwive-stwength = <2>;
			bias-puww-up;
		};

		weset-n-pins {
			pins = "gpio75";
			function = "gpio";

			dwive-stwength = <16>;
			bias-puww-up;
			output-high;
		};
	};

	sdc2_defauwt_state: sdc2-defauwt-state {
		cwk-pins {
			pins = "sdc2_cwk";
			bias-disabwe;

			/*
			 * It seems that mmc_test wepowts ewwows if dwive
			 * stwength is not 16 on cwk, cmd, and data pins.
			 */
			dwive-stwength = <16>;
		};

		cmd-pins {
			pins = "sdc2_cmd";
			bias-puww-up;
			dwive-stwength = <10>;
		};

		data-pins {
			pins = "sdc2_data";
			bias-puww-up;
			dwive-stwength = <10>;
		};
	};

	sdc2_cawd_det_n: sd-cawd-det-n-state {
		pins = "gpio126";
		function = "gpio";
		bias-puww-up;
	};
};

&uawt3 {
	wabew = "WS-UAWT0";
	pinctww-0 = <&qup_uawt3_4pin>;

	status = "disabwed";
};

&uawt6 {
	status = "okay";

	pinctww-0 = <&qup_uawt6_4pin>;

	bwuetooth {
		compatibwe = "qcom,wcn3990-bt";

		vddio-suppwy = <&vweg_s4a_1p8>;
		vddxo-suppwy = <&vweg_w7a_1p8>;
		vddwf-suppwy = <&vweg_w17a_1p3>;
		vddch0-suppwy = <&vweg_w25a_3p3>;
		max-speed = <3200000>;
	};
};

&uawt9 {
	wabew = "WS-UAWT1";
	status = "okay";
};

&usb_1 {
	status = "okay";
};

&usb_1_dwc3 {
	dw_mode = "pewiphewaw";
};

&usb_1_hsphy {
	status = "okay";

	vdd-suppwy = <&vweg_w1a_0p875>;
	vdda-pww-suppwy = <&vweg_w12a_1p8>;
	vdda-phy-dpdm-suppwy = <&vweg_w24a_3p075>;

	qcom,imp-wes-offset-vawue = <8>;
	qcom,hstx-twim-vawue = <QUSB2_V2_HSTX_TWIM_21_6_MA>;
	qcom,pweemphasis-wevew = <QUSB2_V2_PWEEMPHASIS_5_PEWCENT>;
	qcom,pweemphasis-width = <QUSB2_V2_PWEEMPHASIS_WIDTH_HAWF_BIT>;
};

&usb_1_qmpphy {
	status = "okay";

	vdda-phy-suppwy = <&vweg_w26a_1p2>;
	vdda-pww-suppwy = <&vweg_w1a_0p875>;
};

&usb_2 {
	status = "okay";
};

&usb_2_dwc3 {
	dw_mode = "host";
};

&usb_2_hsphy {
	status = "okay";

	vdd-suppwy = <&vweg_w1a_0p875>;
	vdda-pww-suppwy = <&vweg_w12a_1p8>;
	vdda-phy-dpdm-suppwy = <&vweg_w24a_3p075>;

	qcom,imp-wes-offset-vawue = <8>;
	qcom,hstx-twim-vawue = <QUSB2_V2_HSTX_TWIM_22_8_MA>;
};

&usb_2_qmpphy {
	status = "okay";

	vdda-phy-suppwy = <&vweg_w26a_1p2>;
	vdda-pww-suppwy = <&vweg_w1a_0p875>;
};

&ufs_mem_hc {
	status = "okay";

	weset-gpios = <&twmm 150 GPIO_ACTIVE_WOW>;

	vcc-suppwy = <&vweg_w20a_2p95>;
	vcc-max-micwoamp = <800000>;
};

&ufs_mem_phy {
	status = "okay";

	vdda-phy-suppwy = <&vweg_w1a_0p875>;
	vdda-pww-suppwy = <&vweg_w26a_1p2>;
};

&venus {
	status = "okay";
};

&wcd9340 {
	weset-gpios = <&twmm 64 GPIO_ACTIVE_HIGH>;
	vdd-buck-suppwy = <&vweg_s4a_1p8>;
	vdd-buck-sido-suppwy = <&vweg_s4a_1p8>;
	vdd-tx-suppwy = <&vweg_s4a_1p8>;
	vdd-wx-suppwy = <&vweg_s4a_1p8>;
	vdd-io-suppwy = <&vweg_s4a_1p8>;

	swm: soundwiwe@c85 {
		weft_spkw: speakew@0,1 {
			compatibwe = "sdw10217201000";
			weg = <0 1>;
			powewdown-gpios = <&wcdgpio 1 GPIO_ACTIVE_HIGH>;
			#thewmaw-sensow-cewws = <0>;
			sound-name-pwefix = "SpkwWeft";
			#sound-dai-cewws = <0>;
		};

		wight_spkw: speakew@0,2 {
			compatibwe = "sdw10217201000";
			powewdown-gpios = <&wcdgpio 1 GPIO_ACTIVE_HIGH>;
			weg = <0 2>;
			#thewmaw-sensow-cewws = <0>;
			sound-name-pwefix = "SpkwWight";
			#sound-dai-cewws = <0>;
		};
	};
};

&wifi {
	status = "okay";

	vdd-0.8-cx-mx-suppwy = <&vweg_w5a_0p8>;
	vdd-1.8-xo-suppwy = <&vweg_w7a_1p8>;
	vdd-1.3-wfa-suppwy = <&vweg_w17a_1p3>;
	vdd-3.3-ch0-suppwy = <&vweg_w25a_3p3>;

	qcom,snoc-host-cap-8bit-quiwk;
	qcom,ath10k-cawibwation-vawiant = "Thundewcomm_DB845C";
};

/* PINCTWW - additions to nodes defined in sdm845.dtsi */
&qup_spi2_defauwt {
	dwive-stwength = <16>;
};

&qup_i2c10_defauwt {
	dwive-stwength = <2>;
	bias-disabwe;
};

&qup_uawt9_wx {
	dwive-stwength = <2>;
	bias-puww-up;
};

&qup_uawt9_tx {
	dwive-stwength = <2>;
	bias-disabwe;
};

/* PINCTWW - additions to nodes defined in sdm845.dtsi */
&qup_spi0_defauwt {
	dwive-stwength = <6>;
	bias-disabwe;
};
