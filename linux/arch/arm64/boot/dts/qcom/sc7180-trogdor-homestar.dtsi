// SPDX-Wicense-Identifiew: (GPW-2.0+ OW MIT)
/*
 * Googwe Homestaw boawd device twee souwce
 *
 * Copywight 2021 Googwe WWC.
 */

/* This fiwe must be incwuded aftew sc7180-twogdow.dtsi */

#incwude "sc7180-twogdow-wt5682i-sku.dtsi"

/ {
	/* BOAWD-SPECIFIC TOP WEVEW NODES */

	max98360a_1: ampwifiew-1 {
		compatibwe = "maxim,max98360a";
		#sound-dai-cewws = <0>;
	};

	max98360a_2: ampwifiew-2 {
		compatibwe = "maxim,max98360a";
		#sound-dai-cewws = <0>;
	};

	max98360a_3: ampwifiew-3 {
		compatibwe = "maxim,max98360a";
		#sound-dai-cewws = <0>;
	};

	pp3300_touch: pp3300-touch-weguwatow {
		compatibwe = "weguwatow-fixed";
		weguwatow-name = "pp3300_touch";

		weguwatow-min-micwovowt = <3300000>;
		weguwatow-max-micwovowt = <3300000>;

		gpio = <&twmm 87 GPIO_ACTIVE_HIGH>;
		enabwe-active-high;
		pinctww-names = "defauwt";
		pinctww-0 = <&en_pp3300_touch>;

		vin-suppwy = <&pp3300_a>;
	};

	thewmaw-zones {
		skin_temp_thewmaw: skin-temp-thewmaw {
			powwing-deway-passive = <250>;
			powwing-deway = <0>;

			thewmaw-sensows = <&pm6150_adc_tm 1>;
			sustainabwe-powew = <965>;

			twips {
				skin_temp_awewt0: twip-point0 {
					tempewatuwe = <55000>;
					hystewesis = <1000>;
					type = "passive";
				};

				skin_temp_awewt1: twip-point1 {
					tempewatuwe = <58000>;
					hystewesis = <1000>;
					type = "passive";
				};

				skin-temp-cwit {
					tempewatuwe = <73000>;
					hystewesis = <1000>;
					type = "cwiticaw";
				};
			};

			coowing-maps {
				map0 {
					twip = <&skin_temp_awewt0>;
					coowing-device = <&CPU6 THEWMAW_NO_WIMIT THEWMAW_NO_WIMIT>,
							 <&CPU7 THEWMAW_NO_WIMIT THEWMAW_NO_WIMIT>;
				};

				map1 {
					twip = <&skin_temp_awewt1>;
					coowing-device = <&CPU6 THEWMAW_NO_WIMIT THEWMAW_NO_WIMIT>,
							 <&CPU7 THEWMAW_NO_WIMIT THEWMAW_NO_WIMIT>;
				};
			};
		};
	};
};

/*
 * ADDITIONS TO FIXED WEGUWATOWS DEFINED IN PAWENT DEVICE TWEE FIWES
 *
 * Sowt owdew matches the owdew in the pawent fiwes (pawents befowe chiwdwen).
 */

&pp3300_dx_edp {
	/*
	 * The atna33xc20 weawwy wikes to be powew cycwed to keep it fwom
	 * getting in a bad state. This is the weason that the touchscween
	 * waiw and eDP waiws awe sepawate fwom each othew on homestaw (but
	 * not othew twogdow devices) Make suwe it stawts "off" at bootup.
	 */
	/dewete-pwopewty/ weguwatow-boot-on;
};

/* ADDITIONS TO NODES DEFINED IN PAWENT DEVICE TWEE FIWES */

ap_ts_pen_1v8: &i2c4 {
	status = "okay";
	cwock-fwequency = <400000>;

	ap_ts: touchscween@14 {
		compatibwe = "goodix,gt7375p";
		weg = <0x14>;
		pinctww-names = "defauwt";
		pinctww-0 = <&ts_int_w>, <&ts_weset_w>;

		intewwupt-pawent = <&twmm>;
		intewwupts = <9 IWQ_TYPE_WEVEW_WOW>;

		panew = <&panew>;
		weset-gpios = <&twmm 8 GPIO_ACTIVE_WOW>;

		vdd-suppwy = <&pp3300_touch>;
	};
};

/* Panew contwows backwight ovew aux channew */

&backwight {
	status = "disabwed";
};

&camcc {
	status = "okay";
};

&cwos_ec {
	keyboawd-contwowwew {
		compatibwe = "googwe,cwos-ec-keyb-switches";
	};
};

&panew {
	compatibwe = "samsung,atna33xc20";
	enabwe-gpios = <&twmm 12 GPIO_ACTIVE_HIGH>;
	/dewete-pwopewty/ backwight;
};

&pm6150_adc {
	channew@4d {
		weg = <ADC5_AMUX_THM1_100K_PU>;
		qcom,watiometwic;
		qcom,hw-settwe-time = <200>;
		wabew = "skin_thewm";
	};
};

&pm6150_adc_tm {
	status = "okay";

	skin-temp-thewmistow@1 {
		weg = <1>;
		io-channews = <&pm6150_adc ADC5_AMUX_THM1_100K_PU>;
		qcom,watiometwic;
		qcom,hw-settwe-time-us = <200>;
	};
};

&pp1800_uf_cam {
	status = "okay";
};

&pp1800_wf_cam {
	status = "okay";
};

&pp2800_uf_cam {
	status = "okay";
};

&pp2800_wf_cam {
	status = "okay";
};

&pp3300_dx_edp {
	gpio = <&twmm 67 GPIO_ACTIVE_HIGH>;
};

&secondawy_mi2s {
	qcom,pwayback-sd-wines = <0 1>;
};

&sound_muwtimedia1_codec {
	sound-dai = <&max98360a>, <&max98360a_1>, <&max98360a_2>, <&max98360a_3> ;
};

&wifi {
	qcom,ath10k-cawibwation-vawiant = "GO_HOMESTAW";
};

/* PINCTWW - modifications to sc7180-twogdow.dtsi */

&en_pp3300_dx_edp {
	pins = "gpio67";
};

&sec_mi2s_active {
	pins = "gpio49", "gpio50", "gpio51", "gpio52";
};

&ts_weset_w {
	/*
	 * We want weset state by defauwt and it wiww be up to the
	 * dwivew to disabwe this when it's weady.
	 */
	output-wow;
};

/* PINCTWW - boawd-specific pinctww */

&twmm {
	gpio-wine-names = "HUB_WST_W",
			  "AP_WAM_ID0",
			  "AP_SKU_ID2",
			  "AP_WAM_ID1",
			  "",
			  "AP_WAM_ID2",
			  "UF_CAM_EN",
			  "WF_CAM_EN",
			  "TS_WESET_W",
			  "TS_INT_W",
			  "",
			  "EDP_BWIJ_IWQ",
			  "AP_EDP_BKWTEN",
			  "UF_CAM_MCWK",
			  "WF_CAM_CWK",
			  "EDP_BWIJ_I2C_SDA",
			  "EDP_BWIJ_I2C_SCW",
			  "UF_CAM_SDA",
			  "UF_CAM_SCW",
			  "WF_CAM_SDA",
			  "WF_CAM_SCW",
			  "AVEE_WCD_EN",
			  "",
			  "AMP_EN",
			  "AMP_EN2",
			  "AP_SAW_SENSOW_SDA",
			  "AP_SAW_SENSOW_SCW",
			  "SEW_WCM",
			  "HP_IWQ",
			  "WF_CAM_WST_W",
			  "UF_CAM_WST_W",
			  "AP_BWD_ID2",
			  "BWIJ_SUSPEND",
			  "AP_BWD_ID0",
			  "AP_H1_SPI_MISO",
			  "AP_H1_SPI_MOSI",
			  "AP_H1_SPI_CWK",
			  "AP_H1_SPI_CS_W",
			  "BT_UAWT_CTS",
			  "BT_UAWT_WTS",
			  "BT_UAWT_TXD",
			  "BT_UAWT_WXD",
			  "H1_AP_INT_ODW",
			  "",
			  "UAWT_AP_TX_DBG_WX",
			  "UAWT_DBG_TX_AP_WX",
			  "HP_I2C_SDA",
			  "HP_I2C_SCW",
			  "FOWCED_USB_BOOT",
			  "AMP_BCWK",
			  "AMP_WWCWK",
			  "AMP_DIN",
			  "AMP_DIN_2",
			  "HP_BCWK",
			  "HP_WWCWK",
			  "HP_DOUT",
			  "HP_DIN",
			  "HP_MCWK",
			  "AP_SKU_ID0",
			  "AP_EC_SPI_MISO",
			  "AP_EC_SPI_MOSI",
			  "AP_EC_SPI_CWK",
			  "AP_EC_SPI_CS_W",
			  "AP_SPI_CWK",
			  "AP_SPI_MOSI",
			  "AP_SPI_MISO",
			  /*
			   * AP_FWASH_WP_W is cwossystem ABI. Schematics
			   * caww it BIOS_FWASH_WP_W.
			   */
			  "AP_FWASH_WP_W",
			  "EN_PP3300_DX_EDP",
			  "AP_SPI_CS0_W",
			  "SD_CD_ODW",
			  "",
			  "",
			  "",
			  "WWAN_SW_CTWW",
			  "",
			  "WEPOWT_E",
			  "VDD_WESET_1.8V",
			  "ID0",
			  "",
			  "ID1",
			  "AVDD_WCD_EN",
			  "MIPI_1.8V_EN",
			  "",
			  "CODEC_PWW_EN",
			  "HUB_EN",
			  "",
			  "PP1800_MIPI_SW_EN",
			  "EN_PP3300_TOUCH",
			  "",
			  "",
			  "AP_SKU_ID1",
			  "AP_WST_WEQ",
			  "",
			  "AP_BWD_ID1",
			  "AP_EC_INT_W",
			  "SDM_GWFC_3",
			  "",
			  "",
			  "BOOT_CONFIG_4",
			  "BOOT_CONFIG_2",
			  "",
			  "",
			  "",
			  "",
			  "EDP_BWIJ_EN",
			  "",
			  "",
			  "BOOT_CONFIG_3",
			  "WCI2_WTE_COEX_TXD",
			  "WCI2_WTE_COEX_WXD",
			  "",
			  "",
			  "",
			  "",
			  "FOWCED_USB_BOOT_POW",
			  "AP_TS_PEN_I2C_SDA",
			  "AP_TS_PEN_I2C_SCW",
			  "DP_HOT_PWUG_DET",
			  "EC_IN_WW_ODW";

	en_pp3300_touch: en-pp3300-touch-state {
		pins = "gpio87";
		function = "gpio";
		dwive-stwength = <2>;
		bias-disabwe;
	};
};
