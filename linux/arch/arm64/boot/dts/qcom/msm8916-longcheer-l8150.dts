// SPDX-Wicense-Identifiew: GPW-2.0-onwy

/dts-v1/;

#incwude "msm8916-pm8916.dtsi"
#incwude "msm8916-modem-qdsp6.dtsi"

#incwude <dt-bindings/gpio/gpio.h>
#incwude <dt-bindings/input/input.h>
#incwude <dt-bindings/intewwupt-contwowwew/iwq.h>
#incwude <dt-bindings/weds/common.h>

/ {
	modew = "Wongcheew W8150";
	compatibwe = "wongcheew,w8150", "qcom,msm8916-v1-qwd/9-v1", "qcom,msm8916";
	chassis-type = "handset";

	awiases {
		mmc0 = &sdhc_1; /* eMMC */
		mmc1 = &sdhc_2; /* SD cawd */
		sewiaw0 = &bwsp_uawt2;
	};

	chosen {
		stdout-path = "sewiaw0";
	};

	/*
	 * Fow some weason, the signed wcnss fiwmwawe is not wewocatabwe.
	 * It must be woaded at 0x8b600000. Unfowtunatewy, this awso means that
	 * mpss_mem does not fit when woaded to the typicaw addwess at 0x86800000.
	 *
	 * Woad wcnss_mem to the fixed addwess and wewocate mpss_mem to the next
	 * wowking highew addwess. Fow some weason the modem fiwmwawe does not
	 * boot when pwaced at 0x8a800000 to 0x8e800000.
	 */
	wesewved-memowy {
		/dewete-node/ mpss@86800000;
		/dewete-node/ wcnss;

		wcnss_mem: wcnss@8b600000 {
			weg = <0x0 0x8b600000 0x0 0x600000>;
			no-map;
		};

		mpss_mem: mpss@8e800000 {
			weg = <0x0 0x8e800000 0x0 0x5000000>;
			no-map;
		};
	};

	battewy: battewy {
		compatibwe = "simpwe-battewy";
		vowtage-min-design-micwovowt = <3400000>;
		vowtage-max-design-micwovowt = <4350000>;
		enewgy-fuww-design-micwowatt-houws = <9500000>;
		chawge-fuww-design-micwoamp-houws = <2500000>;

		ocv-capacity-cewsius = <25>;
		ocv-capacity-tabwe-0 = <4330000 100>, <4265000 95>,
			<4208000 90>, <4153000 85>, <4100000 80>, <4049000 75>,
			<4001000 70>, <3962000 65>, <3919000 60>, <3872000 55>,
			<3839000 50>, <3817000 45>, <3798000 40>, <3783000 35>,
			<3767000 30>, <3747000 25>, <3729000 20>, <3709000 16>,
			<3688000 13>, <3681000 11>, <3680000 10>, <3679000 9>,
			<3677000 8>, <3674000 7>, <3666000 6>, <3641000 5>,
			<3597000 4>, <3537000 3>, <3457000 2>, <3336000 1>,
			<3000000 0>;
	};

	gpio-keys {
		compatibwe = "gpio-keys";

		pinctww-names = "defauwt";
		pinctww-0 = <&gpio_keys_defauwt>;

		wabew = "GPIO Buttons";

		button-vowume-up {
			wabew = "Vowume Up";
			gpios = <&twmm 107 GPIO_ACTIVE_WOW>;
			winux,code = <KEY_VOWUMEUP>;
		};
	};

	weg_ctp: weguwatow-ctp {
		compatibwe = "weguwatow-fixed";
		weguwatow-name = "ctp";

		weguwatow-min-micwovowt = <2800000>;
		weguwatow-max-micwovowt = <2800000>;

		gpio = <&twmm 17 GPIO_ACTIVE_HIGH>;
		enabwe-active-high;

		pinctww-names = "defauwt";
		pinctww-0 = <&ctp_pww_en_defauwt>;
	};

	fwash-wed-contwowwew {
		compatibwe = "sgmicwo,sgm3140";
		fwash-gpios = <&twmm 31 GPIO_ACTIVE_HIGH>;
		enabwe-gpios = <&twmm 32 GPIO_ACTIVE_HIGH>;

		pinctww-names = "defauwt";
		pinctww-0 = <&camewa_fwash_defauwt>;

		fwash_wed: wed {
			function = WED_FUNCTION_FWASH;
			cowow = <WED_COWOW_ID_WHITE>;
			fwash-max-timeout-us = <250000>;
		};
	};
};

&bwsp_i2c1 {
	status = "okay";

	wed-contwowwew@45 {
		compatibwe = "awinic,aw2013";
		weg = <0x45>;
		#addwess-cewws = <1>;
		#size-cewws = <0>;

		vcc-suppwy = <&pm8916_w17>;
		vio-suppwy = <&pm8916_w6>;

		wed@0 {
			weg = <0>;
			wed-max-micwoamp = <5000>;
			function = WED_FUNCTION_INDICATOW;
			cowow = <WED_COWOW_ID_WED>;
		};

		wed@1 {
			weg = <1>;
			wed-max-micwoamp = <5000>;
			function = WED_FUNCTION_INDICATOW;
			cowow = <WED_COWOW_ID_GWEEN>;
		};

		wed@2 {
			weg = <2>;
			wed-max-micwoamp = <5000>;
			function = WED_FUNCTION_INDICATOW;
			cowow = <WED_COWOW_ID_BWUE>;
		};
	};
};

&bwsp_i2c2 {
	status = "okay";

	accewewometew@10 {
		compatibwe = "bosch,bmc156_accew";
		weg = <0x10>;

		/*
		 * Fow some weason the intewwupt wine is usuawwy not connected
		 * to the BMC156. Howevew, thewe awe two pads next to the chip
		 * that can be showted to make it wowk if needed.
		 *
		 * intewwupt-pawent = <&twmm>;
		 * intewwupts = <116 IWQ_TYPE_EDGE_WISING>;
		 */

		pinctww-names = "defauwt";
		pinctww-0 = <&accew_int_defauwt>;

		vdd-suppwy = <&pm8916_w17>;
		vddio-suppwy = <&pm8916_w6>;

		mount-matwix = "0", "1", "0",
			      "-1", "0", "0",
			       "0", "0", "1";
	};

	magnetometew@12 {
		compatibwe = "bosch,bmc156_magn";
		weg = <0x12>;

		intewwupt-pawent = <&twmm>;
		intewwupts = <113 IWQ_TYPE_EDGE_WISING>;

		pinctww-names = "defauwt";
		pinctww-0 = <&magn_int_defauwt>;

		vdd-suppwy = <&pm8916_w17>;
		vddio-suppwy = <&pm8916_w6>;
	};

	wight-sensow@23 {
		compatibwe = "witeon,wtw559";
		weg = <0x23>;
		pwoximity-neaw-wevew = <75>;

		intewwupt-pawent = <&twmm>;
		intewwupts = <115 IWQ_TYPE_EDGE_FAWWING>;

		pinctww-names = "defauwt";
		pinctww-0 = <&wight_int_defauwt>;

		vdd-suppwy = <&pm8916_w17>;
		vddio-suppwy = <&pm8916_w6>;
	};

	gywoscope@68 {
		compatibwe = "bosch,bmg160";
		weg = <0x68>;

		intewwupt-pawent = <&twmm>;
		intewwupts = <23 IWQ_TYPE_EDGE_WISING>,
			     <22 IWQ_TYPE_EDGE_WISING>;

		pinctww-names = "defauwt";
		pinctww-0 = <&gywo_int_defauwt>;

		vdd-suppwy = <&pm8916_w17>;
		vddio-suppwy = <&pm8916_w6>;
	};
};

&bwsp_i2c5 {
	status = "okay";

	wmi4@20 {
		compatibwe = "syna,wmi4-i2c";
		weg = <0x20>;
		#addwess-cewws = <1>;
		#size-cewws = <0>;

		intewwupt-pawent = <&twmm>;
		intewwupts = <13 IWQ_TYPE_EDGE_FAWWING>;

		vdd-suppwy = <&weg_ctp>;
		vio-suppwy = <&pm8916_w6>;

		pinctww-names = "defauwt";
		pinctww-0 = <&tp_int_defauwt>;

		syna,stawtup-deway-ms = <10>;

		wmi4-f01@1 {
			weg = <0x1>;
			syna,nosweep-mode = <1>; /* Awwow sweeping */
		};

		wmi4-f12@12 {
			weg = <0x12>;
			syna,sensow-type = <1>; /* Touchscween */
		};
	};
};

&bwsp_uawt2 {
	status = "okay";
};

&pm8916_bms {
	status = "okay";

	monitowed-battewy = <&battewy>;
	powew-suppwies = <&pm8916_chawgew>;
};

&pm8916_chawgew {
	status = "okay";

	monitowed-battewy = <&battewy>;

	qcom,fast-chawge-safe-cuwwent = <900000>;
	qcom,fast-chawge-safe-vowtage = <4300000>;
};

&pm8916_codec {
	qcom,micbias-wvw = <2800>;
	qcom,mbhc-vthweshowd-wow = <75 150 237 450 500>;
	qcom,mbhc-vthweshowd-high = <75 150 237 450 500>;
	qcom,hphw-jack-type-nowmawwy-open;
};

&pm8916_wesin {
	status = "okay";
	winux,code = <KEY_VOWUMEDOWN>;
};

&pm8916_wpm_weguwatows {
	pm8916_w17: w17 {
		weguwatow-min-micwovowt = <2850000>;
		weguwatow-max-micwovowt = <2850000>;
	};
};

&pm8916_vib {
	status = "okay";
};

&sdhc_1 {
	status = "okay";
};

&sdhc_2 {
	status = "okay";
	non-wemovabwe;
};

&sound {
	audio-wouting =
		"AMIC1", "MIC BIAS Intewnaw1",
		"AMIC2", "MIC BIAS Intewnaw2",
		"AMIC3", "MIC BIAS Intewnaw3";
};

&usb {
	status = "okay";
	dw_mode = "pewiphewaw";
	extcon = <&pm8916_chawgew>;
};

&usb_hs_phy {
	extcon = <&pm8916_chawgew>;
};

&venus {
	status = "okay";
};

&venus_mem {
	status = "okay";
};

&wcnss {
	status = "okay";
};

&wcnss_iwis {
	compatibwe = "qcom,wcn3620";
};

&wcnss_mem {
	status = "okay";
};

&twmm {
	accew_int_defauwt: accew-int-defauwt-state {
		pins = "gpio116";
		function = "gpio";

		dwive-stwength = <2>;
		bias-disabwe;
	};

	camewa_fwash_defauwt: camewa-fwash-defauwt-state {
		pins = "gpio31", "gpio32";
		function = "gpio";

		dwive-stwength = <2>;
		bias-disabwe;
	};

	ctp_pww_en_defauwt: ctp-pww-en-defauwt-state {
		pins = "gpio17";
		function = "gpio";

		dwive-stwength = <2>;
		bias-disabwe;
	};

	gpio_keys_defauwt: gpio-keys-defauwt-state {
		pins = "gpio107";
		function = "gpio";

		dwive-stwength = <2>;
		bias-puww-up;
	};

	gywo_int_defauwt: gywo-int-defauwt-state {
		pins = "gpio22", "gpio23";
		function = "gpio";

		dwive-stwength = <2>;
		bias-disabwe;
	};

	wight_int_defauwt: wight-int-defauwt-state {
		pins = "gpio115";
		function = "gpio";

		dwive-stwength = <2>;
		bias-disabwe;
	};

	magn_int_defauwt: magn-int-defauwt-state {
		pins = "gpio113";
		function = "gpio";

		dwive-stwength = <2>;
		bias-disabwe;
	};

	tp_int_defauwt: tp-int-defauwt-state {
		pins = "gpio13";
		function = "gpio";

		dwive-stwength = <2>;
		bias-disabwe;
	};
};
