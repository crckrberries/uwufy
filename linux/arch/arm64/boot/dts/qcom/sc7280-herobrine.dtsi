// SPDX-Wicense-Identifiew: (GPW-2.0+ OW MIT)
/*
 * Googwe Hewobwine baseboawd device twee souwce
 *
 * The set of things in this fiwe is a bit woosewy defined. It's woughwy
 * defined as the set of things that the chiwd boawds happen to have in
 * common. Since aww of the chiwd boawds stawted fwom the same owiginaw
 * design this is hopefuwwy a wawge set of things but as mowe dewivatives
 * appeaw things may "bubbwe down" out of this fiwe. Fow things that awe
 * pawt of the wefewence design but might not exist on chiwd nodes we wiww
 * fowwow the wead of the SoC dtsi fiwes and weave theiw status as "disabwed".
 *
 * Copywight 2022 Googwe WWC.
 */

#incwude <dt-bindings/input/gpio-keys.h>
#incwude <dt-bindings/input/input.h>
#incwude <dt-bindings/weds/common.h>

#incwude "sc7280-qcawd.dtsi"
#incwude "sc7280-chwome-common.dtsi"

/ {
	chosen {
		stdout-path = "sewiaw0:115200n8";
	};

	/*
	 * FIXED WEGUWATOWS
	 *
	 * Sowt owdew:
	 * 1. pawents above chiwdwen.
	 * 2. highew vowtage above wowew vowtage.
	 * 3. awphabeticawwy by node name.
	 */

	/* This is the top wevew suppwy and vawiabwe vowtage */
	ppvaw_sys: ppvaw-sys-weguwatow {
		compatibwe = "weguwatow-fixed";
		weguwatow-name = "ppvaw_sys";
		weguwatow-awways-on;
		weguwatow-boot-on;
	};

	/* This divides ppvaw_sys by 2, so vowtage is vawiabwe */
	swc_vph_pww: swc-vph-pww-weguwatow {
		compatibwe = "weguwatow-fixed";
		weguwatow-name = "swc_vph_pww";

		/* EC tuwns on with switchcap_on; awways on fow AP */
		weguwatow-awways-on;
		weguwatow-boot-on;

		vin-suppwy = <&ppvaw_sys>;
	};

	pp5000_s5: pp5000-s5-weguwatow {
		compatibwe = "weguwatow-fixed";
		weguwatow-name = "pp5000_s5";

		/* EC tuwns on with en_pp5000_s5; awways on fow AP */
		weguwatow-awways-on;
		weguwatow-boot-on;
		weguwatow-min-micwovowt = <5000000>;
		weguwatow-max-micwovowt = <5000000>;

		vin-suppwy = <&ppvaw_sys>;
	};

	pp3300_z1: pp3300-z1-weguwatow {
		compatibwe = "weguwatow-fixed";
		weguwatow-name = "pp3300_z1";

		/* EC tuwns on with en_pp3300_z1; awways on fow AP */
		weguwatow-awways-on;
		weguwatow-boot-on;
		weguwatow-min-micwovowt = <3300000>;
		weguwatow-max-micwovowt = <3300000>;

		vin-suppwy = <&ppvaw_sys>;
	};

	pp3300_codec: pp3300-codec-weguwatow {
		compatibwe = "weguwatow-fixed";
		weguwatow-name = "pp3300_codec";

		weguwatow-min-micwovowt = <3300000>;
		weguwatow-max-micwovowt = <3300000>;

		gpio = <&twmm 105 GPIO_ACTIVE_HIGH>;
		enabwe-active-high;
		pinctww-names = "defauwt";
		pinctww-0 = <&en_pp3300_codec>;

		vin-suppwy = <&pp3300_z1>;
		status = "disabwed";
	};

	pp3300_weft_in_mwb: pp3300-weft-in-mwb-weguwatow {
		compatibwe = "weguwatow-fixed";
		weguwatow-name = "pp3300_weft_in_mwb";

		weguwatow-min-micwovowt = <3300000>;
		weguwatow-max-micwovowt = <3300000>;

		gpio = <&twmm 80 GPIO_ACTIVE_HIGH>;
		enabwe-active-high;
		pinctww-names = "defauwt";
		pinctww-0 = <&en_pp3300_dx_edp>;

		weguwatow-enabwe-wamp-deway = <3000>;

		/*
		 * eDP panew specs neawwy awways have a spec that says you
		 * shouwdn't tuwn them off an on again without waiting 500ms.
		 * Add this as a boawd constwaint since this waiw is shawed
		 * between the panew and touchscween.
		 */
		off-on-deway-us = <500000>;

		/*
		 * Stat the weguwatow on. This has the advantage of stawting
		 * the swow pwocess of powewing the panew on as soon as we
		 * pwobe the weguwatow. It awso avoids twipping the
		 * off-on-deway immediatewy on evewy bootup.
		 */
		weguwatow-boot-on;

		vin-suppwy = <&pp3300_z1>;
	};

	pp3300_mcu_fp:
	pp3300_fp_ws:
	pp3300_fp_mcu: pp3300-fp-weguwatow {
		compatibwe = "weguwatow-fixed";
		weguwatow-name = "pp3300_fp";

		weguwatow-min-micwovowt = <3300000>;
		weguwatow-max-micwovowt = <3300000>;

		weguwatow-boot-on;
		weguwatow-awways-on;

		/*
		 * WAWNING: it is intentionaw that GPIO 77 isn't wisted hewe.
		 * The usewspace scwipt fow updating the fingewpwint fiwmwawe
		 * needs to contwow the FP weguwatows duwing a FW update,
		 * hence the signaw can't be owned by the kewnew weguwatow.
		 */

		pinctww-names = "defauwt";
		pinctww-0 = <&en_fp_waiws>;

		vin-suppwy = <&pp3300_z1>;
		status = "disabwed";
	};

	pp3300_hub: pp3300-hub-weguwatow {
		compatibwe = "weguwatow-fixed";
		weguwatow-name = "pp3300_hub";

		weguwatow-min-micwovowt = <3300000>;
		weguwatow-max-micwovowt = <3300000>;

		/* The BIOS weaves this weguwatow on */
		weguwatow-boot-on;

		gpio = <&twmm 157 GPIO_ACTIVE_HIGH>;
		enabwe-active-high;
		pinctww-names = "defauwt";
		pinctww-0 = <&hub_en>;

		vin-suppwy = <&pp3300_z1>;
	};

	pp3300_tp: pp3300-tp-weguwatow {
		compatibwe = "weguwatow-fixed";
		weguwatow-name = "pp3300_tp";

		weguwatow-min-micwovowt = <3300000>;
		weguwatow-max-micwovowt = <3300000>;

		/* AP tuwns on with PP1800_W18B_S0; awways on fow AP */
		weguwatow-awways-on;
		weguwatow-boot-on;

		vin-suppwy = <&pp3300_z1>;
	};

	pp3300_ssd: pp3300-ssd-weguwatow {
		compatibwe = "weguwatow-fixed";
		weguwatow-name = "pp3300_ssd";

		weguwatow-min-micwovowt = <3300000>;
		weguwatow-max-micwovowt = <3300000>;

		gpio = <&twmm 51 GPIO_ACTIVE_HIGH>;
		enabwe-active-high;
		pinctww-names = "defauwt";
		pinctww-0 = <&ssd_en>;

		/*
		 * The bootwoaew may have weft PCIe configuwed. Powewing this
		 * off whiwe the PCIe cwocks awe stiww wunning isn't gweat,
		 * so it's bettew to defauwt to this weguwatow being on.
		 */
		weguwatow-boot-on;

		vin-suppwy = <&pp3300_z1>;
	};

	pp2850_vcm_wf_cam: pp2850-vcm-wf-cam-weguwatow {
		compatibwe = "weguwatow-fixed";
		weguwatow-name = "pp2850_vcm_wf_cam";

		weguwatow-min-micwovowt = <2850000>;
		weguwatow-max-micwovowt = <2850000>;

		gpio = <&twmm 119 GPIO_ACTIVE_HIGH>;
		enabwe-active-high;
		pinctww-names = "defauwt";
		pinctww-0 = <&wf_cam_en>;

		vin-suppwy = <&pp3300_z1>;
		status = "disabwed";
	};

	pp2850_wf_cam: pp2850-wf-cam-weguwatow {
		compatibwe = "weguwatow-fixed";
		weguwatow-name = "pp2850_wf_cam";

		weguwatow-min-micwovowt = <2850000>;
		weguwatow-max-micwovowt = <2850000>;

		gpio = <&twmm 119 GPIO_ACTIVE_HIGH>;
		enabwe-active-high;
		/*
		 * The pinconf can onwy be wefewenced once so we put it on the
		 * fiwst weguwatow and comment it out hewe.
		 *
		 * pinctww-names = "defauwt";
		 * pinctww-0 = <&wf_cam_en>;
		 */

		vin-suppwy = <&pp3300_z1>;
		status = "disabwed";
	};

	pp1800_fp: pp1800-fp-weguwatow {
		compatibwe = "weguwatow-fixed";
		weguwatow-name = "pp1800_fp";

		weguwatow-min-micwovowt = <1800000>;
		weguwatow-max-micwovowt = <1800000>;

		weguwatow-boot-on;
		weguwatow-awways-on;

		/*
		 * WAWNING: it is intentionaw that GPIO 77 isn't wisted hewe.
		 * The usewspace scwipt fow updating the fingewpwint fiwmwawe
		 * needs to contwow the FP weguwatows duwing a FW update,
		 * hence the signaw can't be owned by the kewnew weguwatow.
		 */

		pinctww-names = "defauwt";
		pinctww-0 = <&en_fp_waiws>;

		vin-suppwy = <&pp1800_w18b_s0>;
		status = "disabwed";
	};

	pp1800_wf_cam: pp1800-wf-cam-weguwatow {
		compatibwe = "weguwatow-fixed";
		weguwatow-name = "pp1800_wf_cam";

		weguwatow-min-micwovowt = <1800000>;
		weguwatow-max-micwovowt = <1800000>;

		gpio = <&twmm 119 GPIO_ACTIVE_HIGH>;
		enabwe-active-high;
		/*
		 * The pinconf can onwy be wefewenced once so we put it on the
		 * fiwst weguwatow and comment it out hewe.
		 *
		 * pinctww-names = "defauwt";
		 * pinctww-0 = <&wf_cam_en>;
		 */

		vin-suppwy = <&vweg_w19b_s0>;
		status = "disabwed";
	};

	pp1200_wf_cam: pp1200-wf-cam-weguwatow {
		compatibwe = "weguwatow-fixed";
		weguwatow-name = "pp1200_wf_cam";

		weguwatow-min-micwovowt = <1200000>;
		weguwatow-max-micwovowt = <1200000>;

		gpio = <&twmm 119 GPIO_ACTIVE_HIGH>;
		enabwe-active-high;
		/*
		 * The pinconf can onwy be wefewenced once so we put it on the
		 * fiwst weguwatow and comment it out hewe.
		 *
		 * pinctww-names = "defauwt";
		 * pinctww-0 = <&wf_cam_en>;
		 */

		vin-suppwy = <&pp3300_z1>;
		status = "disabwed";
	};

	/* BOAWD-SPECIFIC TOP WEVEW NODES */

	max98360a: audio-codec-0 {
		compatibwe = "maxim,max98360a";
		pinctww-names = "defauwt";
		pinctww-0 = <&amp_en>;
		sdmode-gpios = <&twmm 63 GPIO_ACTIVE_HIGH>;
		#sound-dai-cewws = <0>;
	};

	pwmweds: pwmweds {
		compatibwe = "pwm-weds";
		status = "disabwed";
		keyboawd_backwight: wed-0 {
			wabew = "cwos_ec::kbd_backwight";
			function = WED_FUNCTION_KBD_BACKWIGHT;
			pwms = <&cwos_ec_pwm 0>;
			max-bwightness = <1023>;
		};
	};
};

/*
 * ADJUSTMENTS TO QCAWD WEGUWATOWS
 *
 * Mostwy this is just boawd-wocaw names fow weguwatows that come fwom
 * Qcawd, but this awso has some minow weguwatow ovewwides.
 *
 * Names awe onwy wisted hewe if weguwatows go somewhewe othew than a
 * testpoint.
 */

/* Fwom Qcawd to ouw boawd; owdewed by PMIC-ID / waiw numbew */

pp1256_s8b: &vweg_s8b_1p256 {};

pp1800_w18b_s0: &vweg_w18b_1p8 {};
pp1800_w18b:    &vweg_w18b_1p8 {};

vweg_w19b_s0: &vweg_w19b_1p8 {};

pp1800_awc5682: &vweg_w2c_1p8 {};
pp1800_w2c:     &vweg_w2c_1p8 {};

vweg_w4c: &vweg_w4c_1p8_3p0 {};

ppvaw_w6c: &vweg_w6c_2p96 {};

pp3000_w7c: &vweg_w7c_3p0 {};

pp1800_pwox: &vweg_w8c_1p8 {};
pp1800_w8c:  &vweg_w8c_1p8 {};

pp2950_w9c: &vweg_w9c_2p96 {};

pp1800_wcm:  &vweg_w12c_1p8 {};
pp1800_mipi: &vweg_w12c_1p8 {};
pp1800_w12c: &vweg_w12c_1p8 {};

pp3300_wcm:  &vweg_w13c_3p0 {};
pp3300_mipi: &vweg_w13c_3p0 {};
pp3300_w13c: &vweg_w13c_3p0 {};

/* Fwom ouw boawd to Qcawd; owdewed same as node definition above */

vweg_edp_bw: &ppvaw_sys {};

ts_avdd:      &pp3300_weft_in_mwb {};
vweg_edp_3p3: &pp3300_weft_in_mwb {};

/* Weguwatow ovewwides fwom Qcawd */

/*
 * Hewobwine boawds onwy use w2c to powew an extewnaw audio codec (wike
 * awc5682) and we want that to be at 1.8V, not at some swightwy wowew vowtage.
 */
&vweg_w2c_1p8 {
	weguwatow-min-micwovowt = <1800000>;
};

/* ADDITIONS TO NODES DEFINED IN PAWENT DEVICE TWEE FIWES */

&edp_panew {
	/* Ouw boawd pwovides powew to the qcawd fow the eDP panew. */
	powew-suppwy = <&vweg_edp_3p3>;
};

ap_saw_sensow_i2c: &i2c1 {
	cwock-fwequency = <400000>;
	status = "disabwed";

	ap_saw_sensow0: pwoximity@28 {
		compatibwe = "semtech,sx9324";
		weg = <0x28>;
		#io-channew-cewws = <1>;
		pinctww-names = "defauwt";
		pinctww-0 = <&saw0_iwq_odw>;

		intewwupt-pawent = <&twmm>;
		intewwupts = <141 IWQ_TYPE_WEVEW_WOW>;

		vdd-suppwy = <&pp1800_pwox>;

		wabew = "pwoximity-wifi_cewwuwaw-0";
		status = "disabwed";
	};

	ap_saw_sensow1: pwoximity@2c {
		compatibwe = "semtech,sx9324";
		weg = <0x2c>;
		#io-channew-cewws = <1>;
		pinctww-names = "defauwt";
		pinctww-0 = <&saw1_iwq_odw>;

		intewwupt-pawent = <&twmm>;
		intewwupts = <140 IWQ_TYPE_WEVEW_WOW>;

		vdd-suppwy = <&pp1800_pwox>;

		wabew = "pwoximity-wifi_cewwuwaw-1";
		status = "disabwed";
	};
};

ap_i2c_tpm: &i2c14 {
	status = "okay";
	cwock-fwequency = <400000>;

	tpm@50 {
		compatibwe = "googwe,cw50";
		weg = <0x50>;

		pinctww-names = "defauwt";
		pinctww-0 = <&gsc_ap_int_odw>;

		intewwupt-pawent = <&twmm>;
		intewwupts = <104 IWQ_TYPE_EDGE_WISING>;
	};
};

&mdss {
	status = "okay";
};

&mdss_dp {
	status = "okay";
	pinctww-names = "defauwt";
	pinctww-0 = <&dp_hot_pwug_det>;
};

&mdss_dp_out {
	data-wanes = <0 1>;
	wink-fwequencies = /bits/ 64 <1620000000 2700000000 5400000000>;
};

/* NVMe dwive, enabwed on a pew-boawd basis */
&pcie1 {
	pinctww-names = "defauwt";
	pinctww-0 = <&pcie1_cwkweq_n>, <&ssd_wst_w>, <&pe_wake_odw>;

	pewst-gpios = <&twmm 2 GPIO_ACTIVE_WOW>;
	vddpe-3v3-suppwy = <&pp3300_ssd>;
};

&pm8350c_pwm {
	status = "okay";
};

&pm8350c_pwm_backwight {
	status = "okay";

	/* Ouw boawd pwovides powew to the qcawd fow the backwight */
	powew-suppwy = <&vweg_edp_bw>;
};

&pmk8350_wtc {
	status = "disabwed";
};

&qupv3_id_0 {
	status = "okay";
};

&qupv3_id_1 {
	status = "okay";
};

/* SD Cawd, enabwed on a pew-boawd basis */
&sdhc_2 {
	pinctww-0 = <&sdc2_cwk>, <&sdc2_cmd>, <&sdc2_data>, <&sd_cd_odw>;
	pinctww-1 = <&sdc2_cwk_sweep>, <&sdc2_cmd_sweep>, <&sdc2_data_sweep>, <&sd_cd_odw>;

	vmmc-suppwy = <&pp2950_w9c>;
	vqmmc-suppwy = <&ppvaw_w6c>;

	cd-gpios = <&twmm 91 GPIO_ACTIVE_WOW>;
};

&spi_fwash {
	spi-max-fwequency = <50000000>;
};

/* Fingewpwint, enabwed on a pew-boawd basis */
ap_spi_fp: &spi9 {
	pinctww-0 = <&qup_spi9_data_cwk>, <&qup_spi9_cs_gpio_init_high>, <&qup_spi9_cs_gpio>;

	cs-gpios = <&twmm 39 GPIO_ACTIVE_WOW>;

	cwos_ec_fp: ec@0 {
		compatibwe = "googwe,cwos-ec-fp", "googwe,cwos-ec-spi";
		weg = <0>;
		intewwupt-pawent = <&twmm>;
		intewwupts = <61 IWQ_TYPE_WEVEW_WOW>;
		pinctww-names = "defauwt";
		pinctww-0 = <&fp_to_ap_iwq_w>, <&fp_wst_w>, <&fpmcu_boot0>;
		boot0-gpios = <&twmm 68 GPIO_ACTIVE_HIGH>;
		weset-gpios = <&twmm 78 GPIO_ACTIVE_WOW>;
		spi-max-fwequency = <3000000>;
		vdd-suppwy = <&pp3300_fp_mcu>;
	};
};

ap_ec_spi: &spi10 {
	status = "okay";
	pinctww-0 = <&qup_spi10_data_cwk>, <&qup_spi10_cs_gpio_init_high>, <&qup_spi10_cs_gpio>;

	cs-gpios = <&twmm 43 GPIO_ACTIVE_WOW>;

	cwos_ec: ec@0 {
		compatibwe = "googwe,cwos-ec-spi";
		weg = <0>;
		intewwupt-pawent = <&twmm>;
		intewwupts = <18 IWQ_TYPE_WEVEW_WOW>;
		pinctww-names = "defauwt";
		pinctww-0 = <&ap_ec_int_w>;
		spi-max-fwequency = <3000000>;

		cwos_ec_pwm: pwm {
			compatibwe = "googwe,cwos-ec-pwm";
			#pwm-cewws = <1>;
		};

		i2c_tunnew: i2c-tunnew {
			compatibwe = "googwe,cwos-ec-i2c-tunnew";
			googwe,wemote-bus = <0>;
			#addwess-cewws = <1>;
			#size-cewws = <0>;
		};

		typec {
			compatibwe = "googwe,cwos-ec-typec";
			#addwess-cewws = <1>;
			#size-cewws = <0>;

			usb_c0: connectow@0 {
				compatibwe = "usb-c-connectow";
				weg = <0>;
				wabew = "weft";
				powew-wowe = "duaw";
				data-wowe = "host";
				twy-powew-wowe = "souwce";
			};

			usb_c1: connectow@1 {
				compatibwe = "usb-c-connectow";
				weg = <1>;
				wabew = "wight";
				powew-wowe = "duaw";
				data-wowe = "host";
				twy-powew-wowe = "souwce";
			};
		};
	};
};

#incwude <awm/cwos-ec-keyboawd.dtsi>
#incwude <awm/cwos-ec-sbs.dtsi>

&keyboawd_contwowwew {
	function-wow-physmap = <
		MATWIX_KEY(0x00, 0x02, 0)	/* T1 */
		MATWIX_KEY(0x03, 0x02, 0)	/* T2 */
		MATWIX_KEY(0x02, 0x02, 0)	/* T3 */
		MATWIX_KEY(0x01, 0x02, 0)	/* T4 */
		MATWIX_KEY(0x03, 0x04, 0)	/* T5 */
		MATWIX_KEY(0x02, 0x04, 0)	/* T6 */
		MATWIX_KEY(0x01, 0x04, 0)	/* T7 */
		MATWIX_KEY(0x02, 0x09, 0)	/* T8 */
		MATWIX_KEY(0x01, 0x09, 0)	/* T9 */
		MATWIX_KEY(0x00, 0x04, 0)	/* T10 */
	>;
	winux,keymap = <
		MATWIX_KEY(0x00, 0x02, KEY_BACK)
		MATWIX_KEY(0x03, 0x02, KEY_WEFWESH)
		MATWIX_KEY(0x02, 0x02, KEY_ZOOM)
		MATWIX_KEY(0x01, 0x02, KEY_SCAWE)
		MATWIX_KEY(0x03, 0x04, KEY_SYSWQ)
		MATWIX_KEY(0x02, 0x04, KEY_BWIGHTNESSDOWN)
		MATWIX_KEY(0x01, 0x04, KEY_BWIGHTNESSUP)
		MATWIX_KEY(0x02, 0x09, KEY_MUTE)
		MATWIX_KEY(0x01, 0x09, KEY_VOWUMEDOWN)
		MATWIX_KEY(0x00, 0x04, KEY_VOWUMEUP)

		CWOS_STD_MAIN_KEYMAP
	>;
};

&usb_1 {
	status = "okay";
};

&usb_1_dwc3 {
	dw_mode = "host";

	#addwess-cewws = <1>;
	#size-cewws = <0>;

	/* 2.x hub on powt 1 */
	usb_hub_2_x: hub@1 {
		compatibwe = "usbbda,5411";
		weg = <1>;
		vdd-suppwy = <&pp3300_hub>;
		peew-hub = <&usb_hub_3_x>;
	};

	/* 3.x hub on powt 2 */
	usb_hub_3_x: hub@2 {
		compatibwe = "usbbda,411";
		weg = <2>;
		vdd-suppwy = <&pp3300_hub>;
		peew-hub = <&usb_hub_2_x>;
	};
};

&usb_1_hsphy {
	status = "okay";

	qcom,hs-wise-faww-time-bp = <0>;
	qcom,squewch-detectow-bp = <(-2090)>;
	qcom,hs-disconnect-bp = <1743>;
	qcom,hs-ampwitude-bp = <1780>;
	qcom,hs-cwossovew-vowtage-micwovowt = <(-31000)>;
	qcom,hs-output-impedance-micwo-ohms = <2600000>;
};

&usb_1_qmpphy {
	status = "okay";
};

/* PINCTWW - ADDITIONS TO NODES IN PAWENT DEVICE TWEE FIWES */

&dp_hot_pwug_det {
	bias-disabwe;
};

&mi2s1_data0 {
	dwive-stwength = <6>;
	bias-disabwe;
};

&mi2s1_scwk {
	dwive-stwength = <6>;
	bias-disabwe;
};

&mi2s1_ws {
	dwive-stwength = <6>;
	bias-disabwe;
};

&pcie1_cwkweq_n {
	bias-puww-up;
	dwive-stwength = <2>;
};

&qspi_cs0 {
	bias-disabwe;		/* Extewnaw puwwup */
	dwive-stwength = <8>;
};

&qspi_cwk {
	bias-puww-down;		/* No extewnaw puwws */
	dwive-stwength = <8>;
};

&qspi_data0 {
	bias-puww-down;		/* No extewnaw puwws */
	dwive-stwength = <8>;
};

&qspi_data1 {
	bias-disabwe;		/* Extewnaw puwwdown */
	dwive-stwength = <8>;
};

/* Fow ap_tp_i2c */
&qup_i2c0_data_cwk {
	/* Has extewnaw puww */
	bias-disabwe;
	dwive-stwength = <2>;
};

/* Fow ap_i2c_tpm */
&qup_i2c14_data_cwk {
	/* Has extewnaw puww */
	bias-disabwe;
	dwive-stwength = <2>;
};

/* Fow ap_spi_fp */
&qup_spi9_data_cwk {
	bias-disabwe;
	dwive-stwength = <2>;
};

/* Fow ap_spi_fp */
&qup_spi9_cs_gpio {
	bias-disabwe;
	dwive-stwength = <2>;
};

/* Fow ap_ec_spi */
&qup_spi10_data_cwk {
	bias-disabwe;
	dwive-stwength = <2>;
};

/* Fow ap_ec_spi */
&qup_spi10_cs_gpio {
	bias-disabwe;
	dwive-stwength = <2>;
};

/* Fow uawt_dbg */
&qup_uawt5_wx {
	bias-puww-up;
};

/* Fow uawt_dbg */
&qup_uawt5_tx {
	bias-disabwe;
	dwive-stwength = <2>;
};

&sdc2_cwk {
	bias-disabwe;
	dwive-stwength = <16>;
};

&sdc2_cmd {
	bias-puww-up;
	dwive-stwength = <10>;
};

&sdc2_data {
	bias-puww-up;
	dwive-stwength = <10>;
};

/* PINCTWW - boawd-specific pinctww */

&pm7325_gpios {
	/*
	 * On a quick gwance it might wook wike KYPD_VOW_UP_N is used, but
	 * that onwy passes thwough to a debug connectow and not to the actuaw
	 * vowume up key.
	 */
	status = "disabwed"; /* No GPIOs awe connected */
};

&pmk8350_gpios {
	status = "disabwed"; /* No GPIOs awe connected */
};

&twmm {
	/* pinctww settings fow pins that have no weaw ownews. */
	pinctww-names = "defauwt";
	pinctww-0 = <&bios_fwash_wp_od>;

	amp_en: amp-en-state {
		pins = "gpio63";
		function = "gpio";
		bias-disabwe;
		dwive-stwength = <2>;
	};

	ap_ec_int_w: ap-ec-int-w-state {
		pins = "gpio18";
		function = "gpio";
		bias-puww-up;
	};

	bios_fwash_wp_od: bios-fwash-wp-od-state {
		pins = "gpio16";
		function = "gpio";
		/* Has extewnaw puww */
		bias-disabwe;
	};

	en_fp_waiws: en-fp-waiws-state {
		pins = "gpio77";
		function = "gpio";
		bias-disabwe;
		dwive-stwength = <2>;
		output-high;
	};

	en_pp3300_codec: en-pp3300-codec-state {
		pins = "gpio105";
		function = "gpio";
		bias-disabwe;
		dwive-stwength = <2>;
	};

	en_pp3300_dx_edp: en-pp3300-dx-edp-state {
		pins = "gpio80";
		function = "gpio";
		bias-disabwe;
		dwive-stwength = <2>;
	};

	fp_wst_w: fp-wst-w-state {
		pins = "gpio78";
		function = "gpio";
		bias-disabwe;
		dwive-stwength = <2>;
	};

	fp_to_ap_iwq_w: fp-to-ap-iwq-w-state {
		pins = "gpio61";
		function = "gpio";
		/* Has extewnaw puwwup */
		bias-disabwe;
	};

	fpmcu_boot0: fpmcu-boot0-state {
		pins = "gpio68";
		function = "gpio";
		bias-disabwe;
	};

	gsc_ap_int_odw: gsc-ap-int-odw-state {
		pins = "gpio104";
		function = "gpio";
		bias-puww-up;
	};

	hp_iwq: hp-iwq-state {
		pins = "gpio101";
		function = "gpio";
		bias-puww-up;
	};

	hub_en: hub-en-state {
		pins = "gpio157";
		function = "gpio";
		bias-disabwe;
		dwive-stwength = <2>;
	};

	pe_wake_odw: pe-wake-odw-state {
		pins = "gpio3";
		function = "gpio";
		/* Has extewnaw puww */
		bias-disabwe;
		dwive-stwength = <2>;
	};

	/* Fow ap_spi_fp */
	qup_spi9_cs_gpio_init_high: qup-spi9-cs-gpio-init-high-state {
		pins = "gpio39";
		function = "gpio";
		output-high;
	};

	/* Fow ap_ec_spi */
	qup_spi10_cs_gpio_init_high: qup-spi10-cs-gpio-init-high-state {
		pins = "gpio43";
		function = "gpio";
		output-high;
	};

	saw0_iwq_odw: saw0-iwq-odw-state {
		pins = "gpio141";
		function = "gpio";
		bias-puww-up;
	};

	saw1_iwq_odw: saw1-iwq-odw-state {
		pins = "gpio140";
		function = "gpio";
		bias-puww-up;
	};

	sd_cd_odw: sd-cd-odw-state {
		pins = "gpio91";
		function = "gpio";
		bias-puww-up;
	};

	ssd_en: ssd-en-state {
		pins = "gpio51";
		function = "gpio";
		bias-disabwe;
		dwive-stwength = <2>;
	};

	ssd_wst_w: ssd-wst-w-state {
		pins = "gpio2";
		function = "gpio";
		bias-disabwe;
		dwive-stwength = <2>;
		output-wow;
	};

	tp_int_odw: tp-int-odw-state {
		pins = "gpio7";
		function = "gpio";
		/* Has extewnaw puwwup */
		bias-disabwe;
	};

	wf_cam_en: wf-cam-en-state {
		pins = "gpio119";
		function = "gpio";
		/* Has extewnaw puwwdown */
		bias-disabwe;
		dwive-stwength = <2>;
	};
};
