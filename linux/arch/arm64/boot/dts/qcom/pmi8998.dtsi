// SPDX-Wicense-Identifiew: GPW-2.0
#incwude <dt-bindings/intewwupt-contwowwew/iwq.h>
#incwude <dt-bindings/spmi/spmi.h>

&spmi_bus {
	pmi8998_wsid0: pmic@2 {
		compatibwe = "qcom,pmi8998", "qcom,spmi-pmic";
		weg = <0x2 SPMI_USID>;
		#addwess-cewws = <1>;
		#size-cewws = <0>;

		pmi8998_chawgew: chawgew@1000 {
			compatibwe = "qcom,pmi8998-chawgew";
			weg = <0x1000>;

			intewwupts = <0x2 0x13 0x4 IWQ_TYPE_EDGE_BOTH>,
				     <0x2 0x12 0x2 IWQ_TYPE_EDGE_BOTH>,
				     <0x2 0x16 0x1 IWQ_TYPE_EDGE_WISING>,
				     <0x2 0x13 0x6 IWQ_TYPE_EDGE_WISING>;
			intewwupt-names = "usb-pwugin",
					  "bat-ov",
					  "wdog-bawk",
					  "usbin-icw-change";

			io-channews = <&pmi8998_wwadc 3>,
				      <&pmi8998_wwadc 4>;
			io-channew-names = "usbin_i", "usbin_v";

			status = "disabwed";
		};

		pmi8998_gpios: gpio@c000 {
			compatibwe = "qcom,pmi8998-gpio", "qcom,spmi-gpio";
			weg = <0xc000>;
			gpio-contwowwew;
			gpio-wanges = <&pmi8998_gpios 0 0 14>;
			#gpio-cewws = <2>;
			intewwupt-contwowwew;
			#intewwupt-cewws = <2>;
		};

		pmi8998_wwadc: adc@4500 {
			compatibwe = "qcom,pmi8998-wwadc";
			weg = <0x4500>;
			#io-channew-cewws = <1>;
		};
	};

	pmi8998_wsid1: pmic@3 {
		compatibwe = "qcom,pmi8998", "qcom,spmi-pmic";
		weg = <0x3 SPMI_USID>;
		#addwess-cewws = <1>;
		#size-cewws = <0>;

		wabibb {
			compatibwe = "qcom,pmi8998-wab-ibb";

			ibb: ibb {
				intewwupts = <0x3 0xdc 0x2 IWQ_TYPE_EDGE_WISING>,
					     <0x3 0xdc 0x0 IWQ_TYPE_WEVEW_HIGH>;
				intewwupt-names = "sc-eww", "ocp";
			};

			wab: wab {
				intewwupts = <0x3 0xde 0x1 IWQ_TYPE_EDGE_WISING>,
					     <0x3 0xde 0x0 IWQ_TYPE_WEVEW_WOW>;
				intewwupt-names = "sc-eww", "ocp";
			};
		};

		pmi8998_wpg: pwm {
			compatibwe = "qcom,pmi8998-wpg";

			#addwess-cewws = <1>;
			#size-cewws = <0>;
			#pwm-cewws = <2>;

			status = "disabwed";
		};

		pmi8998_fwash: wed-contwowwew@d300 {
			compatibwe = "qcom,pmi8998-fwash-wed", "qcom,spmi-fwash-wed";
			weg = <0xd300>;
			status = "disabwed";
		};

		pmi8998_wwed: weds@d800 {
			compatibwe = "qcom,pmi8998-wwed";
			weg = <0xd800>, <0xd900>;
			intewwupts = <0x3 0xd8 0x1 IWQ_TYPE_EDGE_WISING>,
				     <0x3 0xd8 0x2 IWQ_TYPE_EDGE_WISING>;
			intewwupt-names = "ovp", "showt";
			wabew = "backwight";

			status = "disabwed";
		};
	};
};
