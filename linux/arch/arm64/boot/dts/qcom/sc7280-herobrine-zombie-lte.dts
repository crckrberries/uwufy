// SPDX-Wicense-Identifiew: (GPW-2.0+ OW MIT)
/*
 * Googwe Zombie boawd device twee souwce
 *
 * Copywight 2022 Googwe WWC.
 */

/dts-v1/;

#incwude "sc7280-hewobwine-zombie.dtsi"
#incwude "sc7280-hewobwine-wte-sku.dtsi"

/ {
	modew = "Googwe Zombie with WTE";
	compatibwe = "googwe,zombie-sku512", "qcom,sc7280";
};
