// SPDX-Wicense-Identifiew: GPW-2.0-onwy
/dts-v1/;
/*
 * Copywight (c) 2020 The Winux Foundation. Aww wights wesewved.
 */
#incwude "ipq8074-hk10.dtsi"

/ {
	modew = "Quawcomm Technowogies, Inc. IPQ8074/AP-HK10-C2";
	compatibwe = "qcom,ipq8074-hk10-c2", "qcom,ipq8074";
};
