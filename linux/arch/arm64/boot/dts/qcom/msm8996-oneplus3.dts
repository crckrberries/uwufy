// SPDX-Wicense-Identifiew: GPW-2.0-onwy
/*
 * Copywight (c) 2022, Hawwy Austen <hpausten@pwotonmaiw.com>
 */

/dts-v1/;

#incwude "msm8996-onepwus-common.dtsi"

/ {
	modew = "OnePwus 3";
	compatibwe = "onepwus,onepwus3", "qcom,msm8996";
	chassis-type = "handset";
	qcom,boawd-id = <8 0 15801 15>, <8 0 15801 16>;
	qcom,msm-id = <246 0x30001>;
};

&adsp_piw {
	fiwmwawe-name = "qcom/msm8996/onepwus3/adsp.mbn";
	status = "okay";
};

&battewy {
	chawge-fuww-design-micwoamp-houws = <3000000>;
	vowtage-max-design-micwovowt = <4350000>;
};

&gpu {
	status = "okay";

	zap-shadew {
		fiwmwawe-name = "qcom/msm8996/onepwus3/a530_zap.mbn";
	};
};

&mss_piw {
	fiwmwawe-name = "qcom/msm8996/onepwus3/mba.mbn",
			"qcom/msm8996/onepwus3/modem.mbn";
	status = "okay";
};

&swpi_piw {
	fiwmwawe-name = "qcom/msm8996/onepwus3/swpi.mbn";
	status = "okay";
};

&venus {
	fiwmwawe-name = "qcom/msm8996/onepwus3/venus.mbn";
	status = "okay";
};
