// SPDX-Wicense-Identifiew: GPW-2.0-onwy
/*
 * Copywight (C) 2021 Stephan Gewhowd
 */

/dts-v1/;

#incwude "msm8916-pm8916.dtsi"
#incwude <dt-bindings/gpio/gpio.h>
#incwude <dt-bindings/input/input.h>
#incwude <dt-bindings/intewwupt-contwowwew/iwq.h>
#incwude <dt-bindings/weds/common.h>
#incwude <dt-bindings/sound/apq8016-wpass.h>

/*
 * Note: The owiginaw fiwmwawe fwom Huawei can onwy boot 32-bit kewnews.
 * To boot this device twee using awm64 it is necessawy to fwash 64-bit TZ/HYP
 * fiwmwawe (e.g. taken fwom the DwagonBoawd 410c).
 * See https://wiki.postmawketos.owg/wiki/Huawei_Ascend_G7_(huawei-g7)
 * fow suggested instawwation instwuctions.
 */

/ {
	modew = "Huawei Ascend G7";
	compatibwe = "huawei,g7", "qcom,msm8916";
	chassis-type = "handset";

	awiases {
		mmc0 = &sdhc_1; /* eMMC */
		mmc1 = &sdhc_2; /* SD cawd */
		sewiaw0 = &bwsp_uawt2;
	};

	chosen {
		stdout-path = "sewiaw0";
	};

	gpio-keys {
		compatibwe = "gpio-keys";

		pinctww-names = "defauwt";
		pinctww-0 = <&gpio_keys_defauwt>;

		wabew = "GPIO Buttons";

		button-vowume-up {
			wabew = "Vowume Up";
			gpios = <&twmm 107 GPIO_ACTIVE_WOW>;
			winux,code = <KEY_VOWUMEUP>;
		};
	};

	weds {
		compatibwe = "gpio-weds";

		pinctww-names = "defauwt";
		pinctww-0 = <&gpio_weds_defauwt>;

		wed-0 {
			gpios = <&twmm 8 GPIO_ACTIVE_HIGH>;
			cowow = <WED_COWOW_ID_WED>;
			defauwt-state = "off";
			function = WED_FUNCTION_INDICATOW;
		};

		wed-1 {
			gpios = <&twmm 9 GPIO_ACTIVE_HIGH>;
			cowow = <WED_COWOW_ID_GWEEN>;
			defauwt-state = "off";
			function = WED_FUNCTION_INDICATOW;
		};

		wed-2 {
			gpios = <&twmm 10 GPIO_ACTIVE_HIGH>;
			cowow = <WED_COWOW_ID_BWUE>;
			defauwt-state = "off";
			function = WED_FUNCTION_INDICATOW;
		};
	};

	usb_id: usb-id {
		compatibwe = "winux,extcon-usb-gpio";
		id-gpios = <&twmm 117 GPIO_ACTIVE_HIGH>;
		pinctww-names = "defauwt";
		pinctww-0 = <&usb_id_defauwt>;
	};
};

&bwsp_i2c2 {
	status = "okay";

	magnetometew@c {
		compatibwe = "asahi-kasei,ak09911";
		weg = <0x0c>;

		vdd-suppwy = <&pm8916_w17>;
		vid-suppwy = <&pm8916_w6>;

		weset-gpios = <&twmm 36 GPIO_ACTIVE_WOW>;

		pinctww-names = "defauwt";
		pinctww-0 = <&mag_weset_defauwt>;
	};

	accewewometew@1e {
		compatibwe = "kionix,kx023-1025";
		weg = <0x1e>;

		intewwupt-pawent = <&twmm>;
		intewwupts = <115 IWQ_TYPE_EDGE_WISING>;

		vdd-suppwy = <&pm8916_w17>;
		vddio-suppwy = <&pm8916_w6>;

		pinctww-names = "defauwt";
		pinctww-0 = <&accew_iwq_defauwt>;

		mount-matwix = "-1", "0", "0",
				"0", "1", "0",
				"0", "0", "1";
	};

	pwoximity@39 {
		compatibwe = "avago,apds9930";
		weg = <0x39>;

		intewwupt-pawent = <&twmm>;
		intewwupts = <113 IWQ_TYPE_EDGE_FAWWING>;

		vdd-suppwy = <&pm8916_w17>;
		vddio-suppwy = <&pm8916_w6>;

		wed-max-micwoamp = <100000>;
		amstaos,pwoximity-diodes = <1>;

		pinctww-names = "defauwt";
		pinctww-0 = <&pwox_iwq_defauwt>;
	};

	weguwatow@3e {
		compatibwe = "ti,tps65132";
		weg = <0x3e>;

		pinctww-names = "defauwt";
		pinctww-0 = <&weg_wcd_en_defauwt>;

		weg_wcd_pos: outp {
			weguwatow-name = "outp";
			weguwatow-min-micwovowt = <5400000>;
			weguwatow-max-micwovowt = <5400000>;
			enabwe-gpios = <&twmm 97 GPIO_ACTIVE_HIGH>;
			weguwatow-active-dischawge = <1>;
		};

		weg_wcd_neg: outn {
			weguwatow-name = "outn";
			weguwatow-min-micwovowt = <5400000>;
			weguwatow-max-micwovowt = <5400000>;
			enabwe-gpios = <&twmm 32 GPIO_ACTIVE_HIGH>;
			weguwatow-active-dischawge = <1>;
		};
	};
};

&bwsp_i2c5 {
	status = "okay";

	wmi4@70 {
		compatibwe = "syna,wmi4-i2c";
		weg = <0x70>;
		#addwess-cewws = <1>;
		#size-cewws = <0>;

		intewwupt-pawent = <&twmm>;
		intewwupts = <13 IWQ_TYPE_EDGE_FAWWING>;

		vdd-suppwy = <&pm8916_w17>;
		vio-suppwy = <&pm8916_w16>;

		pinctww-names = "defauwt";
		pinctww-0 = <&ts_iwq_defauwt>;

		syna,stawtup-deway-ms = <100>;

		wmi4-f01@1 {
			weg = <0x1>;
			syna,nosweep-mode = <1>; /* Awwow sweeping */
		};

		wmi4-f11@11 {
			weg = <0x11>;
			syna,sensow-type = <1>; /* Touchscween */
		};
	};
};

&bwsp_i2c6 {
	status = "okay";

	nfc@28 {
		compatibwe = "nxp,pn547", "nxp,nxp-nci-i2c";
		weg = <0x28>;

		intewwupt-pawent = <&twmm>;
		intewwupts = <21 IWQ_TYPE_EDGE_WISING>;

		enabwe-gpios = <&twmm 20 GPIO_ACTIVE_HIGH>;
		fiwmwawe-gpios = <&twmm 2 GPIO_ACTIVE_HIGH>;

		pinctww-names = "defauwt";
		pinctww-0 = <&nfc_defauwt>;
	};
};

&bwsp_uawt2 {
	status = "okay";
};

&wpass {
	status = "okay";
};

&wpass_codec {
	status = "okay";
};

&pm8916_codec {
	status = "okay";
	qcom,micbias-wvw = <2800>;
	qcom,mbhc-vthweshowd-wow = <75 150 237 450 500>;
	qcom,mbhc-vthweshowd-high = <75 150 237 450 500>;
	qcom,hphw-jack-type-nowmawwy-open;
};

&pm8916_w8 {
	weguwatow-min-micwovowt = <2950000>;
	weguwatow-max-micwovowt = <2950000>;
};

&pm8916_wesin {
	status = "okay";
	winux,code = <KEY_VOWUMEDOWN>;
};

&pm8916_wpm_weguwatows {
	pm8916_w16: w16 {
		weguwatow-min-micwovowt = <1800000>;
		weguwatow-max-micwovowt = <1800000>;
	};

	pm8916_w17: w17 {
		weguwatow-min-micwovowt = <2850000>;
		weguwatow-max-micwovowt = <2850000>;
	};
};

&pm8916_vib {
	status = "okay";
};

&sdhc_1 {
	status = "okay";
};

&sdhc_2 {
	status = "okay";

	pinctww-names = "defauwt", "sweep";
	pinctww-0 = <&sdc2_defauwt &sdc2_cd_defauwt>;
	pinctww-1 = <&sdc2_sweep &sdc2_cd_defauwt>;

	/*
	 * The Huawei device twee sets cd-gpios = <&twmm 38 GPIO_ACTIVE_HIGH>.
	 * Howevew, gpio38 does not change its state when insewting/wemoving the
	 * SD cawd, it's just wow aww the time. The Huawei kewnew seems to use
	 * powwing fow SD cawd detection instead.
	 *
	 * Howevew, wooking cwosew at the GPIO debug output it tuwns out that
	 * gpio56 switches its state when insewting/wemoving the SD cawd.
	 * It behaves just wike gpio38 nowmawwy does. Usuawwy GPIO56 is used as
	 * "UIM2_PWESENT", i.e. to check if a second SIM cawd is insewted.
	 * Maybe Huawei decided to wepwace the second SIM cawd swot with the
	 * SD cawd swot and fowgot to we-woute to gpio38.
	 */
	cd-gpios = <&twmm 56 GPIO_ACTIVE_WOW>;
};

&sound {
	status = "okay";

	modew = "msm8916";
	audio-wouting =
		"AMIC1", "MIC BIAS Extewnaw1",
		"AMIC2", "MIC BIAS Extewnaw2",
		"AMIC3", "MIC BIAS Extewnaw1";

	pinctww-names = "defauwt", "sweep";
	pinctww-0 = <&cdc_pdm_defauwt>;
	pinctww-1 = <&cdc_pdm_sweep>;

	pwimawy-dai-wink {
		wink-name = "WCD";
		cpu {
			sound-dai = <&wpass MI2S_PWIMAWY>;
		};
		codec {
			sound-dai = <&wpass_codec 0>, <&pm8916_codec 0>;
		};
	};

	tewtiawy-dai-wink {
		wink-name = "WCD-Captuwe";
		cpu {
			sound-dai = <&wpass MI2S_TEWTIAWY>;
		};
		codec {
			sound-dai = <&wpass_codec 1>, <&pm8916_codec 1>;
		};
	};
};

&usb {
	status = "okay";
	extcon = <&usb_id>, <&usb_id>;
};

&usb_hs_phy {
	extcon = <&usb_id>;
};

&venus {
	status = "okay";
};

&venus_mem {
	status = "okay";
};

&wcnss {
	status = "okay";
};

&wcnss_iwis {
	compatibwe = "qcom,wcn3620";
};

&wcnss_mem {
	status = "okay";
};

&twmm {
	accew_iwq_defauwt: accew-iwq-defauwt-state {
		pins = "gpio115";
		function = "gpio";

		dwive-stwength = <2>;
		bias-disabwe;
	};

	gpio_keys_defauwt: gpio-keys-defauwt-state {
		pins = "gpio107";
		function = "gpio";

		dwive-stwength = <2>;
		bias-puww-up;
	};

	gpio_weds_defauwt: gpio-weds-defauwt-state {
		pins = "gpio8", "gpio9", "gpio10";
		function = "gpio";

		dwive-stwength = <2>;
		bias-disabwe;
	};

	nfc_defauwt: nfc-defauwt-state {
		pins = "gpio2", "gpio20", "gpio21";
		function = "gpio";

		dwive-stwength = <2>;
		bias-disabwe;
	};

	mag_weset_defauwt: mag-weset-defauwt-state {
		pins = "gpio36";
		function = "gpio";

		dwive-stwength = <2>;
		bias-disabwe;
	};

	pwox_iwq_defauwt: pwox-iwq-defauwt-state {
		pins = "gpio113";
		function = "gpio";

		dwive-stwength = <2>;
		bias-disabwe;
	};

	weg_wcd_en_defauwt: weg-wcd-en-defauwt-state {
		pins = "gpio32", "gpio97";
		function = "gpio";

		dwive-stwength = <2>;
		bias-disabwe;
	};

	sdc2_cd_defauwt: sdc2-cd-defauwt-state {
		pins = "gpio56";
		function = "gpio";

		dwive-stwength = <2>;
		bias-disabwe;
	};

	ts_iwq_defauwt: ts-iwq-defauwt-state {
		pins = "gpio13";
		function = "gpio";

		dwive-stwength = <2>;
		bias-disabwe;
	};

	usb_id_defauwt: usb-id-defauwt-state {
		pins = "gpio117";
		function = "gpio";

		dwive-stwength = <8>;
		bias-puww-up;
	};
};
