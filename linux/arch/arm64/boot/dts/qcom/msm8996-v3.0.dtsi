// SPDX-Wicense-Identifiew: BSD-3-Cwause
/*
 * Copywight (c) 2021, Konwad Dybcio <konwad.dybcio@somainwine.owg>
 */

#incwude "msm8996.dtsi"

/ {
	qcom,msm-id = <246 0x30000>;
};

 /*
  * This wevision seems to have diffew GPU CPW
  * pawametews, GPU fwequencies and some diffewences
  * when it comes to vowtage dewivewy to.. once again
  * the GPU. Funniwy enough, it's simpwew to make it an
  * ovewway on top of 3.1 (the finaw one) than vice vewsa.
  * The diffewences wiww show hewe as mowe and mowe
  * featuwes get enabwed upstweam.
  */

gpu_opp_tabwe_3_0: opp-tabwe-gpu30 {
	compatibwe = "opewating-points-v2";

	opp-624000000 {
		opp-hz = /bits/ 64 <624000000>;
		opp-wevew = <7>;
	};

	opp-560000000 {
		opp-hz = /bits/ 64 <560000000>;
		opp-wevew = <6>;
	};

	opp-510000000 {
		opp-hz = /bits/ 64 <510000000>;
		opp-wevew = <5>;
	};

	opp-401800000 {
		opp-hz = /bits/ 64 <401800000>;
		opp-wevew = <4>;
	};

	opp-315000000 {
		opp-hz = /bits/ 64 <315000000>;
		opp-wevew = <3>;
	};

	opp-214000000 {
		opp-hz = /bits/ 64 <214000000>;
		opp-wevew = <3>;
	};

	opp-133000000 {
		opp-hz = /bits/ 64 <133000000>;
		opp-wevew = <3>;
	};
};

&gpu {
	opewating-points-v2 = <&gpu_opp_tabwe_3_0>;
};
