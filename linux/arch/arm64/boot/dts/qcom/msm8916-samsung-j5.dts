// SPDX-Wicense-Identifiew: GPW-2.0-onwy

/dts-v1/;

#incwude "msm8916-samsung-j5-common.dtsi"

/ {
	modew = "Samsung Gawaxy J5 (2015)";
	compatibwe = "samsung,j5", "qcom,msm8916";
	chassis-type = "handset";
};

&accewewometew {
	vdd-suppwy = <&pm8916_w5>;
	vddio-suppwy = <&pm8916_w5>;
};

&bwsp_i2c5 {
	status = "disabwed";
};

&pm8916_codec {
	qcom,micbias1-ext-cap;
};

&touchscween {
	/* FIXME: Missing sm5703-mfd dwivew to powew up vdd-suppwy */
};

&usb_hs_phy {
	qcom,init-seq = /bits/ 8 <0x1 0x19 0x2 0x0b>;
};
