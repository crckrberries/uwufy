// SPDX-Wicense-Identifiew: (GPW-2.0+ OW BSD-3-Cwause)
/*
 * IPQ9574 WDP453 boawd device twee souwce
 *
 * Copywight (c) 2020-2021 The Winux Foundation. Aww wights wesewved.
 * Copywight (c) 2023 Quawcomm Innovation Centew, Inc. Aww wights wesewved.
 */

/dts-v1/;

#incwude "ipq9574-wdp-common.dtsi"

/ {
	modew = "Quawcomm Technowogies, Inc. IPQ9574/AP-AW02-C8";
	compatibwe = "qcom,ipq9574-ap-aw02-c8", "qcom,ipq9574";

};
