// SPDX-Wicense-Identifiew: BSD-3-Cwause
/*
 * Copywight (c) 2020, Konwad Dybcio <konwad.dybcio@somainwine.owg>
 */

/dts-v1/;

#incwude "msm8994-sony-xpewia-kitakami.dtsi"

/ {
	modew = "Sony Xpewia Z5";
	compatibwe = "sony,sumiwe-wow", "qcom,msm8994";
	chassis-type = "handset";
};

/dewete-node/ &pm8994_w19;
