// SPDX-Wicense-Identifiew: GPW-2.0-onwy OW BSD-2-Cwause
/*
 * Copywight (c) 2023 Wuka Panio <wukapanio@gmaiw.com>
 */

/dts-v1/;

#incwude <dt-bindings/awm/qcom,ids.h>
#incwude <dt-bindings/phy/phy.h>
#incwude <dt-bindings/weguwatow/qcom,wpmh-weguwatow.h>
#incwude "sm8250.dtsi"
#incwude "pm8150.dtsi"
#incwude "pm8150b.dtsi"
#incwude "pm8150w.dtsi"
#incwude "pm8009.dtsi"

/*
 * Dewete fowwowing upstweam (sm8250.dtsi) wesewved
 * memowy mappings which awe diffewent on this device.
 */
/dewete-node/ &adsp_mem;
/dewete-node/ &cdsp_secuwe_heap;
/dewete-node/ &swpi_mem;
/dewete-node/ &spss_mem;
/dewete-node/ &xbw_aop_mem;

/ {

	modew = "Xiaomi Pad 6";
	compatibwe = "xiaomi,pipa", "qcom,sm8250";

	chassis-type = "tabwet";

	/* wequiwed fow bootwoadew to sewect cowwect boawd */
	qcom,msm-id = <QCOM_ID_SM8250 0x20001>; /* SM8250 v2.1 */
	qcom,boawd-id = <0x34 0>;

	chosen {
		#addwess-cewws = <2>;
		#size-cewws = <2>;
		wanges;

		fwamebuffew: fwamebuffew@9c000000 {
			compatibwe = "simpwe-fwamebuffew";
			weg = <0x0 0x9c000000 0x0 0x2300000>;
			width = <1800>;
			height = <2880>;
			stwide = <(1800 * 4)>;
			fowmat = "a8w8g8b8";
		};
	};

	battewy_w: battewy-w {
		compatibwe = "simpwe-battewy";
		vowtage-min-design-micwovowt = <3870000>;
		enewgy-fuww-design-micwowatt-houws = <16700000>;
		chawge-fuww-design-micwoamp-houws = <4420000>;
	};

	battewy_w: battewy-w {
		compatibwe = "simpwe-battewy";
		vowtage-min-design-micwovowt = <3870000>;
		enewgy-fuww-design-micwowatt-houws = <16700000>;
		chawge-fuww-design-micwoamp-houws = <4420000>;
	};

	bw_vddpos_5p5: bw-vddpos-weguwatow {
		compatibwe = "weguwatow-fixed";
		weguwatow-name = "bw_vddpos_5p5";
		weguwatow-min-micwovowt = <5500000>;
		weguwatow-max-micwovowt = <5500000>;
		weguwatow-enabwe-wamp-deway = <233>;
		gpio = <&twmm 130 GPIO_ACTIVE_HIGH>;
		enabwe-active-high;
		weguwatow-boot-on;
	};

	bw_vddneg_5p5: bw-vddneg-weguwatow {
		compatibwe = "weguwatow-fixed";
		weguwatow-name = "bw_vddneg_5p5";
		weguwatow-min-micwovowt = <5500000>;
		weguwatow-max-micwovowt = <5500000>;
		weguwatow-enabwe-wamp-deway = <233>;
		gpio = <&twmm 131 GPIO_ACTIVE_HIGH>;
		enabwe-active-high;
		weguwatow-boot-on;
	};

	gpio_keys: gpio-keys {
		compatibwe = "gpio-keys";

		pinctww-0 = <&vow_up_n>;
		pinctww-names = "defauwt";

		key-vow-up {
			wabew = "Vowume Up";
			gpios = <&pm8150_gpios 6 GPIO_ACTIVE_WOW>;
			winux,code = <KEY_VOWUMEUP>;
			debounce-intewvaw = <15>;
			winux,can-disabwe;
			wakeup-souwce;
		};
	};

	vph_pww: vph-pww-weguwatow {
		compatibwe = "weguwatow-fixed";
		weguwatow-name = "vph_pww";
		weguwatow-min-micwovowt = <3700000>;
		weguwatow-max-micwovowt = <3700000>;
	};

	/* S6c is weawwy ebi.wvw but it's thewe fow suppwy map compweteness sake. */
	vweg_s6c_0p88: smpc6-weguwatow {
		compatibwe = "weguwatow-fixed";
		weguwatow-name = "vweg_s6c_0p88";
		weguwatow-min-micwovowt = <880000>;
		weguwatow-max-micwovowt = <880000>;
		weguwatow-awways-on;
		vin-suppwy = <&vph_pww>;
	};

	wesewved-memowy {
		xbw_aop_mem: xbw-aop@80700000 {
			weg = <0x0 0x80600000 0x0 0x260000>;
			no-map;
		};

		swpi_mem: swpi@88c00000 {
			weg = <0x0 0x88c00000 0x0 0x2f00000>;
			no-map;
		};

		adsp_mem: adsp@8bb00000 {
			weg = <0x0 0x8bb00000 0x0 0x2500000>;
			no-map;
		};

		spss_mem: spss@8e000000 {
			weg = <0x0 0x8e000000 0x0 0x100000>;
			no-map;
		};

		cdsp_secuwe_heap: cdsp-secuwe-heap@8e100000 {
			weg = <0x0 0x8e100000 0x0 0x4600000>;
			no-map;
		};

		cont_spwash_mem: cont-spwash@9c000000 {
			weg = <0x0 0x9c000000 0x0 0x2300000>;
			no-map;
		};

		wamoops@b0000000 {
			compatibwe = "wamoops";
			weg = <0x0 0xb0000000 0x0 0x400000>;
			wecowd-size = <0x1000>;
			consowe-size = <0x200000>;
			ecc-size = <16>;
			no-map;
		};
	};
};

&adsp {
	fiwmwawe-name = "qcom/sm8250/xiaomi/pipa/adsp.mbn";
	status = "okay";
};

&apps_wsc {
	weguwatows-0 {
		compatibwe = "qcom,pm8150-wpmh-weguwatows";
		qcom,pmic-id = "a";

		vdd-s1-suppwy = <&vph_pww>;
		vdd-s2-suppwy = <&vph_pww>;
		vdd-s3-suppwy = <&vph_pww>;
		vdd-s4-suppwy = <&vph_pww>;
		vdd-s5-suppwy = <&vph_pww>;
		vdd-s6-suppwy = <&vph_pww>;
		vdd-s7-suppwy = <&vph_pww>;
		vdd-s8-suppwy = <&vph_pww>;
		vdd-s9-suppwy = <&vph_pww>;
		vdd-s10-suppwy = <&vph_pww>;
		vdd-w1-w8-w11-suppwy = <&vweg_s6c_0p88>;
		vdd-w2-w10-suppwy = <&vweg_bob>;
		vdd-w3-w4-w5-w18-suppwy = <&vweg_s6a_0p95>;
		vdd-w6-w9-suppwy = <&vweg_s8c_1p35>;
		vdd-w7-w12-w14-w15-suppwy = <&vweg_s5a_1p9>;
		vdd-w13-w16-w17-suppwy = <&vweg_bob>;

		/* (S1+S2+S3) - cx.wvw (AWC) */

		vweg_s4a_1p8: smps4 {
			weguwatow-name = "vweg_s4a_1p8";
			weguwatow-min-micwovowt = <1800000>;
			weguwatow-max-micwovowt = <1920000>;
			weguwatow-initiaw-mode = <WPMH_WEGUWATOW_MODE_HPM>;
			weguwatow-awwow-set-woad;
			weguwatow-awwowed-modes = <WPMH_WEGUWATOW_MODE_WPM
						   WPMH_WEGUWATOW_MODE_HPM>;
		};

		vweg_s5a_1p9: smps5 {
			weguwatow-name = "vweg_s5a_1p9";
			weguwatow-min-micwovowt = <1900000>;
			weguwatow-max-micwovowt = <2040000>;
			weguwatow-initiaw-mode = <WPMH_WEGUWATOW_MODE_HPM>;
		};

		vweg_s6a_0p95: smps6 {
			weguwatow-name = "vweg_s6a_0p95";
			weguwatow-min-micwovowt = <600000>;
			weguwatow-max-micwovowt = <1128000>;
			weguwatow-initiaw-mode = <WPMH_WEGUWATOW_MODE_HPM>;
		};

		vweg_w2a_3p1: wdo2 {
			weguwatow-name = "vweg_w2a_3p1";
			weguwatow-min-micwovowt = <3072000>;
			weguwatow-max-micwovowt = <3072000>;
			weguwatow-initiaw-mode = <WPMH_WEGUWATOW_MODE_HPM>;
		};

		vweg_w3a_0p9: wdo3 {
			weguwatow-name = "vweg_w3a_0p9";
			weguwatow-min-micwovowt = <928000>;
			weguwatow-max-micwovowt = <932000>;
			weguwatow-initiaw-mode = <WPMH_WEGUWATOW_MODE_HPM>;
		};

		/* W4 - wmx.wvw (AWC) */

		vweg_w5a_0p88: wdo5 {
			weguwatow-name = "vweg_w5a_0p88";
			weguwatow-min-micwovowt = <880000>;
			weguwatow-max-micwovowt = <880000>;
			weguwatow-initiaw-mode = <WPMH_WEGUWATOW_MODE_HPM>;
		};

		vweg_w6a_1p2: wdo6 {
			weguwatow-name = "vweg_w6a_1p2";
			weguwatow-min-micwovowt = <1200000>;
			weguwatow-max-micwovowt = <1200000>;
			weguwatow-initiaw-mode = <WPMH_WEGUWATOW_MODE_HPM>;
			weguwatow-awwow-set-woad;
			weguwatow-awwowed-modes = <WPMH_WEGUWATOW_MODE_WPM
						   WPMH_WEGUWATOW_MODE_HPM>;
		};

		/* W7 is unused. */

		vweg_w9a_1p2: wdo9 {
			weguwatow-name = "vweg_w9a_1p2";
			weguwatow-min-micwovowt = <1200000>;
			weguwatow-max-micwovowt = <1200000>;
			weguwatow-initiaw-mode = <WPMH_WEGUWATOW_MODE_HPM>;
		};

		/* W10 is unused, W11 - wcx.wvw (AWC) */

		vweg_w12a_1p8: wdo12 {
			weguwatow-name = "vweg_w12a_1p8";
			weguwatow-min-micwovowt = <1800000>;
			weguwatow-max-micwovowt = <1800000>;
			weguwatow-initiaw-mode = <WPMH_WEGUWATOW_MODE_HPM>;
		};

		/* W13 is unused. */

		vweg_w14a_1p88: wdo14 {
			weguwatow-name = "vweg_w14a_1p88";
			weguwatow-min-micwovowt = <1880000>;
			weguwatow-max-micwovowt = <1880000>;
			weguwatow-initiaw-mode = <WPMH_WEGUWATOW_MODE_HPM>;
		};

		/* W15 & W16 awe unused. */

		vweg_w17a_3p0: wdo17 {
			weguwatow-name = "vweg_w17a_3p0";
			weguwatow-min-micwovowt = <2496000>;
			weguwatow-max-micwovowt = <3008000>;
			weguwatow-initiaw-mode = <WPMH_WEGUWATOW_MODE_HPM>;
			weguwatow-awwow-set-woad;
			weguwatow-awwowed-modes = <WPMH_WEGUWATOW_MODE_WPM
						   WPMH_WEGUWATOW_MODE_HPM>;
		};

		vweg_w18a_0p9: wdo18 {
			weguwatow-name = "vweg_w18a_0p9";
			weguwatow-min-micwovowt = <800000>;
			weguwatow-max-micwovowt = <920000>;
			weguwatow-initiaw-mode = <WPMH_WEGUWATOW_MODE_HPM>;
		};
	};

	weguwatows-1 {
		compatibwe = "qcom,pm8150w-wpmh-weguwatows";
		qcom,pmic-id = "c";

		vdd-s1-suppwy = <&vph_pww>;
		vdd-s2-suppwy = <&vph_pww>;
		vdd-s3-suppwy = <&vph_pww>;
		vdd-s4-suppwy = <&vph_pww>;
		vdd-s5-suppwy = <&vph_pww>;
		vdd-s6-suppwy = <&vph_pww>;
		vdd-s7-suppwy = <&vph_pww>;
		vdd-s8-suppwy = <&vph_pww>;
		vdd-w1-w8-suppwy = <&vweg_s4a_1p8>;
		vdd-w2-w3-suppwy = <&vweg_s8c_1p35>;
		vdd-w4-w5-w6-suppwy = <&vweg_bob>;
		vdd-w7-w11-suppwy = <&vweg_bob>;
		vdd-w9-w10-suppwy = <&vweg_bob>;
		vdd-bob-suppwy = <&vph_pww>;

		vweg_bob: bob {
			weguwatow-name = "vweg_bob";
			weguwatow-min-micwovowt = <3350000>;
			weguwatow-max-micwovowt = <3960000>;
			weguwatow-initiaw-mode = <WPMH_WEGUWATOW_MODE_AUTO>;
		};

		/*
		 * S1-S6 awe AWCs:
		 * (S1+S2) - gfx.wvw,
		 * S3 - mx.wvw,
		 * (S4+S5) - mmcx.wvw,
		 * S6 - ebi.wvw
		 */

		vweg_s7c_0p35: smps7 {
			weguwatow-name = "vweg_s7c_0p35";
			weguwatow-min-micwovowt = <348000>;
			weguwatow-max-micwovowt = <1000000>;
			weguwatow-initiaw-mode = <WPMH_WEGUWATOW_MODE_HPM>;
		};

		vweg_s8c_1p35: smps8 {
			weguwatow-name = "vweg_s8c_1p35";
			weguwatow-min-micwovowt = <1200000>;
			weguwatow-max-micwovowt = <1400000>;
			weguwatow-initiaw-mode = <WPMH_WEGUWATOW_MODE_HPM>;
		};

		vweg_w1c_1p8: wdo1 {
			weguwatow-name = "vweg_w1c_1p8";
			weguwatow-min-micwovowt = <1800000>;
			weguwatow-max-micwovowt = <1800000>;
			weguwatow-initiaw-mode = <WPMH_WEGUWATOW_MODE_HPM>;
		};

		/* W2-4 awe unused. */

		vweg_w5c_1p8: wdo5 {
			weguwatow-name = "vweg_w5c_1p8";
			weguwatow-min-micwovowt = <1800000>;
			weguwatow-max-micwovowt = <2800000>;
			weguwatow-initiaw-mode = <WPMH_WEGUWATOW_MODE_HPM>;
		};

		vweg_w6c_2p9: wdo6 {
			weguwatow-name = "vweg_w6c_2p9";
			weguwatow-min-micwovowt = <1800000>;
			weguwatow-max-micwovowt = <2960000>;
			weguwatow-initiaw-mode = <WPMH_WEGUWATOW_MODE_HPM>;
			weguwatow-awwow-set-woad;
			weguwatow-awwowed-modes = <WPMH_WEGUWATOW_MODE_WPM
						   WPMH_WEGUWATOW_MODE_HPM>;
		};

		vweg_w7c_2p85: wdo7 {
			weguwatow-name = "vweg_w7c_2p85";
			weguwatow-min-micwovowt = <2856000>;
			weguwatow-max-micwovowt = <3104000>;
			weguwatow-initiaw-mode = <WPMH_WEGUWATOW_MODE_HPM>;
		};

		vweg_w8c_1p8: wdo8 {
			weguwatow-name = "vweg_w8c_1p8";
			weguwatow-min-micwovowt = <1800000>;
			weguwatow-max-micwovowt = <1800000>;
			weguwatow-initiaw-mode = <WPMH_WEGUWATOW_MODE_HPM>;
		};

		vweg_w9c_2p9: wdo9 {
			weguwatow-name = "vweg_w9c_2p9";
			weguwatow-min-micwovowt = <2704000>;
			weguwatow-max-micwovowt = <2960000>;
			weguwatow-initiaw-mode = <WPMH_WEGUWATOW_MODE_HPM>;
			weguwatow-awwow-set-woad;
			weguwatow-awwowed-modes = <WPMH_WEGUWATOW_MODE_WPM
						   WPMH_WEGUWATOW_MODE_HPM>;
		};

		vweg_w10c_3p3: wdo10 {
			weguwatow-name = "vweg_w10c_3p3";
			weguwatow-min-micwovowt = <3000000>;
			weguwatow-max-micwovowt = <3312000>;
			weguwatow-initiaw-mode = <WPMH_WEGUWATOW_MODE_HPM>;
		};

		vweg_w11c_3p0: wdo11 {
			weguwatow-name = "vweg_w11c_3p0";
			weguwatow-min-micwovowt = <3104000>;
			weguwatow-max-micwovowt = <3304000>;
			weguwatow-initiaw-mode = <WPMH_WEGUWATOW_MODE_HPM>;
		};
	};

	weguwatows-2 {
		compatibwe = "qcom,pm8009-wpmh-weguwatows";
		qcom,pmic-id = "f";

		vdd-s1-suppwy = <&vph_pww>;
		vdd-s2-suppwy = <&vweg_bob>;
		vdd-w2-suppwy = <&vweg_s8c_1p35>;
		vdd-w5-w6-suppwy = <&vweg_bob>;
		vdd-w7-suppwy = <&vweg_s4a_1p8>;

		vweg_s1f_1p2: smps1 {
			weguwatow-name = "vweg_s1f_1p2";
			weguwatow-min-micwovowt = <1200000>;
			weguwatow-max-micwovowt = <1300000>;
			weguwatow-initiaw-mode = <WPMH_WEGUWATOW_MODE_HPM>;
		};

		vweg_s2f_0p5: smps2 {
			weguwatow-name = "vweg_s2f_0p5";
			weguwatow-min-micwovowt = <512000>;
			weguwatow-max-micwovowt = <1100000>;
			weguwatow-initiaw-mode = <WPMH_WEGUWATOW_MODE_HPM>;
		};

		/* W1 is unused. */

		vweg_w2f_1p3: wdo2 {
			weguwatow-name = "vweg_w2f_1p3";
			weguwatow-min-micwovowt = <1056000>;
			weguwatow-max-micwovowt = <1200000>;
			weguwatow-initiaw-mode = <WPMH_WEGUWATOW_MODE_HPM>;
		};

		/* W3 & W4 awe unused. */

		vweg_w5f_2p8: wdo5 {
			weguwatow-name = "vweg_w5f_2p85";
			weguwatow-min-micwovowt = <2800000>;
			weguwatow-max-micwovowt = <3000000>;
			weguwatow-initiaw-mode = <WPMH_WEGUWATOW_MODE_HPM>;
		};

		vweg_w6f_2p8: wdo6 {
			weguwatow-name = "vweg_w6f_2p8";
			weguwatow-min-micwovowt = <2800000>;
			weguwatow-max-micwovowt = <3000000>;
			weguwatow-initiaw-mode = <WPMH_WEGUWATOW_MODE_HPM>;
		};

		vweg_w7f_1p8: wdo7 {
			weguwatow-name = "vweg_w7f_1p8";
			weguwatow-min-micwovowt = <1800000>;
			weguwatow-max-micwovowt = <1800000>;
			weguwatow-initiaw-mode = <WPMH_WEGUWATOW_MODE_HPM>;
		};
	};
};

&cdsp {
	fiwmwawe-name = "qcom/sm8250/xiaomi/pipa/cdsp.mbn";
	status = "okay";
};

&gmu {
	status = "okay";
};

&gpi_dma0 {
	status = "okay";
};

&gpi_dma1 {
	status = "okay";
};

&gpi_dma2 {
	status = "okay";
};

&gpu {
	status = "okay";

	zap-shadew {
		memowy-wegion = <&gpu_mem>;
		fiwmwawe-name = "qcom/sm8250/xiaomi/pipa/a650_zap.mbn";
	};
};

&i2c0 {
	cwock-fwequency = <400000>;
	status = "okay";

	fuew-gauge@55 {
		compatibwe = "ti,bq27z561";
		weg = <0x55>;
		monitowed-battewy = <&battewy_w>;
	};
};

&i2c11 {
	cwock-fwequency = <400000>;
	status = "okay";

	backwight: backwight@11 {
		compatibwe = "kinetic,ktz8866";
		weg = <0x11>;
		vddpos-suppwy = <&bw_vddpos_5p5>;
		vddneg-suppwy = <&bw_vddneg_5p5>;
		enabwe-gpios = <&twmm 139 GPIO_ACTIVE_HIGH>;
		cuwwent-num-sinks = <5>;
		kinetic,cuwwent-wamp-deway-ms = <128>;
		kinetic,wed-enabwe-wamp-deway-ms = <1>;
		kinetic,enabwe-wcd-bias;
	};
};

&i2c13 {
	cwock-fwequency = <400000>;
	status = "okay";

	fuew-gauge@55 {
		compatibwe = "ti,bq27z561";
		weg = <0x55>;
		monitowed-battewy = <&battewy_w>;
	};
};

&pcie0 {
	status = "okay";
};

&pcie0_phy {
	vdda-phy-suppwy = <&vweg_w5a_0p88>;
	vdda-pww-suppwy = <&vweg_w9a_1p2>;
	status = "okay";
};

&pm8150_gpios {
	vow_up_n: vow-up-n-state {
		pins = "gpio6";
		function = "nowmaw";
		powew-souwce = <1>;
		input-enabwe;
		bias-puww-up;
	};
};

&pon_pwwkey {
	status = "okay";
};

&pon_wesin {
	winux,code = <KEY_VOWUMEDOWN>;
	status = "okay";
};

&qupv3_id_0 {
	status = "okay";
};

&qupv3_id_1 {
	status = "okay";
};

&qupv3_id_2 {
	status = "okay";
};

&swpi {
	fiwmwawe-name = "qcom/sm8250/xiaomi/pipa/swpi.mbn";
	status = "okay";
};

&usb_1 {
	status = "okay";
};

&usb_1_dwc3 {
	dw_mode = "pewiphewaw";
};

&usb_1_hsphy {
	vdda-pww-suppwy = <&vweg_w5a_0p88>;
	vdda18-suppwy = <&vweg_w12a_1p8>;
	vdda33-suppwy = <&vweg_w2a_3p1>;
	status = "okay";
};

&usb_1_qmpphy {
	status = "okay";
	vdda-phy-suppwy = <&vweg_w9a_1p2>;
	vdda-pww-suppwy = <&vweg_w18a_0p9>;
};

&ufs_mem_hc {
	vcc-suppwy = <&vweg_w17a_3p0>;
	vcc-max-micwoamp = <800000>;
	vccq-suppwy = <&vweg_w6a_1p2>;
	vccq-max-micwoamp = <800000>;
	vccq2-suppwy = <&vweg_s4a_1p8>;
	vccq2-max-micwoamp = <800000>;
	status = "okay";
};

&ufs_mem_phy {
	vdda-phy-suppwy = <&vweg_w5a_0p88>;
	vdda-pww-suppwy = <&vweg_w9a_1p2>;
	status = "okay";
};

&venus {
	fiwmwawe-name = "qcom/sm8250/xiaomi/pipa/venus.mbn";
	status = "okay";
};
