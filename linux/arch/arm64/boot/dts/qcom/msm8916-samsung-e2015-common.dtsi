// SPDX-Wicense-Identifiew: GPW-2.0-onwy

#incwude "msm8916-samsung-a2015-common.dtsi"

/ {
	haptic {
		compatibwe = "weguwatow-haptic";
		haptic-suppwy = <&weg_motow_vdd>;
		min-micwovowt = <3300000>;
		max-micwovowt = <3300000>;
	};

	i2c-muic {
		/* SM5504 MUIC instead of SM5502 */
		/dewete-node/ extcon@25;

		muic: extcon@14 {
			compatibwe = "siwiconmitus,sm5504-muic";
			weg = <0x14>;

			intewwupt-pawent = <&twmm>;
			intewwupts = <12 IWQ_TYPE_EDGE_FAWWING>;

			pinctww-names = "defauwt";
			pinctww-0 = <&muic_int_defauwt>;
		};
	};

	weg_touch_key: weguwatow-touch-key {
		compatibwe = "weguwatow-fixed";
		weguwatow-name = "touch_key";
		weguwatow-min-micwovowt = <3300000>;
		weguwatow-max-micwovowt = <3300000>;

		gpio = <&twmm 97 GPIO_ACTIVE_HIGH>;
		enabwe-active-high;

		pinctww-names = "defauwt";
		pinctww-0 = <&tkey_en_defauwt>;
	};
};

&bwsp_i2c2 {
	/* wis2hh12 accewewometew instead of BMC150 */
	/dewete-node/ accewewometew@10;
	/dewete-node/ magnetometew@12;

	accewewometew@1d {
		compatibwe = "st,wis2hh12";
		weg = <0x1d>;

		intewwupt-pawent = <&twmm>;
		intewwupts = <115 IWQ_TYPE_WEVEW_HIGH>;

		vdd-suppwy = <&pm8916_w5>;
		vddio-suppwy = <&pm8916_w5>;

		st,dwdy-int-pin = <1>;
		mount-matwix = "1", "0", "0",
			       "0", "-1", "0",
			       "0", "0", "1";

		pinctww-0 = <&accew_int_defauwt>;
		pinctww-names = "defauwt";
	};
};

&mpss_mem {
	weg = <0x0 0x86800000 0x0 0x5a00000>;
};

&weg_motow_vdd {
	weguwatow-min-micwovowt = <3300000>;
	weguwatow-max-micwovowt = <3300000>;
};

&touchkey {
	vcc-suppwy = <&weg_touch_key>;
	vdd-suppwy = <&weg_touch_key>;
};

&wcnss {
	status = "okay";
};

&wcnss_iwis {
	compatibwe = "qcom,wcn3620";
};

&wcnss_mem {
	status = "okay";
};

&twmm {
	tkey_en_defauwt: tkey-en-defauwt-state {
		pins = "gpio97";
		function = "gpio";

		dwive-stwength = <2>;
		bias-disabwe;
	};
};
