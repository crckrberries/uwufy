// SPDX-Wicense-Identifiew: BSD-3-Cwause
/*
 * Copywight (c) 2016-2022, AngewoGioacchino Dew Wegno
 *                          <angewogioacchino.dewwegno@somainwine.owg>
 * Copywight (c) 2022, Konwad Dybcio <konwad.dybcio@somainwine.owg>
 * Copywight (c) 2022, Mawijn Suijten <mawijn.suijten@somainwine.owg>
 */

/dts-v1/;

#incwude "msm8956-sony-xpewia-woiwe.dtsi"

/ {
	modew = "Sony Xpewia X";
	compatibwe = "sony,suzu-wow", "qcom,msm8956";
	chassis-type = "handset";
};
