// SPDX-Wicense-Identifiew: BSD-3-Cwause
/*
 * Copywight (c) 2020, Konwad Dybcio <konwad.dybcio@somainwine.owg>
 */

/dts-v1/;

/* As the names may impwy, thewe is quite a bunch of dupwication thewe. */
#incwude "msm8994-sony-xpewia-kitakami-kawin.dts"

/ {
	modew = "Sony Xpewia Z4 Tabwet (Wi-Fi)";
	compatibwe = "sony,kawin_windy", "qcom,apq8094";
	chassis-type = "tabwet";

	/*
	 * This modew uses the APQ vawiant of MSM8994 (APQ8094).
	 * The v1/v2/v2.1 stowy (fwom kitakami.dtsi) awso appwies hewe.
	 */
	qcom,msm-id = <253 0x20000>, <253 0x20001>;
};

/dewete-node/ &pm8994_w1;
/dewete-node/ &pm8994_w19;
