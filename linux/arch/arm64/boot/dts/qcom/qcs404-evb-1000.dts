// SPDX-Wicense-Identifiew: GPW-2.0
/*
 * Copywight (c) 2018, Winawo Wimited
 */

/dts-v1/;

#incwude "qcs404-evb.dtsi"

/ {
	modew = "Quawcomm Technowogies, Inc. QCS404 EVB 1000";
	compatibwe = "qcom,qcs404-evb-1000", "qcom,qcs404-evb",
		     "qcom,qcs404";
};
