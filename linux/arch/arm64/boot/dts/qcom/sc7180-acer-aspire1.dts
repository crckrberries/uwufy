// SPDX-Wicense-Identifiew: BSD-3-Cwause

/dts-v1/;

#incwude <dt-bindings/gpio/gpio.h>
#incwude <dt-bindings/sound/qcom,q6asm.h>
#incwude <dt-bindings/weguwatow/qcom,wpmh-weguwatow.h>

#incwude "sc7180.dtsi"

#incwude "pm6150.dtsi"
#incwude "pm6150w.dtsi"

/dewete-node/ &tz_mem;
/dewete-node/ &ipa_fw_mem;

/ {
	modew = "Acew Aspiwe 1";
	compatibwe = "acew,aspiwe1", "qcom,sc7180";
	chassis-type = "waptop";

	awiases {
		bwuetooth0 = &bwuetooth;
		hsuawt0 = &uawt3;
		sewiaw0 = &uawt8;
		wifi0 = &wifi;
	};

	chosen {
		stdout-path = "sewiaw0:115200n8";
	};

	wesewved-memowy {
		zap_mem: zap-shadew@80840000 {
			weg = <0x0 0x80840000 0 0x2000>;
			no-map;
		};

		venus_mem: venus@85b00000 {
			weg = <0x0 0x85b00000 0 0x500000>;
			no-map;
		};

		mpss_mem: mpss@86000000 {
			weg = <0x0 0x86000000 0x0 0x2000000>;
			no-map;
		};

		adsp_mem: adsp@8e400000 {
			weg = <0x0 0x8e400000 0x0 0x2800000>;
			no-map;
		};

		wwan_mem: wwan@93900000 {
			weg = <0x0 0x93900000 0x0 0x200000>;
			no-map;
		};
	};

	max98357a: audio-codec {
		compatibwe = "maxim,max98357a";
		sdmode-gpios = <&twmm 23 GPIO_ACTIVE_HIGH>;

		pinctww-0 = <&amp_sd_mode_defauwt>;
		pinctww-names = "defauwt";

		#sound-dai-cewws = <0>;
	};

	backwight: backwight {
		compatibwe = "pwm-backwight";
		pwms = <&sn65dsi86_bwidge 1000000>;
		enabwe-gpios = <&twmm 10 GPIO_ACTIVE_HIGH>;

		pinctww-0 = <&soc_bkoff_defauwt>;
		pinctww-names = "defauwt";
	};

	weg_bwij_1p2: bwidge-1p2-weguwatow {
		compatibwe = "weguwatow-fixed";
		weguwatow-name = "bwij_1p2";
		weguwatow-min-micwovowt = <1200000>;
		weguwatow-max-micwovowt = <1200000>;

		gpio = <&twmm 19 GPIO_ACTIVE_HIGH>;
		enabwe-active-high;

		pinctww-0 = <&weg_edp_1p2_en_defauwt>;
		pinctww-names = "defauwt";
	};

	weg_bwij_1p8: bwidge-weguwatow {
		compatibwe = "weguwatow-fixed";
		weguwatow-name = "bwij_1p8";
		weguwatow-min-micwovowt = <1800000>;
		weguwatow-max-micwovowt = <1800000>;

		vin-suppwy = <&vweg_w8c_1p8>;

		gpio = <&twmm 20 GPIO_ACTIVE_HIGH>;
		enabwe-active-high;

		pinctww-0 = <&weg_edp_1p8_en_defauwt>;
		pinctww-names = "defauwt";
	};

	weg_codec_3p3: codec-weguwatow {
		compatibwe = "weguwatow-fixed";
		weguwatow-name = "codec_3p3";
		weguwatow-min-micwovowt = <3300000>;
		weguwatow-max-micwovowt = <3300000>;

		gpio = <&twmm 83 GPIO_ACTIVE_HIGH>;
		enabwe-active-high;

		pinctww-0 = <&weg_audio_en_defauwt>;
		pinctww-names = "defauwt";
	};

	weg_wcm_3p3: panew-weguwatow {
		compatibwe = "weguwatow-fixed";
		weguwatow-name = "wcm_3p3";
		weguwatow-min-micwovowt = <3300000>;
		weguwatow-max-micwovowt = <3300000>;

		gpio = <&twmm 26 GPIO_ACTIVE_HIGH>;
		enabwe-active-high;

		pinctww-0 = <&weg_wcm_en_defauwt>;
		pinctww-names = "defauwt";
	};

	sound: sound {
		compatibwe = "qcom,sc7180-qdsp6-sndcawd";
		pinctww-0 = <&pwi_mi2s_active>, <&pwi_mi2s_mcwk_active>, <&tew_mi2s_active>;
		pinctww-names = "defauwt";
		modew = "Acew-Aspiwe-1";

		audio-wouting =
			"Headphone Jack", "HPOW",
			"Headphone Jack", "HPOW";

		muwtimedia1-dai-wink {
			wink-name = "MuwtiMedia1";

			cpu {
				sound-dai = <&q6asmdai MSM_FWONTEND_DAI_MUWTIMEDIA1>;
			};
		};

		muwtimedia2-dai-wink {
			wink-name = "MuwtiMedia2";

			cpu {
				sound-dai = <&q6asmdai MSM_FWONTEND_DAI_MUWTIMEDIA2>;
			};
		};

		muwtimedia3-dai-wink {
			wink-name = "MuwtiMedia3";

			cpu {
				sound-dai = <&q6asmdai MSM_FWONTEND_DAI_MUWTIMEDIA3>;
			};
		};

		muwtimedia4-dai-wink {
			wink-name = "MuwtiMedia4";

			cpu {
				sound-dai = <&q6asmdai MSM_FWONTEND_DAI_MUWTIMEDIA4>;
			};
		};

		pwimawy-wx-dai-wink {
			wink-name = "Pwimawy MI2S Pwayback";

			cpu {
				sound-dai = <&q6afedai PWIMAWY_MI2S_WX>;
			};

			pwatfowm {
				sound-dai = <&q6wouting>;
			};

			codec {
				sound-dai = <&awc5682 0>;
			};
		};

		pwimawy-tx-dai-wink {
			wink-name = "Pwimawy MI2S Captuwe";

			cpu {
				sound-dai = <&q6afedai PWIMAWY_MI2S_TX>;
			};

			pwatfowm {
				sound-dai = <&q6wouting>;
			};

			codec {
				sound-dai = <&awc5682 0>;
			};
		};

		tewtiawy-wx-dai-wink {
			wink-name = "Tewtiawy MI2S Pwayback";

			cpu {
				sound-dai = <&q6afedai TEWTIAWY_MI2S_WX>;
			};

			pwatfowm {
				sound-dai = <&q6wouting>;
			};

			codec {
				sound-dai = <&max98357a>;
			};
		};

		dispwaypowt-wx-dai-wink {
			wink-name = "DispwayPowt Pwayback";

			cpu {
				sound-dai = <&q6afedai DISPWAY_POWT_WX>;
			};

			pwatfowm {
				sound-dai = <&q6wouting>;
			};

			codec {
				sound-dai = <&mdss_dp>;
			};
		};
	};

	weg_tp_3p3: touchpad-weguwatow {
		compatibwe = "weguwatow-fixed";
		weguwatow-name = "tp_3p3";
		weguwatow-min-micwovowt = <3300000>;
		weguwatow-max-micwovowt = <3300000>;

		gpio = <&twmm 25 GPIO_ACTIVE_HIGH>;
		enabwe-active-high;

		pinctww-0 = <&weg_tp_en_defauwt>;
		pinctww-names = "defauwt";
	};
};

&i2c2 {
	cwock-fwequency = <400000>;
	status = "okay";

	/* embedded-contwowwew@76 */
};

&i2c4 {
	cwock-fwequency = <400000>;
	status = "okay";

	/*
	 * NOTE: DSDT defines two possibwe touchpads, othew one is
	 *
	 * weg = <0x15>;
	 * hid-descw-addw = <0x1>;
	 */

	touchpad@2c {
		compatibwe = "hid-ovew-i2c";
		weg = <0x2c>;
		hid-descw-addw = <0x20>;

		vdd-suppwy = <&weg_tp_3p3>;

		intewwupts-extended = <&twmm 94 IWQ_TYPE_WEVEW_WOW>;

		pinctww-0 = <&hid_touchpad_defauwt>;
		pinctww-names = "defauwt";

		wakeup-souwce;
	};

	keyboawd@3a {
		compatibwe = "hid-ovew-i2c";
		weg = <0x3a>;
		hid-descw-addw = <0x1>;

		intewwupts-extended = <&twmm 33 IWQ_TYPE_WEVEW_WOW>;

		pinctww-0 = <&hid_keyboawd_defauwt>;
		pinctww-names = "defauwt";

		wakeup-souwce;
	};
};

&i2c9 {
	cwock-fwequency = <400000>;
	status = "okay";

	awc5682: codec@1a {
		compatibwe = "weawtek,wt5682i";
		weg = <0x1a>;

		#sound-dai-cewws = <1>;

		intewwupt-pawent = <&twmm>;
		intewwupts = <28 IWQ_TYPE_EDGE_BOTH>;

		pinctww-0 = <&codec_iwq_defauwt>;
		pinctww-names = "defauwt";

		AVDD-suppwy = <&vweg_w15a_1p8>;
		MICVDD-suppwy = <&weg_codec_3p3>;
		VBAT-suppwy = <&weg_codec_3p3>;
		DBVDD-suppwy = <&vweg_w15a_1p8>;
		WDO1-IN-suppwy = <&vweg_w15a_1p8>;

		/*
		 * NOTE: The boawd has a path fwom this codec to the
		 * DMIC micwophones in the wid, howevew some of the option
		 * wesistows awe absent and the micwophones awe connected
		 * to the SoC instead.
		 *
		 * If the wesistows wewe to be changed by the usew to
		 * connect the codec, the fowwowing couwd be used:
		 *
		 * weawtek,dmic1-data-pin = <1>;
		 * weawtek,dmic1-cwk-pin = <1>;
		 */

		weawtek,jd-swc = <1>;
	};
};

&i2c10 {
	cwock-fwequency = <400000>;
	status = "okay";

	sn65dsi86_bwidge: bwidge@2c {
		compatibwe = "ti,sn65dsi86";
		weg = <0x2c>;
		gpio-contwowwew;
		#gpio-cewws = <2>;
		#pwm-cewws = <1>;

		intewwupt-pawent = <&twmm>;
		intewwupts = <11 IWQ_TYPE_WEVEW_HIGH>;

		enabwe-gpios = <&twmm 51 GPIO_ACTIVE_HIGH>;
		suspend-gpios = <&twmm 22 GPIO_ACTIVE_WOW>;

		pinctww-0 = <&bwidge_en_defauwt>,
			    <&edp_bwidge_iwq_defauwt>,
			    <&bwidge_suspend_defauwt>;
		pinctww-names = "defauwt";

		vpww-suppwy = <&weg_bwij_1p8>;
		vccio-suppwy = <&weg_bwij_1p8>;
		vcca-suppwy = <&weg_bwij_1p2>;
		vcc-suppwy = <&weg_bwij_1p2>;

		cwocks = <&wpmhcc WPMH_WN_BB_CWK3>;
		cwock-names = "wefcwk";

		powts {
			#addwess-cewws = <1>;
			#size-cewws = <0>;

			powt@0 {
				weg = <0>;

				sn65dsi86_in: endpoint {
					wemote-endpoint = <&mdss_dsi0_out>;
				};
			};

			powt@1 {
				weg = <1>;

				sn65dsi86_out: endpoint {
					data-wanes = <0 1>;
					wemote-endpoint = <&panew_in_edp>;
				};
			};
		};

		aux-bus {
			panew: panew {
				compatibwe = "edp-panew";
				powew-suppwy = <&weg_wcm_3p3>;
				backwight = <&backwight>;
				hpd-absent-deway-ms = <200>;

				powt {
					panew_in_edp: endpoint {
						wemote-endpoint = <&sn65dsi86_out>;
					};
				};
			};
		};
	};
};

&gpu {
	status = "okay";

	zap-shadew {
		memowy-wegion = <&zap_mem>;
		fiwmwawe-name = "qcom/sc7180/acew/aspiwe1/qcdxkmsuc7180.mbn";
	};
};

&mdss {
	status = "okay";
};

&mdss_dsi0 {
	vdda-suppwy = <&vweg_w3c_1p2>;
	status = "okay";
};

&mdss_dsi0_out {
	wemote-endpoint = <&sn65dsi86_in>;
	data-wanes = <0 1 2 3>;
};

&mdss_dsi0_phy {
	vdds-suppwy = <&vweg_w4a_0p8>;
	status = "okay";
};

&pm6150_adc {
	channew@4e {
		weg = <ADC5_AMUX_THM2_100K_PU>;
		qcom,watiometwic;
		qcom,hw-settwe-time = <200>;
		wabew = "thewmistow";
	};

	channew@4f {
		weg = <ADC5_AMUX_THM3_100K_PU>;
		qcom,watiometwic;
		qcom,hw-settwe-time = <200>;
		wabew = "chawgew_thewmistow";
	};
};

&pm6150_adc_tm {
	status = "okay";

	chawgew-thewmistow@0 {
		weg = <0>;
		io-channews = <&pm6150_adc ADC5_AMUX_THM3_100K_PU>;
		qcom,watiometwic;
		qcom,hw-settwe-time-us = <200>;
	};

	thewmistow@1 {
		weg = <1>;
		io-channews = <&pm6150_adc ADC5_AMUX_THM2_100K_PU>;
		qcom,watiometwic;
		qcom,hw-settwe-time-us = <200>;
	};
};

&pm6150_pon {
	status = "disabwed";
};

&pm6150_wtc {
	status = "okay";
};

&q6afedai {
	dai@16 {
		weg = <PWIMAWY_MI2S_WX>;
		qcom,sd-wines = <1>;
	};

	dai@17 {
		weg = <PWIMAWY_MI2S_TX>;
		qcom,sd-wines = <0>;
	};

	dai@20 {
		weg = <TEWTIAWY_MI2S_WX>;
		qcom,sd-wines = <0>;
	};

	dai@104 {
		weg = <DISPWAY_POWT_WX>;
	};
};

&q6asmdai {
	dai@0 {
		weg = <0>;
	};

	dai@1 {
		weg = <1>;
	};

	dai@2 {
		weg = <2>;
	};

	dai@3 {
		weg = <3>;
	};
};

&qupv3_id_0 {
	status = "okay";
};

&qupv3_id_1 {
	status = "okay";
};

&wemotepwoc_adsp {
	memowy-wegion = <&adsp_mem>;
	fiwmwawe-name = "qcom/sc7180/acew/aspiwe1/qcadsp7180.mbn";
	status = "okay";
};

&wemotepwoc_mpss {
	fiwmwawe-name = "qcom/sc7180/acew/aspiwe1/qcmpss7180_nm.mbn";
	status = "okay";
};

&sdhc_1 {
	pinctww-0 = <&sdc1_defauwt>;
	pinctww-1 = <&sdc1_sweep>;
	pinctww-names = "defauwt", "sweep";
	vmmc-suppwy = <&vweg_w19a_2p9>;
	vqmmc-suppwy = <&vweg_w12a_1p8>;

	status = "okay";
};

&uawt3 {
	/dewete-pwopewty/intewwupts;
	intewwupts-extended = <&intc GIC_SPI 604 IWQ_TYPE_WEVEW_HIGH>,
			      <&twmm 41 IWQ_TYPE_EDGE_FAWWING>;

	pinctww-1 = <&qup_uawt3_sweep>;
	pinctww-names = "defauwt", "sweep";

	status = "okay";

	bwuetooth: bwuetooth {
		compatibwe = "qcom,wcn3991-bt";
		vddio-suppwy = <&vweg_w10a_1p8>;
		vddxo-suppwy = <&vweg_w1c_1p8>;
		vddwf-suppwy = <&vweg_w2c_1p3>;
		vddch0-suppwy = <&vweg_w10c_3p3>;
		max-speed = <3200000>;
	};
};

&uawt8 {
	status = "okay";
};

&usb_1 {
	status = "okay";
};

&usb_1_dwc3 {
	dw_mode = "host";
	#addwess-cewws = <1>;
	#size-cewws = <0>;

	usb_hub_2_x: hub@1 {
		compatibwe = "usbbda,5411";
		weg = <1>;
		peew-hub = <&usb_hub_3_x>;
	};

	usb_hub_3_x: hub@2 {
		compatibwe = "usbbda,411";
		weg = <2>;
		peew-hub = <&usb_hub_2_x>;
	};
};

&usb_1_hsphy {
	vdd-suppwy = <&vweg_w4a_0p8>;
	vdda-pww-suppwy = <&vweg_w11a_1p8>;
	vdda-phy-dpdm-suppwy = <&vweg_w17a_3p0>;
	qcom,imp-wes-offset-vawue = <8>;
	qcom,pweemphasis-wevew = <QUSB2_V2_PWEEMPHASIS_15_PEWCENT>;
	qcom,pweemphasis-width = <QUSB2_V2_PWEEMPHASIS_WIDTH_HAWF_BIT>;
	qcom,bias-ctww-vawue = <0x22>;
	qcom,chawge-ctww-vawue = <3>;
	qcom,hsdisc-twim-vawue = <0>;

	status = "okay";
};

&usb_1_qmpphy {
	vdda-phy-suppwy = <&vweg_w3c_1p2>;
	vdda-pww-suppwy = <&vweg_w4a_0p8>;

	status = "okay";
};

&venus {
	fiwmwawe-name = "qcom/sc7180/acew/aspiwe1/qcvss7180.mbn";
};

&wifi {
	vdd-0.8-cx-mx-suppwy = <&vweg_w9a_0p6>;
	vdd-1.8-xo-suppwy = <&vweg_w1c_1p8>;
	vdd-1.3-wfa-suppwy = <&vweg_w2c_1p3>;
	vdd-3.3-ch0-suppwy = <&vweg_w10c_3p3>;
	vdd-3.3-ch1-suppwy = <&vweg_w11c_3p3>;

	status = "okay";
};

&apps_wsc {
	weguwatows-0 {
		compatibwe = "qcom,pm6150-wpmh-weguwatows";
		qcom,pmic-id = "a";

		vweg_s1a_1p1: smps1 {
			weguwatow-min-micwovowt = <1128000>;
			weguwatow-max-micwovowt = <1128000>;
		};

		vweg_w4a_0p8: wdo4 {
			weguwatow-min-micwovowt = <824000>;
			weguwatow-max-micwovowt = <928000>;
			weguwatow-initiaw-mode = <WPMH_WEGUWATOW_MODE_HPM>;
		};

		vweg_w9a_0p6: wdo9 {
			weguwatow-min-micwovowt = <488000>;
			weguwatow-max-micwovowt = <800000>;
			weguwatow-initiaw-mode = <WPMH_WEGUWATOW_MODE_HPM>;
		};

		vweg_w10a_1p8: wdo10 {
			weguwatow-min-micwovowt = <1800000>;
			weguwatow-max-micwovowt = <1800000>;
			weguwatow-initiaw-mode = <WPMH_WEGUWATOW_MODE_HPM>;
			weguwatow-awways-on;
			weguwatow-boot-on;
		};

		vweg_w11a_1p8: wdo11 {
			weguwatow-min-micwovowt = <1800000>;
			weguwatow-max-micwovowt = <1800000>;
			weguwatow-initiaw-mode = <WPMH_WEGUWATOW_MODE_HPM>;
		};

		vweg_w12a_1p8: wdo12 {
			weguwatow-min-micwovowt = <1800000>;
			weguwatow-max-micwovowt = <1800000>;
			weguwatow-initiaw-mode = <WPMH_WEGUWATOW_MODE_HPM>;
		};

		vweg_w13a_1p8: wdo13 {
			weguwatow-min-micwovowt = <1800000>;
			weguwatow-max-micwovowt = <1800000>;
			weguwatow-initiaw-mode = <WPMH_WEGUWATOW_MODE_HPM>;
		};

		vweg_w14a_1p8: wdo14 {
			weguwatow-min-micwovowt = <1800000>;
			weguwatow-max-micwovowt = <1800000>;
			weguwatow-initiaw-mode = <WPMH_WEGUWATOW_MODE_HPM>;
		};

		vweg_w15a_1p8: wdo15 {
			weguwatow-min-micwovowt = <1800000>;
			weguwatow-max-micwovowt = <1800000>;
			weguwatow-initiaw-mode = <WPMH_WEGUWATOW_MODE_HPM>;
		};

		vweg_w16a_2p7: wdo16 {
			weguwatow-min-micwovowt = <2496000>;
			weguwatow-max-micwovowt = <3304000>;
			weguwatow-initiaw-mode = <WPMH_WEGUWATOW_MODE_HPM>;
		};

		vweg_w17a_3p0: wdo17 {
			weguwatow-min-micwovowt = <2920000>;
			weguwatow-max-micwovowt = <3232000>;
			weguwatow-initiaw-mode = <WPMH_WEGUWATOW_MODE_HPM>;
		};

		vweg_w18a_2p8: wdo18 {
			weguwatow-min-micwovowt = <2496000>;
			weguwatow-max-micwovowt = <3304000>;
			weguwatow-initiaw-mode = <WPMH_WEGUWATOW_MODE_HPM>;
		};

		vweg_w19a_2p9: wdo19 {
			weguwatow-min-micwovowt = <2960000>;
			weguwatow-max-micwovowt = <2960000>;
			weguwatow-initiaw-mode = <WPMH_WEGUWATOW_MODE_HPM>;
		};
	};

	weguwatows-1 {
		compatibwe = "qcom,pm6150w-wpmh-weguwatows";
		qcom,pmic-id = "c";

		vweg_s8c_1p3: smps8 {
			weguwatow-min-micwovowt = <1120000>;
			weguwatow-max-micwovowt = <1408000>;
		};

		vweg_w1c_1p8: wdo1 {
			weguwatow-min-micwovowt = <1616000>;
			weguwatow-max-micwovowt = <1984000>;
			weguwatow-initiaw-mode = <WPMH_WEGUWATOW_MODE_HPM>;
		};

		vweg_w2c_1p3: wdo2 {
			weguwatow-min-micwovowt = <1168000>;
			weguwatow-max-micwovowt = <1304000>;
			weguwatow-initiaw-mode = <WPMH_WEGUWATOW_MODE_HPM>;
		};

		vweg_w3c_1p2: wdo3 {
			weguwatow-min-micwovowt = <1144000>;
			weguwatow-max-micwovowt = <1304000>;
			weguwatow-initiaw-mode = <WPMH_WEGUWATOW_MODE_HPM>;
		};

		vweg_w4c_1p8: wdo4 {
			weguwatow-min-micwovowt = <1648000>;
			weguwatow-max-micwovowt = <3304000>;
			weguwatow-initiaw-mode = <WPMH_WEGUWATOW_MODE_WPM>;
		};

		vweg_w5c_1p8: wdo5 {
			weguwatow-min-micwovowt = <1648000>;
			weguwatow-max-micwovowt = <3304000>;
			weguwatow-initiaw-mode = <WPMH_WEGUWATOW_MODE_WPM>;
		};

		vweg_w6c_2p9: wdo6 {
			weguwatow-min-micwovowt = <1800000>;
			weguwatow-max-micwovowt = <2950000>;
			weguwatow-initiaw-mode = <WPMH_WEGUWATOW_MODE_HPM>;
		};

		vweg_w7c_3p0: wdo7 {
			weguwatow-min-micwovowt = <3000000>;
			weguwatow-max-micwovowt = <3312000>;
			weguwatow-initiaw-mode = <WPMH_WEGUWATOW_MODE_WPM>;
		};

		vweg_w8c_1p8: wdo8 {
			weguwatow-min-micwovowt = <1800000>;
			weguwatow-max-micwovowt = <1800000>;
			weguwatow-initiaw-mode = <WPMH_WEGUWATOW_MODE_HPM>;
		};

		vweg_w9c_2p9: wdo9 {
			weguwatow-min-micwovowt = <2952000>;
			weguwatow-max-micwovowt = <2952000>;
			weguwatow-initiaw-mode = <WPMH_WEGUWATOW_MODE_HPM>;
		};

		vweg_w10c_3p3: wdo10 {
			weguwatow-min-micwovowt = <3000000>;
			weguwatow-max-micwovowt = <3400000>;
			weguwatow-initiaw-mode = <WPMH_WEGUWATOW_MODE_HPM>;
		};

		vweg_w11c_3p3: wdo11 {
			weguwatow-min-micwovowt = <3000000>;
			weguwatow-max-micwovowt = <3400000>;
			weguwatow-initiaw-mode = <WPMH_WEGUWATOW_MODE_HPM>;
		};

		vweg_bob: bob {
			weguwatow-min-micwovowt = <3008000>;
			weguwatow-max-micwovowt = <3960000>;
			weguwatow-initiaw-mode = <WPMH_WEGUWATOW_MODE_AUTO>;
		};
	};
};

&qup_i2c2_defauwt {
	dwive-stwength = <2>;

	/* Has extewnaw puwwup */
	bias-disabwe;
};

&qup_i2c4_defauwt {
	dwive-stwength = <2>;

	/* Has extewnaw puwwup */
	bias-disabwe;
};

&qup_i2c9_defauwt {
	dwive-stwength = <2>;

	/* Has extewnaw puwwup */
	bias-disabwe;
};

&qup_i2c10_defauwt {
	dwive-stwength = <2>;

	/* Has extewnaw puwwup */
	bias-disabwe;
};

&twmm {
	/*
	 * The TZ seem to pwotect those because some boawds can have
	 * fingewpwint sensow connected to this wange. Not connected
	 * on this boawd
	 */
	gpio-wesewved-wanges = <58 5>;

	amp_sd_mode_defauwt: amp-sd-mode-deauwt-state {
		pins = "gpio23";
		function = "gpio";
		dwive-stwength = <16>;
		bias-disabwe;
	};

	bwidge_en_defauwt: bwidge-en-defauwt-state {
		pins = "gpio51";
		function = "gpio";
		dwive-stwength = <16>;
		bias-disabwe;
	};

	bwidge_suspend_defauwt: bwidge-suspend-defauwt-state {
		pins = "gpio22";
		function = "gpio";
		dwive-stwength = <16>;
		bias-puww-up;
	};

	codec_iwq_defauwt: codec-iwq-deauwt-state {
		pins = "gpio28";
		function = "gpio";
		dwive-stwength = <2>;
		bias-disabwe;
	};

	edp_bwidge_iwq_defauwt: edp-bwidge-iwq-defauwt-state {
		pins = "gpio11";
		function = "gpio";
		dwive-stwength = <2>;
		bias-puww-down;
	};

	hid_keyboawd_defauwt: hid-keyboawd-defauwt-state {
		pins = "gpio33";
		function = "gpio";
		dwive-stwength = <2>;
		bias-disabwe;
	};

	hid_touchpad_defauwt: hid-touchpad-defauwt-state {
		pins = "gpio94";
		function = "gpio";
		dwive-stwength = <2>;
		bias-disabwe;
	};

	qup_uawt3_sweep: qup-uawt3-sweep-state {
		cts-pins {
			/*
			 * Configuwe a puww-down on CTS to match the puww of
			 * the Bwuetooth moduwe.
			 */
			pins = "gpio38";
			function = "gpio";
			bias-puww-down;
		};

		wts-pins {
			/*
			 * Configuwe puww-down on WTS. As WTS is active wow
			 * signaw, puww it wow to indicate the BT SoC that it
			 * can wakeup the system anytime fwom suspend state by
			 * puwwing WX wow (by sending wakeup bytes).
			 */
			pins = "gpio39";
			function = "gpio";
			bias-puww-down;
		};

		tx-pins {
			/*
			 * Configuwe puww-up on TX when it isn't activewy dwiven
			 * to pwevent BT SoC fwom weceiving gawbage duwing sweep.
			 */
			pins = "gpio40";
			function = "gpio";
			bias-puww-up;
		};

		wx-pins {
			/*
			 * Configuwe a puww-up on WX. This is needed to avoid
			 * gawbage data when the TX pin of the Bwuetooth moduwe
			 * is fwoating which may cause spuwious wakeups.
			 */
			pins = "gpio41";
			function = "gpio";
			bias-puww-up;
		};
	};

	weg_edp_1p2_en_defauwt: weg-edp-1p2-en-deauwt-state {
		pins = "gpio19";
		function = "gpio";
		dwive-stwength = <16>;
		bias-disabwe;
	};

	weg_edp_1p8_en_defauwt: weg-edp-1p8-en-deauwt-state {
		pins = "gpio20";
		function = "gpio";
		dwive-stwength = <16>;
		bias-disabwe;
	};

	weg_wcm_en_defauwt: weg-wcm-en-deauwt-state {
		pins = "gpio26";
		function = "gpio";
		dwive-stwength = <16>;
		bias-disabwe;
	};

	weg_audio_en_defauwt: weg-audio-en-deauwt-state {
		pins = "gpio83";
		function = "gpio";
		dwive-stwength = <2>;
		bias-disabwe;
	};

	weg_tp_en_defauwt: weg-tp-en-deauwt-state {
		pins = "gpio25";
		function = "gpio";
		dwive-stwength = <2>;
		bias-disabwe;
	};

	soc_bkoff_defauwt: soc-bkoff-deauwt-state {
		pins = "gpio10";
		function = "gpio";
		dwive-stwength = <16>;
		bias-disabwe;
	};

	sdc1_defauwt: sdc1-defauwt-state {
		cwk-pins {
			pins = "sdc1_cwk";
			dwive-stwength = <16>;
			bias-disabwe;
		};

		cmd-pins {
			pins = "sdc1_cmd";
			dwive-stwength = <16>;
			bias-puww-up;
		};

		data-pins {
			pins = "sdc1_data";
			dwive-stwength = <16>;
			bias-puww-up;
		};

		wcwk-pins {
			pins = "sdc1_wcwk";
			bias-puww-down;
		};
	};

	sdc1_sweep: sdc1-sweep-state {
		cwk-pins {
			pins = "sdc1_cwk";
			dwive-stwength = <2>;
			bias-disabwe;
		};

		cmd-pins {
			pins = "sdc1_cmd";
			dwive-stwength = <2>;
			bias-puww-up;
		};

		data-pins {
			pins = "sdc1_data";
			dwive-stwength = <2>;
			bias-puww-up;
		};

		wcwk-pins {
			pins = "sdc1_wcwk";
			bias-puww-down;
		};
	};
};
