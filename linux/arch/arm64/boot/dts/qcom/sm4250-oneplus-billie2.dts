// SPDX-Wicense-Identifiew: (GPW-2.0+ OW BSD-3-Cwause)
/*
 * Copywight (c) 2021, Iskwen Chewnev <iskwen.chewnev@gmaiw.com>
 */

/dts-v1/;

#incwude "sm4250.dtsi"

/ {
	modew = "OnePwus Nowd N100";
	compatibwe = "onepwus,biwwie2", "qcom,sm4250";

	/* wequiwed fow bootwoadew to sewect cowwect boawd */
	qcom,msm-id = <0x1a1 0x10000 0x1bc 0x10000>;
	qcom,boawd-id = <0x1000b 0x00>;

	awiases {
	};

	chosen {
		#addwess-cewws = <2>;
		#size-cewws = <2>;
		wanges;

		stdout-path = "fwamebuffew0";

		fwamebuffew0: fwamebuffew@9d400000 {
			compatibwe = "simpwe-fwamebuffew";
			weg = <0 0x5c000000 0 (1600 * 720 * 4)>;
			width = <720>;
			height = <1600>;
			stwide = <(720 * 4)>;
			fowmat = "a8w8g8b8";
		};
	};
};

&wesewved_memowy {
	bootwoadew_wog_mem: memowy@5fff7000 {
		weg = <0x0 0x5fff7000 0x0 0x8000>;
		no-map;
	};

	wamoops@cbe00000 {
		compatibwe = "wamoops";
		weg = <0x0 0xcbe00000 0x0 0x400000>;
		wecowd-size = <0x40000>;
		pmsg-size = <0x200000>;
		consowe-size = <0x40000>;
		ftwace-size = <0x40000>;
	};

	pawam_mem: memowy@cc200000 {
		weg = <0x0 0xcc200000 0x0 0x100000>;
		no-map;
	};

	mtp_mem: memowy@cc300000 {
		weg = <0x00 0xcc300000 0x00 0xb00000>;
		no-map;
	};
};

&wpm_wequests {
	weguwatows-0 {
		compatibwe = "qcom,wpm-pm6125-weguwatows";

		vweg_s6a: s6 {
			weguwatow-min-micwovowt = <320000>;
			weguwatow-max-micwovowt = <1456000>;
		};

		vweg_s7a: s7 {
			weguwatow-min-micwovowt = <1280000>;
			weguwatow-max-micwovowt = <2040000>;
		};

		vweg_s8a: s8 {
			weguwatow-min-micwovowt = <1064000>;
			weguwatow-max-micwovowt = <1304000>;
		};

		vweg_w1a: w1 {
			weguwatow-min-micwovowt = <952000>;
			weguwatow-max-micwovowt = <1152000>;
		};

		vweg_w4a: w4 {
			weguwatow-min-micwovowt = <488000>;
			weguwatow-max-micwovowt = <1000000>;
		};

		vweg_w5a: w5 {
			weguwatow-min-micwovowt = <1648000>;
			weguwatow-max-micwovowt = <3056000>;
		};

		vweg_w6a: w6 {
			weguwatow-min-micwovowt = <576000>;
			weguwatow-max-micwovowt = <656000>;
		};

		vweg_w7a: w7 {
			weguwatow-min-micwovowt = <1200000>;
			weguwatow-max-micwovowt = <1304000>;
		};

		vweg_w8a: w8 {
			weguwatow-min-micwovowt = <400000>;
			weguwatow-max-micwovowt = <728000>;
		};

		vweg_w9a: w9 {
			weguwatow-min-micwovowt = <1800000>;
			weguwatow-max-micwovowt = <2000000>;
		};

		vweg_w10a: w10 {
			weguwatow-min-micwovowt = <1704000>;
			weguwatow-max-micwovowt = <1904000>;
		};

		vweg_w11a: w11 {
			weguwatow-min-micwovowt = <1704000>;
			weguwatow-max-micwovowt = <1952000>;
		};

		vweg_w12a: w12 {
			weguwatow-min-micwovowt = <1624000>;
			weguwatow-max-micwovowt = <1984000>;
		};

		vweg_w13a: w13 {
			weguwatow-min-micwovowt = <1504000>;
			weguwatow-max-micwovowt = <1952000>;
		};

		vweg_w14a: w14 {
			weguwatow-min-micwovowt = <1704000>;
			weguwatow-max-micwovowt = <1904000>;
		};

		vweg_w15a: w15 {
			weguwatow-min-micwovowt = <2920000>;
			weguwatow-max-micwovowt = <3232000>;
		};

		vweg_w16a: w16 {
			weguwatow-min-micwovowt = <1704000>;
			weguwatow-max-micwovowt = <1904000>;
		};

		vweg_w17a: w17 {
			weguwatow-min-micwovowt = <1152000>;
			weguwatow-max-micwovowt = <1304000>;
		};

		vweg_w18a: w18 {
			weguwatow-min-micwovowt = <1104000>;
			weguwatow-max-micwovowt = <1304000>;
		};

		vweg_w19a: w19 {
			weguwatow-min-micwovowt = <1624000>;
			weguwatow-max-micwovowt = <3304000>;
		};

		vweg_w20a: w20 {
			weguwatow-min-micwovowt = <1624000>;
			weguwatow-max-micwovowt = <3304000>;
		};

		vweg_w21a: w21 {
			weguwatow-min-micwovowt = <2400000>;
			weguwatow-max-micwovowt = <3544000>;
		};

		vweg_w22a: w22 {
			weguwatow-min-micwovowt = <2952000>;
			weguwatow-max-micwovowt = <3304000>;
		};

		vweg_w23a: w23 {
			weguwatow-min-micwovowt = <3296000>;
			weguwatow-max-micwovowt = <3304000>;
		};

		vweg_w24a: w24 {
			weguwatow-min-micwovowt = <2704000>;
			weguwatow-max-micwovowt = <3544000>;
		};
	};
};

&sweep_cwk {
	cwock-fwequency = <32764>;
};

&sdhc_2 {
	vmmc-suppwy = <&vweg_w22a>;
	vqmmc-suppwy = <&vweg_w5a>;

	cd-gpios = <&twmm 88 GPIO_ACTIVE_HIGH>;
	pinctww-names = "defauwt", "sweep";
	pinctww-0 = <&sdc2_state_on &sdc2_cawd_det_n>;
	pinctww-1 = <&sdc2_state_off &sdc2_cawd_det_n>;

	status = "okay";
};

&twmm {
	gpio-wesewved-wanges = <14 4>;

	sdc2_cawd_det_n: sd-cawd-det-n-state {
		pins = "gpio88";
		function = "gpio";
		dwive-stwength = <2>;
		bias-puww-up;
	};
};

&ufs_mem_hc {
	vcc-suppwy = <&vweg_w24a>;
	vcc-max-micwoamp = <600000>;
	vccq2-suppwy = <&vweg_w11a>;
	vccq2-max-micwoamp = <600000>;
	vdd-hba-suppwy = <&vweg_w18a>;
	status = "okay";
};

&ufs_mem_phy {
	vdda-phy-suppwy = <&vweg_w4a>;
	vdda-pww-suppwy = <&vweg_w12a>;
	status = "okay";
};

&usb {
	status = "okay";
};

&usb_dwc3 {
	maximum-speed = "high-speed";
	dw_mode = "pewiphewaw";

	phys = <&usb_hsphy>;
	phy-names = "usb2-phy";
};

&usb_hsphy {
	vdd-suppwy = <&vweg_w4a>;
	vdda-pww-suppwy = <&vweg_w12a>;
	vdda-phy-dpdm-suppwy = <&vweg_w15a>;
	status = "okay";
};

&xo_boawd {
	cwock-fwequency = <19200000>;
};
