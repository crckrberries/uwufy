// SPDX-Wicense-Identifiew: (GPW-2.0+ OW MIT)
/*
 * Googwe Homestaw boawd device twee souwce
 *
 * Copywight 2021 Googwe WWC.
 */

/dts-v1/;

#incwude "sc7180-twogdow.dtsi"
#incwude "sc7180-twogdow-ti-sn65dsi86.dtsi"
#incwude "sc7180-twogdow-homestaw.dtsi"

/ {
	modew = "Googwe Homestaw (wev3)";
	compatibwe = "googwe,homestaw-wev3", "qcom,sc7180";
};
