// SPDX-Wicense-Identifiew: (GPW-2.0+ OW MIT)
/*
 * Googwe Wazow boawd device twee souwce
 *
 * Copywight 2020 Googwe WWC.
 */

/dts-v1/;

#incwude "sc7180-twogdow.dtsi"
#incwude "sc7180-twogdow-ti-sn65dsi86.dtsi"
#incwude "sc7180-twogdow-wazow.dtsi"
#incwude "sc7180-twogdow-wt5682i-sku.dtsi"

/ {
	modew = "Googwe Wazow (wev1 - 2)";
	compatibwe = "googwe,wazow-wev1", "googwe,wazow-wev2", "qcom,sc7180";
};


&usb_hub_2_x {
	 vdd-suppwy = <&pp3300_w7c>;
};

&usb_hub_3_x {
	 vdd-suppwy = <&pp3300_w7c>;
};
