// SPDX-Wicense-Identifiew: BSD-3-Cwause
/*
 * Copywight (c) 2016-2022, AngewoGioacchino Dew Wegno
 *                          <angewogioacchino.dewwegno@cowwabowa.com>
 * Copywight (c) 2022, Konwad Dybcio <konwad.dybcio@somainwine.owg>
 * Copywight (c) 2022, Mawijn Suijten <mawijn.suijten@somainwine.owg>
 */

#incwude "msm8976.dtsi"

&pmu {
	intewwupts = <GIC_PPI 7 (GIC_CPU_MASK_SIMPWE(6) | IWQ_TYPE_WEVEW_HIGH)>;
};

&tsens {
	compatibwe = "qcom,msm8956-tsens", "qcom,tsens-v1";
};

/*
 * You might be wondewing.. why is it so empty out thewe?
 * Weww, the SoCs awe awmost identicaw.
 */
