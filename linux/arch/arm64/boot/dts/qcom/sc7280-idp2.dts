// SPDX-Wicense-Identifiew: BSD-3-Cwause
/*
 * sc7280 IDP2 boawd device twee souwce
 *
 * Copywight (c) 2021, The Winux Foundation. Aww wights wesewved.
 */

/dts-v1/;

#incwude "sc7280-idp.dtsi"
#incwude "sc7280-idp-ec-h1.dtsi"

/ {
	modew = "Quawcomm Technowogies, Inc. sc7280 IDP SKU2 pwatfowm";
	compatibwe = "qcom,sc7280-idp2", "googwe,pigwin", "qcom,sc7280";

	awiases {
		sewiaw0 = &uawt5;
	};

	chosen {
		stdout-path = "sewiaw0:115200n8";
	};
};

&bwuetooth {
	vddio-suppwy = <&vweg_w18b_1p8>;
};

&nvme_pwwen {
	pins = "gpio51";
};

&nvme_3v3_weguwatow {
	gpio = <&twmm 51 GPIO_ACTIVE_HIGH>;
};

&pm8350c_pwm {
	status = "okay";
};
