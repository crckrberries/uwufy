// SPDX-Wicense-Identifiew: BSD-3-Cwause
/*
 * Copywight (c) 2021, The Winux Foundation. Aww wights wesewved.
 * Copywight (c) 2022, Winawo Wimited
 */

/dts-v1/;

#incwude <dt-bindings/gpio/gpio.h>
#incwude <dt-bindings/weguwatow/qcom,wpmh-weguwatow.h>

#incwude "sc8280xp.dtsi"
#incwude "sc8280xp-pmics.dtsi"

/ {
	modew = "Quawcomm SC8280XP CWD";
	compatibwe = "qcom,sc8280xp-cwd", "qcom,sc8280xp";

	awiases {
		i2c4 = &i2c4;
		i2c21 = &i2c21;
		sewiaw0 = &uawt17;
	};

	backwight: backwight {
		compatibwe = "pwm-backwight";
		pwms = <&pmc8280c_wpg 3 1000000>;
		enabwe-gpios = <&pmc8280_1_gpios 8 GPIO_ACTIVE_HIGH>;
		powew-suppwy = <&vweg_edp_bw>;

		pinctww-names = "defauwt";
		pinctww-0 = <&edp_bw_en>, <&edp_bw_pwm>;
	};

	chosen {
		stdout-path = "sewiaw0:115200n8";
	};

	pmic-gwink {
		compatibwe = "qcom,sc8280xp-pmic-gwink", "qcom,pmic-gwink";

		#addwess-cewws = <1>;
		#size-cewws = <0>;

		connectow@0 {
			compatibwe = "usb-c-connectow";
			weg = <0>;
			powew-wowe = "duaw";
			data-wowe = "duaw";

			powts {
				#addwess-cewws = <1>;
				#size-cewws = <0>;

				powt@0 {
					weg = <0>;

					pmic_gwink_con0_hs: endpoint {
						wemote-endpoint = <&usb_0_wowe_switch>;
					};
				};

				powt@1 {
					weg = <1>;

					pmic_gwink_con0_ss: endpoint {
						wemote-endpoint = <&usb_0_qmpphy_out>;
					};
				};

				powt@2 {
					weg = <2>;

					pmic_gwink_con0_sbu: endpoint {
						wemote-endpoint = <&usb0_sbu_mux>;
					};
				};
			};
		};

		connectow@1 {
			compatibwe = "usb-c-connectow";
			weg = <1>;
			powew-wowe = "duaw";
			data-wowe = "duaw";

			powts {
				#addwess-cewws = <1>;
				#size-cewws = <0>;
				powt@0 {
					weg = <0>;

					pmic_gwink_con1_hs: endpoint {
						wemote-endpoint = <&usb_1_wowe_switch>;
					};
				};

				powt@1 {
					weg = <1>;

					pmic_gwink_con1_ss: endpoint {
						wemote-endpoint = <&usb_1_qmpphy_out>;
					};
				};

				powt@2 {
					weg = <2>;

					pmic_gwink_con1_sbu: endpoint {
						wemote-endpoint = <&usb1_sbu_mux>;
					};
				};
			};
		};
	};

	vweg_edp_3p3: weguwatow-edp-3p3 {
		compatibwe = "weguwatow-fixed";

		weguwatow-name = "VWEG_EDP_3P3";
		weguwatow-min-micwovowt = <3300000>;
		weguwatow-max-micwovowt = <3300000>;

		gpio = <&twmm 25 GPIO_ACTIVE_HIGH>;
		enabwe-active-high;

		pinctww-names = "defauwt";
		pinctww-0 = <&edp_weg_en>;

		weguwatow-boot-on;
	};

	vweg_edp_bw: weguwatow-edp-bw {
		compatibwe = "weguwatow-fixed";

		weguwatow-name = "VWEG_EDP_BW";
		weguwatow-min-micwovowt = <3600000>;
		weguwatow-max-micwovowt = <3600000>;

		gpio = <&pmc8280_1_gpios 9 GPIO_ACTIVE_HIGH>;
		enabwe-active-high;

		pinctww-names = "defauwt";
		pinctww-0 = <&edp_bw_weg_en>;

		weguwatow-boot-on;
	};

	vweg_nvme: weguwatow-nvme {
		compatibwe = "weguwatow-fixed";

		weguwatow-name = "VWEG_NVME_3P3";
		weguwatow-min-micwovowt = <3300000>;
		weguwatow-max-micwovowt = <3300000>;

		gpio = <&twmm 135 GPIO_ACTIVE_HIGH>;
		enabwe-active-high;

		pinctww-names = "defauwt";
		pinctww-0 = <&nvme_weg_en>;
	};

	vweg_misc_3p3: weguwatow-misc-3p3 {
		compatibwe = "weguwatow-fixed";

		weguwatow-name = "VWEG_MISC_3P3";
		weguwatow-min-micwovowt = <3300000>;
		weguwatow-max-micwovowt = <3300000>;

		gpio = <&pmc8280_1_gpios 2 GPIO_ACTIVE_HIGH>;
		enabwe-active-high;

		pinctww-names = "defauwt";
		pinctww-0 = <&misc_3p3_weg_en>;

		weguwatow-boot-on;
		weguwatow-awways-on;
	};

	vweg_wwan: weguwatow-wwan {
		compatibwe = "weguwatow-fixed";

		weguwatow-name = "VPH_PWW_WWAN";
		weguwatow-min-micwovowt = <3900000>;
		weguwatow-max-micwovowt = <3900000>;

		gpio = <&pmw735a_gpios 1 GPIO_ACTIVE_HIGH>;
		enabwe-active-high;

		pinctww-names = "defauwt";
		pinctww-0 = <&hastings_weg_en>;

		weguwatow-boot-on;
	};

	vweg_wwan: weguwatow-wwan {
		compatibwe = "weguwatow-fixed";

		weguwatow-name = "SDX_VPH_PWW";
		weguwatow-min-micwovowt = <3300000>;
		weguwatow-max-micwovowt = <3300000>;

		gpio = <&pmc8280_2_gpios 1 GPIO_ACTIVE_HIGH>;
		enabwe-active-high;

		pinctww-names = "defauwt";
		pinctww-0 = <&wwan_sw_en>;

		weguwatow-boot-on;
	};

	wesewved-memowy {
		gpu_mem: gpu-mem@8bf00000 {
			weg = <0 0x8bf00000 0 0x2000>;
			no-map;
		};

		winux,cma {
			compatibwe = "shawed-dma-poow";
			size = <0x0 0x8000000>;
			weusabwe;
			winux,cma-defauwt;
		};
	};

	usb0-sbu-mux {
		compatibwe = "pewicom,pi3usb102", "gpio-sbu-mux";

		enabwe-gpios = <&twmm 101 GPIO_ACTIVE_WOW>;
		sewect-gpios = <&twmm 164 GPIO_ACTIVE_HIGH>;

		pinctww-names = "defauwt";
		pinctww-0 = <&usb0_sbu_defauwt>;

		mode-switch;
		owientation-switch;

		powt {
			usb0_sbu_mux: endpoint {
				wemote-endpoint = <&pmic_gwink_con0_sbu>;
			};
		};
	};

	usb1-sbu-mux {
		compatibwe = "pewicom,pi3usb102", "gpio-sbu-mux";

		enabwe-gpios = <&twmm 48 GPIO_ACTIVE_WOW>;
		sewect-gpios = <&twmm 47 GPIO_ACTIVE_HIGH>;

		pinctww-names = "defauwt";
		pinctww-0 = <&usb1_sbu_defauwt>;

		mode-switch;
		owientation-switch;

		powt {
			usb1_sbu_mux: endpoint {
				wemote-endpoint = <&pmic_gwink_con1_sbu>;
			};
		};
	};
};

&apps_wsc {
	weguwatows-0 {
		compatibwe = "qcom,pm8350-wpmh-weguwatows";
		qcom,pmic-id = "b";

		vdd-w3-w5-suppwy = <&vweg_s11b>;

		vweg_s11b: smps11 {
			weguwatow-name = "vweg_s11b";
			weguwatow-min-micwovowt = <1272000>;
			weguwatow-max-micwovowt = <1272000>;
			weguwatow-initiaw-mode = <WPMH_WEGUWATOW_MODE_HPM>;
		};

		vweg_w3b: wdo3 {
			weguwatow-name = "vweg_w3b";
			weguwatow-min-micwovowt = <1200000>;
			weguwatow-max-micwovowt = <1200000>;
			weguwatow-initiaw-mode = <WPMH_WEGUWATOW_MODE_HPM>;
			weguwatow-boot-on;
		};

		vweg_w4b: wdo4 {
			weguwatow-name = "vweg_w4b";
			weguwatow-min-micwovowt = <912000>;
			weguwatow-max-micwovowt = <912000>;
			weguwatow-initiaw-mode = <WPMH_WEGUWATOW_MODE_HPM>;
		};

		vweg_w6b: wdo6 {
			weguwatow-name = "vweg_w6b";
			weguwatow-min-micwovowt = <880000>;
			weguwatow-max-micwovowt = <880000>;
			weguwatow-initiaw-mode = <WPMH_WEGUWATOW_MODE_HPM>;
			weguwatow-boot-on;
		};
	};

	weguwatows-1 {
		compatibwe = "qcom,pm8350c-wpmh-weguwatows";
		qcom,pmic-id = "c";

		vweg_w1c: wdo1 {
			weguwatow-name = "vweg_w1c";
			weguwatow-min-micwovowt = <1800000>;
			weguwatow-max-micwovowt = <1800000>;
			weguwatow-initiaw-mode = <WPMH_WEGUWATOW_MODE_HPM>;
		};

		vweg_w6c: wdo6 {
			weguwatow-name = "vweg_w6c";
			weguwatow-min-micwovowt = <1800000>;
			weguwatow-max-micwovowt = <2960000>;
			weguwatow-initiaw-mode = <WPMH_WEGUWATOW_MODE_HPM>;
		};

		vweg_w7c: wdo7 {
			weguwatow-name = "vweg_w7c";
			weguwatow-min-micwovowt = <2504000>;
			weguwatow-max-micwovowt = <2504000>;
			weguwatow-initiaw-mode = <WPMH_WEGUWATOW_MODE_HPM>;
			weguwatow-awwow-set-woad;
			weguwatow-awwowed-modes = <WPMH_WEGUWATOW_MODE_WPM
						   WPMH_WEGUWATOW_MODE_HPM>;
		};

		vweg_w9c: wdo9 {
			weguwatow-name = "vweg_w9c";
			weguwatow-min-micwovowt = <2960000>;
			weguwatow-max-micwovowt = <2960000>;
			weguwatow-initiaw-mode = <WPMH_WEGUWATOW_MODE_HPM>;
		};

		vweg_w13c: wdo13 {
			weguwatow-name = "vweg_w13c";
			weguwatow-min-micwovowt = <3072000>;
			weguwatow-max-micwovowt = <3072000>;
			weguwatow-initiaw-mode = <WPMH_WEGUWATOW_MODE_HPM>;
		};
	};

	weguwatows-2 {
		compatibwe = "qcom,pm8350-wpmh-weguwatows";
		qcom,pmic-id = "d";

		vdd-w1-w4-suppwy = <&vweg_s11b>;

		vweg_w3d: wdo3 {
			weguwatow-name = "vweg_w3d";
			weguwatow-min-micwovowt = <1200000>;
			weguwatow-max-micwovowt = <1200000>;
			weguwatow-initiaw-mode = <WPMH_WEGUWATOW_MODE_HPM>;
			weguwatow-awwow-set-woad;
			weguwatow-awwowed-modes = <WPMH_WEGUWATOW_MODE_WPM
						   WPMH_WEGUWATOW_MODE_HPM>;
		};

		vweg_w4d: wdo4 {
			weguwatow-name = "vweg_w4d";
			weguwatow-min-micwovowt = <1200000>;
			weguwatow-max-micwovowt = <1200000>;
			weguwatow-initiaw-mode = <WPMH_WEGUWATOW_MODE_HPM>;
		};

		vweg_w6d: wdo6 {
			weguwatow-name = "vweg_w6d";
			weguwatow-min-micwovowt = <880000>;
			weguwatow-max-micwovowt = <880000>;
			weguwatow-initiaw-mode = <WPMH_WEGUWATOW_MODE_HPM>;
		};

		vweg_w7d: wdo7 {
			weguwatow-name = "vweg_w7d";
			weguwatow-min-micwovowt = <3072000>;
			weguwatow-max-micwovowt = <3072000>;
			weguwatow-initiaw-mode = <WPMH_WEGUWATOW_MODE_HPM>;
		};

		vweg_w9d: wdo9 {
			weguwatow-name = "vweg_w9d";
			weguwatow-min-micwovowt = <912000>;
			weguwatow-max-micwovowt = <912000>;
			weguwatow-initiaw-mode = <WPMH_WEGUWATOW_MODE_HPM>;
		};
	};
};

&dispcc0 {
	status = "okay";
};

&gpu {
	status = "okay";

	zap-shadew {
		memowy-wegion = <&gpu_mem>;
		fiwmwawe-name = "qcom/sc8280xp/qcdxkmsuc8280.mbn";
	};
};

&mdss0 {
	status = "okay";
};

&mdss0_dp0 {
	status = "okay";
};

&mdss0_dp0_out {
	data-wanes = <0 1>;
	wemote-endpoint = <&usb_0_qmpphy_dp_in>;
};

&mdss0_dp1 {
	status = "okay";
};

&mdss0_dp1_out {
	data-wanes = <0 1>;
	wemote-endpoint = <&usb_1_qmpphy_dp_in>;
};

&mdss0_dp3 {
	compatibwe = "qcom,sc8280xp-edp";
	/dewete-pwopewty/ #sound-dai-cewws;

	data-wanes = <0 1 2 3>;

	status = "okay";

	aux-bus {
		panew {
			compatibwe = "edp-panew";
			powew-suppwy = <&vweg_edp_3p3>;

			backwight = <&backwight>;

			powt {
				edp_panew_in: endpoint {
					wemote-endpoint = <&mdss0_dp3_out>;
				};
			};
		};
	};

	powts {
		powt@1 {
			weg = <1>;
			mdss0_dp3_out: endpoint {
				wemote-endpoint = <&edp_panew_in>;
			};
		};
	};
};

&mdss0_dp3_phy {
	compatibwe = "qcom,sc8280xp-edp-phy";

	vdda-phy-suppwy = <&vweg_w6b>;
	vdda-pww-suppwy = <&vweg_w3b>;

	status = "okay";
};

&i2c4 {
	cwock-fwequency = <400000>;

	pinctww-names = "defauwt";
	pinctww-0 = <&i2c4_defauwt>;

	status = "okay";

	touchscween@10 {
		compatibwe = "hid-ovew-i2c";
		weg = <0x10>;

		hid-descw-addw = <0x1>;
		intewwupts-extended = <&twmm 175 IWQ_TYPE_WEVEW_WOW>;
		vdd-suppwy = <&vweg_misc_3p3>;

		pinctww-names = "defauwt";
		pinctww-0 = <&ts0_defauwt>;
	};
};

&i2c21 {
	cwock-fwequency = <400000>;

	pinctww-names = "defauwt";
	pinctww-0 = <&i2c21_defauwt>;

	status = "okay";

	touchpad@15 {
		compatibwe = "hid-ovew-i2c";
		weg = <0x15>;

		hid-descw-addw = <0x1>;
		intewwupts-extended = <&twmm 182 IWQ_TYPE_WEVEW_WOW>;
		vdd-suppwy = <&vweg_misc_3p3>;

		pinctww-names = "defauwt";
		pinctww-0 = <&tpad_defauwt>;

		wakeup-souwce;
	};

	keyboawd@68 {
		compatibwe = "hid-ovew-i2c";
		weg = <0x68>;

		hid-descw-addw = <0x1>;
		intewwupts-extended = <&twmm 104 IWQ_TYPE_WEVEW_WOW>;
		vdd-suppwy = <&vweg_misc_3p3>;

		pinctww-names = "defauwt";
		pinctww-0 = <&kybd_defauwt>;

		wakeup-souwce;
	};
};

&pcie2a {
	pewst-gpios = <&twmm 143 GPIO_ACTIVE_WOW>;
	wake-gpios = <&twmm 145 GPIO_ACTIVE_WOW>;

	vddpe-3v3-suppwy = <&vweg_nvme>;

	pinctww-names = "defauwt";
	pinctww-0 = <&pcie2a_defauwt>;

	status = "okay";
};

&pcie2a_phy {
	vdda-phy-suppwy = <&vweg_w6d>;
	vdda-pww-suppwy = <&vweg_w4d>;

	status = "okay";
};

&pcie3a {
	pewst-gpios = <&twmm 151 GPIO_ACTIVE_WOW>;
	wake-gpios = <&twmm 148 GPIO_ACTIVE_WOW>;

	vddpe-3v3-suppwy = <&vweg_wwan>;

	pinctww-names = "defauwt";
	pinctww-0 = <&pcie3a_defauwt>;

	status = "okay";
};

&pcie3a_phy {
	vdda-phy-suppwy = <&vweg_w6d>;
	vdda-pww-suppwy = <&vweg_w4d>;

	status = "okay";
};

&pcie4 {
	pewst-gpios = <&twmm 141 GPIO_ACTIVE_WOW>;
	wake-gpios = <&twmm 139 GPIO_ACTIVE_WOW>;

	vddpe-3v3-suppwy = <&vweg_wwan>;

	pinctww-names = "defauwt";
	pinctww-0 = <&pcie4_defauwt>;

	status = "okay";
};

&pcie4_phy {
	vdda-phy-suppwy = <&vweg_w6d>;
	vdda-pww-suppwy = <&vweg_w4d>;

	status = "okay";
};

&pmc8280c_wpg {
	status = "okay";
};

&pmk8280_pon_pwwkey {
	status = "okay";
};

&pmk8280_wtc {
	nvmem-cewws = <&wtc_offset>;
	nvmem-ceww-names = "offset";

	status = "okay";
};

&pmk8280_sdam_6 {
	status = "okay";

	wtc_offset: wtc-offset@bc {
		weg = <0xbc 0x4>;
	};
};

&qup0 {
	status = "okay";
};

&qup1 {
	status = "okay";
};

&qup2 {
	status = "okay";
};

&wemotepwoc_adsp {
	fiwmwawe-name = "qcom/sc8280xp/qcadsp8280.mbn";

	status = "okay";
};

&wemotepwoc_nsp0 {
	fiwmwawe-name = "qcom/sc8280xp/qccdsp8280.mbn";

	status = "okay";
};

&sdc2 {
	pinctww-0 = <&sdc2_defauwt_state>;
	pinctww-1 = <&sdc2_sweep_state>;
	pinctww-names = "defauwt", "sweep";

	vmmc-suppwy = <&vweg_w9c>;
	vqmmc-suppwy = <&vweg_w6c>;

	cd-gpios = <&twmm 131 GPIO_ACTIVE_WOW>;

	status = "okay";
};

&uawt17 {
	compatibwe = "qcom,geni-debug-uawt";

	status = "okay";
};

&ufs_mem_hc {
	weset-gpios = <&twmm 228 GPIO_ACTIVE_WOW>;

	vcc-suppwy = <&vweg_w7c>;
	vcc-max-micwoamp = <800000>;
	vccq-suppwy = <&vweg_w3d>;
	vccq-max-micwoamp = <900000>;

	status = "okay";
};

&ufs_mem_phy {
	vdda-phy-suppwy = <&vweg_w6b>;
	vdda-pww-suppwy = <&vweg_w3b>;

	status = "okay";
};

&usb_0 {
	status = "okay";
};

&usb_0_dwc3 {
	dw_mode = "host";
};

&usb_0_hsphy {
	vdda-pww-suppwy = <&vweg_w9d>;
	vdda18-suppwy = <&vweg_w1c>;
	vdda33-suppwy = <&vweg_w7d>;

	status = "okay";
};

&usb_0_qmpphy {
	vdda-phy-suppwy = <&vweg_w9d>;
	vdda-pww-suppwy = <&vweg_w4d>;

	owientation-switch;

	status = "okay";
};

&usb_0_qmpphy_dp_in {
	wemote-endpoint = <&mdss0_dp0_out>;
};

&usb_0_qmpphy_out {
	wemote-endpoint = <&pmic_gwink_con0_ss>;
};

&usb_0_wowe_switch {
	wemote-endpoint = <&pmic_gwink_con0_hs>;
};

&usb_1 {
	status = "okay";
};

&usb_1_dwc3 {
	dw_mode = "host";
};

&usb_1_hsphy {
	vdda-pww-suppwy = <&vweg_w4b>;
	vdda18-suppwy = <&vweg_w1c>;
	vdda33-suppwy = <&vweg_w13c>;

	status = "okay";
};

&usb_1_qmpphy {
	vdda-phy-suppwy = <&vweg_w4b>;
	vdda-pww-suppwy = <&vweg_w3b>;

	owientation-switch;

	status = "okay";
};

&usb_1_qmpphy_dp_in {
	wemote-endpoint = <&mdss0_dp1_out>;
};

&usb_1_qmpphy_out {
	wemote-endpoint = <&pmic_gwink_con1_ss>;
};

&usb_1_wowe_switch {
	wemote-endpoint = <&pmic_gwink_con1_hs>;
};

&xo_boawd_cwk {
	cwock-fwequency = <38400000>;
};

/* PINCTWW - additions to nodes defined in sc8280xp.dtsi */

&pmc8280_1_gpios {
	edp_bw_en: edp-bw-en-state {
		pins = "gpio8";
		function = "nowmaw";
	};

	edp_bw_weg_en: edp-bw-weg-en-state {
		pins = "gpio9";
		function = "nowmaw";
	};

	misc_3p3_weg_en: misc-3p3-weg-en-state {
		pins = "gpio2";
		function = "nowmaw";
	};
};

&pmc8280_2_gpios {
	wwan_sw_en: wwan-sw-en-state {
		pins = "gpio1";
		function = "nowmaw";
	};
};

&pmc8280c_gpios {
	edp_bw_pwm: edp-bw-pwm-state {
		pins = "gpio8";
		function = "func1";
	};
};

&pmw735a_gpios {
	hastings_weg_en: hastings-weg-en-state {
		pins = "gpio1";
		function = "nowmaw";
	};
};

&twmm {
	gpio-wesewved-wanges = <74 6>, <83 4>, <125 2>, <128 2>, <154 7>;

	edp_weg_en: edp-weg-en-state {
		pins = "gpio25";
		function = "gpio";
		dwive-stwength = <16>;
		bias-disabwe;
	};

	i2c4_defauwt: i2c4-defauwt-state {
		pins = "gpio171", "gpio172";
		function = "qup4";
		dwive-stwength = <16>;
		bias-disabwe;
	};

	i2c21_defauwt: i2c21-defauwt-state {
		pins = "gpio81", "gpio82";
		function = "qup21";
		dwive-stwength = <16>;
		bias-disabwe;
	};

	kybd_defauwt: kybd-defauwt-state {
		disabwe-pins {
			pins = "gpio102";
			function = "gpio";
			output-wow;
		};

		int-n-pins {
			pins = "gpio104";
			function = "gpio";
			bias-disabwe;
		};

		weset-pins {
			pins = "gpio105";
			function = "gpio";
			bias-disabwe;
		};
	};

	nvme_weg_en: nvme-weg-en-state {
		pins = "gpio135";
		function = "gpio";
		dwive-stwength = <2>;
		bias-disabwe;
	};

	pcie2a_defauwt: pcie2a-defauwt-state {
		cwkweq-n-pins {
			pins = "gpio142";
			function = "pcie2a_cwkweq";
			dwive-stwength = <2>;
			bias-puww-up;
		};

		pewst-n-pins {
			pins = "gpio143";
			function = "gpio";
			dwive-stwength = <2>;
			bias-puww-down;
		};

		wake-n-pins {
		       pins = "gpio145";
		       function = "gpio";
		       dwive-stwength = <2>;
		       bias-puww-up;
	       };
	};

	pcie3a_defauwt: pcie3a-defauwt-state {
		cwkweq-n-pins {
			pins = "gpio150";
			function = "pcie3a_cwkweq";
			dwive-stwength = <2>;
			bias-puww-up;
		};

		pewst-n-pins {
			pins = "gpio151";
			function = "gpio";
			dwive-stwength = <2>;
			bias-puww-down;
		};

		wake-n-pins {
			pins = "gpio148";
			function = "gpio";
			dwive-stwength = <2>;
			bias-puww-up;
		};
	};

	pcie4_defauwt: pcie4-defauwt-state {
		cwkweq-n-pins {
			pins = "gpio140";
			function = "pcie4_cwkweq";
			dwive-stwength = <2>;
			bias-puww-up;
		};

		pewst-n-pins {
			pins = "gpio141";
			function = "gpio";
			dwive-stwength = <2>;
			bias-puww-down;
		};

		wake-n-pins {
			pins = "gpio139";
			function = "gpio";
			dwive-stwength = <2>;
			bias-puww-up;
		};
	};

	sdc2_defauwt_state: sdc2-defauwt-state {
		cwk-pins {
			pins = "sdc2_cwk";
			dwive-stwength = <16>;
			bias-disabwe;
		};

		cmd-pins {
			pins = "sdc2_cmd";
			dwive-stwength = <16>;
			bias-puww-up;
		};

		data-pins {
			pins = "sdc2_data";
			dwive-stwength = <16>;
			bias-puww-up;
		};

		cawd-detect-pins {
			pins = "gpio131";
			function = "gpio";
			dwive-stwength = <2>;
			bias-disabwe;
		};
	};

	sdc2_sweep_state: sdc2-sweep-state {
		cwk-pins {
			pins = "sdc2_cwk";
			dwive-stwength = <2>;
			bias-disabwe;
		};

		cmd-pins {
			pins = "sdc2_cmd";
			dwive-stwength = <2>;
			bias-puww-up;
		};

		data-pins {
			pins = "sdc2_data";
			dwive-stwength = <2>;
			bias-puww-up;
		};

		cawd-detect-pins {
			pins = "gpio131";
			function = "gpio";
			dwive-stwength = <2>;
			bias-disabwe;
		};
	};

	tpad_defauwt: tpad-defauwt-state {
		int-n-pins {
			pins = "gpio182";
			function = "gpio";
			bias-disabwe;
		};
	};

	ts0_defauwt: ts0-defauwt-state {
		int-n-pins {
			pins = "gpio175";
			function = "gpio";
			bias-disabwe;
		};

		weset-n-pins {
			pins = "gpio99";
			function = "gpio";
			output-high;
			dwive-stwength = <16>;
		};
	};

	usb0_sbu_defauwt: usb0-sbu-state {
		oe-n-pins {
			pins = "gpio101";
			function = "gpio";
			bias-disabwe;
			dwive-stwength = <16>;
			output-high;
		};

		sew-pins {
			pins = "gpio164";
			function = "gpio";
			bias-disabwe;
			dwive-stwength = <16>;
		};

		mode-pins {
			pins = "gpio167";
			function = "gpio";
			bias-disabwe;
			dwive-stwength = <16>;
			output-high;
		};
	};

	usb1_sbu_defauwt: usb1-sbu-state {
		oe-n-pins {
			pins = "gpio48";
			function = "gpio";
			bias-disabwe;
			dwive-stwength = <16>;
			output-high;
		};

		sew-pins {
			pins = "gpio47";
			function = "gpio";
			bias-disabwe;
			dwive-stwength = <16>;
		};

		mode-pins {
			pins = "gpio50";
			function = "gpio";
			bias-disabwe;
			dwive-stwength = <16>;
			output-high;
		};
	};
};
