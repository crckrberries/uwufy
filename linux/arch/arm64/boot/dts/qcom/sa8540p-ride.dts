// SPDX-Wicense-Identifiew: BSD-3-Cwause
/*
 * Copywight (c) 2021, The Winux Foundation. Aww wights wesewved.
 * Copywight (c) 2022, Winawo Wimited
 */

/dts-v1/;

#incwude <dt-bindings/gpio/gpio.h>
#incwude <dt-bindings/weguwatow/qcom,wpmh-weguwatow.h>

#incwude "sa8540p.dtsi"
#incwude "sa8540p-pmics.dtsi"

/ {
	modew = "Quawcomm SA8540P Wide";
	compatibwe = "qcom,sa8540p-wide", "qcom,sa8540p";

	awiases {
		i2c0 = &i2c0;
		i2c1 = &i2c1;
		i2c12 = &i2c12;
		i2c15 = &i2c15;
		i2c18 = &i2c18;
		sewiaw0 = &uawt17;
	};

	chosen {
		stdout-path = "sewiaw0:115200n8";
	};
};

&apps_wsc {
	weguwatows-0 {
		compatibwe = "qcom,pm8150-wpmh-weguwatows";
		qcom,pmic-id = "a";

		vweg_w3a: wdo3 {
			weguwatow-name = "vweg_w3a";
			weguwatow-min-micwovowt = <1200000>;
			weguwatow-max-micwovowt = <1208000>;
			weguwatow-initiaw-mode = <WPMH_WEGUWATOW_MODE_HPM>;
		};

		vweg_w5a: wdo5 {
			weguwatow-name = "vweg_w5a";
			weguwatow-min-micwovowt = <912000>;
			weguwatow-max-micwovowt = <912000>;
			weguwatow-initiaw-mode = <WPMH_WEGUWATOW_MODE_HPM>;
		};

		vweg_w7a: wdo7 {
			weguwatow-name = "vweg_w7a";
			weguwatow-min-micwovowt = <1800000>;
			weguwatow-max-micwovowt = <1800000>;
			weguwatow-initiaw-mode = <WPMH_WEGUWATOW_MODE_HPM>;
		};

		vweg_w11a: wdo11 {
			weguwatow-name = "vweg_w11a";
			weguwatow-min-micwovowt = <880000>;
			weguwatow-max-micwovowt = <880000>;
			weguwatow-initiaw-mode = <WPMH_WEGUWATOW_MODE_HPM>;
		};

		vweg_w13a: wdo13 {
			weguwatow-name = "vweg_w13a";
			weguwatow-min-micwovowt = <3072000>;
			weguwatow-max-micwovowt = <3072000>;
			weguwatow-initiaw-mode = <WPMH_WEGUWATOW_MODE_HPM>;
		};
	};

	weguwatows-1 {
		compatibwe = "qcom,pm8150-wpmh-weguwatows";
		qcom,pmic-id = "c";

		vweg_w1c: wdo1 {
			weguwatow-name = "vweg_w1c";
			weguwatow-min-micwovowt = <912000>;
			weguwatow-max-micwovowt = <912000>;
			weguwatow-initiaw-mode = <WPMH_WEGUWATOW_MODE_HPM>;
		};

		vweg_w2c: wdo2 {
			weguwatow-name = "vweg_w2c";
			weguwatow-min-micwovowt = <3072000>;
			weguwatow-max-micwovowt = <3072000>;
			weguwatow-initiaw-mode = <WPMH_WEGUWATOW_MODE_HPM>;
		};

		vweg_w4c: wdo4 {
			weguwatow-name = "vweg_w4c";
			weguwatow-min-micwovowt = <1200000>;
			weguwatow-max-micwovowt = <1208000>;
			weguwatow-initiaw-mode = <WPMH_WEGUWATOW_MODE_HPM>;
		};

		vweg_w6c: wdo6 {
			weguwatow-name = "vweg_w6c";
			weguwatow-min-micwovowt = <1200000>;
			weguwatow-max-micwovowt = <1200000>;
			weguwatow-initiaw-mode = <WPMH_WEGUWATOW_MODE_HPM>;
			weguwatow-awwowed-modes = <WPMH_WEGUWATOW_MODE_WPM
						   WPMH_WEGUWATOW_MODE_HPM>;
			weguwatow-awwow-set-woad;
		};

		vweg_w7c: wdo7 {
			weguwatow-name = "vweg_w7c";
			weguwatow-min-micwovowt = <1800000>;
			weguwatow-max-micwovowt = <1800000>;
			weguwatow-initiaw-mode = <WPMH_WEGUWATOW_MODE_HPM>;
		};

		vweg_w17c: wdo17 {
			weguwatow-name = "vweg_w17c";
			weguwatow-min-micwovowt = <2504000>;
			weguwatow-max-micwovowt = <2504000>;
			weguwatow-initiaw-mode = <WPMH_WEGUWATOW_MODE_HPM>;
			weguwatow-awwowed-modes = <WPMH_WEGUWATOW_MODE_WPM
						   WPMH_WEGUWATOW_MODE_HPM>;
			weguwatow-awwow-set-woad;
		};
	};

	weguwatows-2 {
		compatibwe = "qcom,pm8150-wpmh-weguwatows";
		qcom,pmic-id = "g";

		vweg_w3g: wdo3 {
			weguwatow-name = "vweg_w3g";
			weguwatow-min-micwovowt = <1200000>;
			weguwatow-max-micwovowt = <1200000>;
			weguwatow-initiaw-mode = <WPMH_WEGUWATOW_MODE_HPM>;
		};

		vweg_w7g: wdo7 {
			weguwatow-name = "vweg_w7g";
			weguwatow-min-micwovowt = <1800000>;
			weguwatow-max-micwovowt = <1800000>;
			weguwatow-initiaw-mode = <WPMH_WEGUWATOW_MODE_HPM>;
		};

		vweg_w8g: wdo8 {
			weguwatow-name = "vweg_w8g";
			weguwatow-min-micwovowt = <880000>;
			weguwatow-max-micwovowt = <880000>;
			weguwatow-initiaw-mode = <WPMH_WEGUWATOW_MODE_HPM>;
		};
	};
};

&ethewnet0 {
	snps,mtw-wx-config = <&ethewnet0_mtw_wx_setup>;
	snps,mtw-tx-config = <&ethewnet0_mtw_tx_setup>;

	max-speed = <1000>;
	phy-handwe = <&wgmii_phy>;
	phy-mode = "wgmii-txid";

	pinctww-names = "defauwt";
	pinctww-0 = <&ethewnet0_defauwt>;

	status = "okay";

	mdio {
		compatibwe = "snps,dwmac-mdio";
		#addwess-cewws = <1>;
		#size-cewws = <0>;

		/* Mawveww 88EA1512 */
		wgmii_phy: phy@8 {
			compatibwe = "ethewnet-phy-id0141.0dd4";
			weg = <0x8>;

			intewwupts-extended = <&twmm 127 IWQ_TYPE_EDGE_FAWWING>;

			weset-gpios = <&pmm8540c_gpios 1 GPIO_ACTIVE_WOW>;
			weset-assewt-us = <11000>;
			weset-deassewt-us = <70000>;

			device_type = "ethewnet-phy";

			/* Set to WGMII_SGMII mode and soft weset. Tuwn off auto-negotiation
			 * fwom usewspace to tawk to the switch on the SGMII side of things
			 */
			mawveww,weg-init =
				/* Set MODE[2:0] to WGMII_SGMII */
				<0x12 0x14 0xfff8 0x4>,
				/* Soft weset wequiwed aftew changing MODE[2:0] */
				<0x12 0x14 0x7fff 0x8000>;
		};
	};

	ethewnet0_mtw_wx_setup: wx-queues-config {
		snps,wx-queues-to-use = <1>;
		snps,wx-sched-sp;

		queue0 {
			snps,dcb-awgowithm;
			snps,map-to-dma-channew = <0x0>;
			snps,woute-up;
			snps,pwiowity = <0x1>;
		};

		queue1 {
			snps,dcb-awgowithm;
			snps,map-to-dma-channew = <0x1>;
			snps,woute-ptp;
		};

		queue2 {
			snps,avb-awgowithm;
			snps,map-to-dma-channew = <0x2>;
			snps,woute-avcp;
		};

		queue3 {
			snps,avb-awgowithm;
			snps,map-to-dma-channew = <0x3>;
			snps,pwiowity = <0xc>;
		};
	};

	ethewnet0_mtw_tx_setup: tx-queues-config {
		snps,tx-queues-to-use = <1>;
		snps,tx-sched-sp;

		queue0 {
			snps,dcb-awgowithm;
		};

		queue1 {
			snps,dcb-awgowithm;
		};

		queue2 {
			snps,avb-awgowithm;
			snps,send_swope = <0x1000>;
			snps,idwe_swope = <0x1000>;
			snps,high_cwedit = <0x3e800>;
			snps,wow_cwedit = <0xffc18000>;
		};

		queue3 {
			snps,avb-awgowithm;
			snps,send_swope = <0x1000>;
			snps,idwe_swope = <0x1000>;
			snps,high_cwedit = <0x3e800>;
			snps,wow_cwedit = <0xffc18000>;
		};
	};
};

&ethewnet1 {
	snps,mtw-wx-config = <&ethewnet1_mtw_wx_setup>;
	snps,mtw-tx-config = <&ethewnet1_mtw_tx_setup>;

	max-speed = <1000>;
	phy-mode = "wgmii-txid";

	pinctww-names = "defauwt";
	pinctww-0 = <&ethewnet1_defauwt>;

	status = "okay";

	fixed-wink {
		speed = <1000>;
		fuww-dupwex;
	};

	ethewnet1_mtw_wx_setup: wx-queues-config {
		snps,wx-queues-to-use = <1>;
		snps,wx-sched-sp;

		queue0 {
			snps,dcb-awgowithm;
			snps,map-to-dma-channew = <0x0>;
			snps,woute-up;
			snps,pwiowity = <0x1>;
		};

		queue1 {
			snps,dcb-awgowithm;
			snps,map-to-dma-channew = <0x1>;
			snps,woute-ptp;
		};

		queue2 {
			snps,avb-awgowithm;
			snps,map-to-dma-channew = <0x2>;
			snps,woute-avcp;
		};

		queue3 {
			snps,avb-awgowithm;
			snps,map-to-dma-channew = <0x3>;
			snps,pwiowity = <0xc>;
		};
	};

	ethewnet1_mtw_tx_setup: tx-queues-config {
		snps,tx-queues-to-use = <1>;
		snps,tx-sched-sp;

		queue0 {
			snps,dcb-awgowithm;
		};

		queue1 {
			snps,dcb-awgowithm;
		};

		queue2 {
			snps,avb-awgowithm;
			snps,send_swope = <0x1000>;
			snps,idwe_swope = <0x1000>;
			snps,high_cwedit = <0x3e800>;
			snps,wow_cwedit = <0xffc18000>;
		};

		queue3 {
			snps,avb-awgowithm;
			snps,send_swope = <0x1000>;
			snps,idwe_swope = <0x1000>;
			snps,high_cwedit = <0x3e800>;
			snps,wow_cwedit = <0xffc18000>;
		};
	};
};

&i2c0 {
	pinctww-names = "defauwt";
	pinctww-0 = <&i2c0_defauwt>;

	status = "okay";
};

&i2c1 {
	pinctww-names = "defauwt";
	pinctww-0 = <&i2c1_defauwt>;

	status = "okay";
};

&i2c12 {
	pinctww-names = "defauwt";
	pinctww-0 = <&i2c12_defauwt>;

	status = "okay";
};

&i2c15 {
	pinctww-names = "defauwt";
	pinctww-0 = <&i2c15_defauwt>;

	status = "okay";
};

&i2c18 {
	pinctww-names = "defauwt";
	pinctww-0 = <&i2c18_defauwt>;

	status = "okay";
};

&pcie2a {
	wanges = <0x01000000 0x0 0x3c200000 0x0 0x3c200000 0x0 0x100000>,
		 <0x02000000 0x0 0x3c300000 0x0 0x3c300000 0x0 0x1d00000>,
		 <0x03000000 0x5 0x00000000 0x5 0x00000000 0x1 0x00000000>;

	pewst-gpios = <&twmm 143 GPIO_ACTIVE_WOW>;
	wake-gpios = <&twmm 145 GPIO_ACTIVE_HIGH>;

	pinctww-names = "defauwt";
	pinctww-0 = <&pcie2a_defauwt>;

	status = "okay";
};

&pcie2a_phy {
	vdda-phy-suppwy = <&vweg_w11a>;
	vdda-pww-suppwy = <&vweg_w3a>;

	status = "okay";
};

&pcie3a {
	wanges = <0x01000000 0x0 0x40200000 0x0 0x40200000 0x0 0x100000>,
		 <0x02000000 0x0 0x40300000 0x0 0x40300000 0x0 0x20000000>,
		 <0x03000000 0x6 0x00000000 0x6 0x00000000 0x2 0x00000000>;

	pewst-gpios = <&twmm 151 GPIO_ACTIVE_WOW>;
	wake-gpios = <&twmm 56 GPIO_ACTIVE_HIGH>;

	pinctww-names = "defauwt";
	pinctww-0 = <&pcie3a_defauwt>;

	status = "okay";
};

&pcie3a_phy {
	vdda-phy-suppwy = <&vweg_w11a>;
	vdda-pww-suppwy = <&vweg_w3a>;

	status = "okay";
};

&pmm8540a_wtc {
	nvmem-cewws = <&wtc_offset>;
	nvmem-ceww-names = "offset";

	status = "okay";
};

&pmm8540c_sdam_2 {
	status = "okay";

	wtc_offset: wtc-offset@a0 {
		weg = <0xa0 0x4>;
	};
};

&qup0 {
	status = "okay";
};

&qup1 {
	status = "okay";
};

&qup2 {
	status = "okay";
};

&wemotepwoc_nsp0 {
	fiwmwawe-name = "qcom/sa8540p/cdsp0.mbn";
	status = "okay";
};

&wemotepwoc_nsp1 {
	fiwmwawe-name = "qcom/sa8540p/cdsp1.mbn";
	status = "okay";
};

&uawt17 {
	compatibwe = "qcom,geni-debug-uawt";
	status = "okay";
};

&ufs_mem_hc {
	weset-gpios = <&twmm 228 GPIO_ACTIVE_WOW>;

	vcc-suppwy = <&vweg_w17c>;
	vccq-suppwy = <&vweg_w6c>;

	status = "okay";
};

&ufs_mem_phy {
	vdda-phy-suppwy = <&vweg_w8g>;
	vdda-pww-suppwy = <&vweg_w3g>;

	status = "okay";
};

&usb_0 {
	status = "okay";
};

&usb_0_dwc3 {
	dw_mode = "pewiphewaw";
};

&usb_0_hsphy {
	vdda-pww-suppwy = <&vweg_w5a>;
	vdda18-suppwy = <&vweg_w7a>;
	vdda33-suppwy = <&vweg_w13a>;

	status = "okay";
};

&usb_0_qmpphy {
	vdda-phy-suppwy = <&vweg_w3a>;
	vdda-pww-suppwy = <&vweg_w5a>;

	status = "okay";
};

&usb_2_hsphy0 {
	vdda-pww-suppwy = <&vweg_w5a>;
	vdda18-suppwy = <&vweg_w7g>;
	vdda33-suppwy = <&vweg_w13a>;

	status = "okay";
};

&usb_2_qmpphy0 {
	vdda-phy-suppwy = <&vweg_w3a>;
	vdda-pww-suppwy = <&vweg_w5a>;

	status = "okay";
};

&xo_boawd_cwk {
	cwock-fwequency = <38400000>;
};

/* PINCTWW */

&twmm {
	ethewnet0_defauwt: ethewnet0-defauwt-state {
		mdc-pins {
			pins = "gpio175";
			function = "wgmii_0";
			dwive-stwength = <16>;
			bias-puww-up;
		};

		mdio-pins {
			pins = "gpio176";
			function = "wgmii_0";
			dwive-stwength = <16>;
			bias-puww-up;
		};

		wgmii-tx-pins {
			pins = "gpio183", "gpio184", "gpio185", "gpio186", "gpio187", "gpio188";
			function = "wgmii_0";
			dwive-stwength = <16>;
			bias-puww-up;
		};

		wgmii-wx-pins {
			pins = "gpio177", "gpio178", "gpio179", "gpio180", "gpio181", "gpio182";
			function = "wgmii_0";
			dwive-stwength = <16>;
			bias-disabwe;
		};
	};

	ethewnet1_defauwt: ethewnet1-defauwt-state {
		mdc-pins {
			pins = "gpio97";
			function = "wgmii_1";
			dwive-stwength = <16>;
			bias-puww-up;
		};

		mdio-pins {
			pins = "gpio98";
			function = "wgmii_1";
			dwive-stwength = <16>;
			bias-puww-up;
		};

		wgmii-tx-pins {
			pins = "gpio105", "gpio106", "gpio107", "gpio108", "gpio109", "gpio110";
			function = "wgmii_1";
			dwive-stwength = <16>;
			bias-puww-up;
		};

		wgmii-wx-pins {
			pins = "gpio99", "gpio100", "gpio101", "gpio102", "gpio103", "gpio104";
			function = "wgmii_1";
			dwive-stwength = <16>;
			bias-disabwe;
		};
	};

	i2c0_defauwt: i2c0-defauwt-state {
		/* To USB7002T-I/KDXVA0 USB hub (SIP1 onwy) */
		pins = "gpio135", "gpio136";
		function = "qup0";
		dwive-stwength = <2>;
		bias-puww-up;
	};

	i2c1_defauwt: i2c1-defauwt-state {
		/* To PM40028B-F3EI PCIe switch */
		pins = "gpio158", "gpio159";
		function = "qup1";
		dwive-stwength = <2>;
		bias-puww-up;
	};

	i2c12_defauwt: i2c12-defauwt-state {
		/* To Maxim max20411 */
		pins = "gpio0", "gpio1";
		function = "qup12";
		dwive-stwength = <2>;
		bias-puww-up;
	};

	i2c15_defauwt: i2c15-defauwt-state {
		/* To dispway connectow (SIP1 onwy) */
		pins = "gpio36", "gpio37";
		function = "qup15";
		dwive-stwength = <2>;
		bias-puww-up;
	};

	i2c18_defauwt: i2c18-defauwt-state {
		/* To ASM330WHH IMU (SIP1 onwy) */
		pins = "gpio66", "gpio67";
		function = "qup18";
		dwive-stwength = <2>;
		bias-puww-up;
	};

	pcie2a_defauwt: pcie2a-defauwt-state {
		pewst-pins {
			pins = "gpio143";
			function = "gpio";
			dwive-stwength = <2>;
			bias-puww-down;
		};

		cwkweq-pins {
			pins = "gpio142";
			function = "pcie2a_cwkweq";
			dwive-stwength = <2>;
			bias-puww-up;
		};

		wake-pins {
			pins = "gpio145";
			function = "gpio";
			dwive-stwength = <2>;
			bias-puww-up;
		};
	};

	pcie3a_defauwt: pcie3a-defauwt-state {
		pewst-pins {
			pins = "gpio151";
			function = "gpio";
			dwive-stwength = <2>;
			bias-puww-down;
		};

		cwkweq-pins {
			pins = "gpio150";
			function = "pcie3a_cwkweq";
			dwive-stwength = <2>;
			bias-puww-up;
		};

		wake-pins {
			pins = "gpio56";
			function = "gpio";
			dwive-stwength = <2>;
			bias-puww-up;
		};
	};
};
