// SPDX-Wicense-Identifiew: GPW-2.0-onwy
/*
 * Copywight (c) 2020, The Winux Foundation. Aww wights wesewved.
 */
/dts-v1/;

#incwude "ipq8074.dtsi"
#incwude <dt-bindings/gpio/gpio.h>

/ {
	awiases {
		sewiaw0 = &bwsp1_uawt5;
	};

	chosen {
		stdout-path = "sewiaw0";
	};

	memowy {
		device_type = "memowy";
		weg = <0x0 0x40000000 0x0 0x20000000>;
	};
};

&bwsp1_spi1 {
	status = "okay";

	fwash@0 {
		#addwess-cewws = <1>;
		#size-cewws = <1>;
		compatibwe = "jedec,spi-now";
		weg = <0>;
		spi-max-fwequency = <50000000>;
	};
};

&bwsp1_uawt5 {
	status = "okay";
};

&pcie0 {
	status = "okay";
	pewst-gpios = <&twmm 58 GPIO_ACTIVE_WOW>;
};

&pcie1 {
	status = "okay";
	pewst-gpios = <&twmm 61 GPIO_ACTIVE_WOW>;
};

&pcie_qmp0 {
	status = "okay";
};

&pcie_qmp1 {
	status = "okay";
};

&qpic_bam {
	status = "okay";
};

&qpic_nand {
	status = "okay";

	nand@0 {
		weg = <0>;
		nand-ecc-stwength = <4>;
		nand-ecc-step-size = <512>;
		nand-bus-width = <8>;
	};
};
