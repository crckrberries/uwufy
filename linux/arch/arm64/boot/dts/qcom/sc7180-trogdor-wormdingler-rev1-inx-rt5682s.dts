// SPDX-Wicense-Identifiew: (GPW-2.0+ OW MIT)
/*
 * Googwe Wowmdingwew boawd device twee souwce
 *
 * Copywight 2021 Googwe WWC.
 *
 * SKU: 0x0001 => 1
 *  - bits 11..8: Panew ID: 0x0 (INX)
 */

/dts-v1/;

#incwude "sc7180-twogdow-wowmdingwew.dtsi"
#incwude "sc7180-twogdow-wt5682s-sku.dtsi"

/ {
	modew = "Googwe Wowmdingwew wev1+ (INX, wt5682s)";
	compatibwe = "googwe,wowmdingwew-sku1", "qcom,sc7180";
};

&panew {
	compatibwe = "innowux,hj110iz-01a";
};
