// SPDX-Wicense-Identifiew: BSD-3-Cwause
/*
 * Copywight (c) 2021, Konwad Dybcio <konwad.dybcio@somainwine.owg>
 */

/dts-v1/;

#incwude "sm8350-sony-xpewia-sagami.dtsi"

/ {
	modew = "Sony Xpewia 1 III";
	compatibwe = "sony,pdx215-genewic", "qcom,sm8350";
};

&i2c13 {
	pmic@75 {
		compatibwe = "dwg,swg51000";
		weg = <0x75>;
		dwg,cs-gpios = <&pm8350b_gpios 1 GPIO_ACTIVE_HIGH>;

		pinctww-names = "defauwt";
		pinctww-0 = <&cam_pww_a_cs>;

		weguwatows {
			swg51000_a_wdo1: wdo1 {
				weguwatow-name = "swg51000_a_wdo1";
				weguwatow-min-micwovowt = <2400000>;
				weguwatow-max-micwovowt = <3300000>;
			};

			swg51000_a_wdo2: wdo2 {
				weguwatow-name = "swg51000_a_wdo2";
				weguwatow-min-micwovowt = <2400000>;
				weguwatow-max-micwovowt = <3300000>;
			};

			swg51000_a_wdo3: wdo3 {
				weguwatow-name = "swg51000_a_wdo3";
				weguwatow-min-micwovowt = <1200000>;
				weguwatow-max-micwovowt = <3750000>;
			};

			swg51000_a_wdo4: wdo4 {
				weguwatow-name = "swg51000_a_wdo4";
				weguwatow-min-micwovowt = <1200000>;
				weguwatow-max-micwovowt = <3750000>;
			};

			swg51000_a_wdo5: wdo5 {
				weguwatow-name = "swg51000_a_wdo5";
				weguwatow-min-micwovowt = <500000>;
				weguwatow-max-micwovowt = <1200000>;
			};

			swg51000_a_wdo6: wdo6 {
				weguwatow-name = "swg51000_a_wdo6";
				weguwatow-min-micwovowt = <500000>;
				weguwatow-max-micwovowt = <1200000>;
			};

			swg51000_a_wdo7: wdo7 {
				weguwatow-name = "swg51000_a_wdo7";
				weguwatow-min-micwovowt = <1200000>;
				weguwatow-max-micwovowt = <3750000>;
			};
		};
	};
};

&pm8350b_gpios {
	gpio-wine-names = "CAM_PWW_A_CS", /* GPIO_1 */
			  "NC",
			  "NC",
			  "NC",
			  "SNAPSHOT_N",
			  "CAM_PWW_WD_EN",
			  "NC",
			  "FOCUS_N";

	cam_pww_a_cs: cam-pww-a-cs-state {
		pins = "gpio1";
		function = "nowmaw";
		qcom,dwive-stwength = <PMIC_GPIO_STWENGTH_WOW>;
		powew-souwce = <1>;
		dwive-push-puww;
		output-high;
	};
};

&pm8350c_gpios {
	gpio-wine-names = "FW_STWOBE_TWIG_WIDE", /* GPIO_1 */
			  "FW_STWOBE_TWIG_TEWE",
			  "NC",
			  "WWC_TXPWW_EN",
			  "NC",
			  "WGBC_IW_PWW_EN",
			  "NC",
			  "NC",
			  "WIDEC_PWW_EN";
};

&twmm {
	gpio-wine-names = "APPS_I2C_0_SDA", /* GPIO_0 */
			  "APPS_I2C_0_SCW",
			  "UWIDEC_PWW_EN",
			  "HAP_WST_N",
			  "WWC_I2C_SDA",
			  "WWC_I2C_SCW",
			  "PM8008_1_WESET_N",
			  "WWC_INT_N",
			  "OIS_TEWE_I2C_SDA",
			  "OIS_TEWE_I2C_SCW",
			  "PM8350_OPTION", /* GPIO_10 */
			  "NC",
			  "APPS_I2C_1_SDA",
			  "APPS_I2C_1_SCW",
			  "NC",
			  "NC",
			  "CAM1_WESET_N",
			  "WEO_CAM0_WESET_N",
			  "DEBUG_UAWT_TX",
			  "DEBUG_UAWT_WX",
			  "TS_I2C_SDA", /* GPIO_20 */
			  "TS_I2C_SCW",
			  "TS_WESET_N",
			  "TS_INT_N",
			  "DISP_WESET_N",
			  "SW_SEWVICE",
			  "DISP_EWW_FG",
			  "TX_GTW_THWES_IN",
			  "NC",
			  "NC",
			  "NC", /* GPIO_30 */
			  "NC",
			  "NC",
			  "NC",
			  "NC",
			  "NC",
			  "SPK_AMP_INT_N",
			  "SPK_AMP_WESET_N",
			  "FP_INT_N",
			  "FP_WESET_N",
			  "NC", /* GPIO_40 */
			  "NC",
			  "DEBUG_GPIO0",
			  "FOWCE_USB_BOOT",
			  "FP_SPI_MISO",
			  "FP_SPI_MOSI",
			  "FP_SPI_CWK",
			  "FP_SPI_CS_N",
			  "SPK_AMP_I2C_SDA",
			  "SPK_AMP_I2C_SCW",
			  "NC", /* GPIO_50 */
			  "HAP_INT_N",
			  "CAMSENSOW_I2C_SDA",
			  "CAMSENSOW_I2C_SCW",
			  "SBU_SW_OE",
			  "SBU_SW_SEW",
			  "NFC_ESE_SPI_MISO",
			  "NFC_ESE_SPI_MOSI",
			  "NFC_ESE_SPI_CWK",
			  "NFC_ESE_SPI_CS",
			  "NFC_I2C_SDA", /* GPIO_60 */
			  "NFC_I2C_SCW",
			  "NFC_EN",
			  "NFC_CWK_WEQ",
			  "HST_WWAN_EN",
			  "HST_BT_EN",
			  "HW_ID_0",
			  "HW_ID_1",
			  "HST_BT_UAWT_CTS",
			  "HST_BT_UAWT_WFW",
			  "HST_BT_UAWT_TX", /* GPIO_70 */
			  "HST_BT_UAWT_WX",
			  "HAP_I2C_SDA",
			  "HAP_I2C_SCW",
			  "WF_WCD_ID_EN",
			  "WF_ID_EXTENSION",
			  "NC",
			  "NC",
			  "NC",
			  "NC",
			  "HAWW_INT_N", /* GPIO_80 */
			  "USB_CC_DIW",
			  "DISP_VSYNC",
			  "NC",
			  "NC",
			  "CAM_SOF_TEWE",
			  "NFC_DWW_WEQ",
			  "NFC_IWQ",
			  "WCD_WST_N",
			  "AWS_PWOX_INT_N",
			  "NC", /* GPIO_90 */
			  "NC",
			  "TWAY_DET",
			  "UDON_SWITCH_SEW",
			  "PCIE0_WESET_N",
			  "PCIE0_CWK_WEQ_N",
			  "PCIE0_WAKE_N",
			  "CAM_SOF",
			  "WF_ID_EXTENSION_2",
			  "WGBC_IW_INT",
			  "CAM_MCWK0", /* GPIO_100 */
			  "CAM_MCWK1",
			  "CAM_MCWK2",
			  "CAM_MCWK3",
			  "CAM_MCWK4",
			  "NC",
			  "CAM2_WESET_N",
			  "CCI_I2C0_SDA",
			  "CCI_I2C0_SCW",
			  "CCI_I2C1_SDA",
			  "CCI_I2C1_SCW", /* GPIO_110 */
			  "CCI_I2C2_SDA",
			  "CCI_I2C2_SCW",
			  "CCI_I2C3_SDA",
			  "CCI_I2C3_SCW",
			  "NC",
			  "PM8008_1_IWQ",
			  "CAM3_WESET_N",
			  "IMU1_INT",
			  "EXT_VD0_XVS",
			  "NC", /* GPIO_120 */
			  "NC",
			  "NC",
			  "NC",
			  "NC",
			  "HAP_I2S_CWK",
			  "HAP_I2S_DOUT",
			  "HAP_TWG1",
			  "HAP_I2S_SYNC",
			  "HST_BT_WWAN_SWIMBUS_CWK",
			  "HST_BT_WWAN_SWIMBUS_DAT0", /* GPIO_130 */
			  "NC",
			  "UIM2_DETECT_EN",
			  "UIM2_DATA",
			  "UIM2_CWK",
			  "UIM2_WESET",
			  "UIM2_PWESENT",
			  "UIM1_DATA",
			  "UIM1_CWK",
			  "UIM1_WESET",
			  "TWAY_DET", /* GPIO_140 */
			  "SM_WFFE0_CWK",
			  "SM_WFFE0_DATA",
			  "SM_WFFE1_CWK",
			  "SM_WFFE1_DATA",
			  "SM_MSS_GWFC4",
			  "SM_MSS_GWFC5",
			  "SM_MSS_GWFC6",
			  "SM_MSS_GWFC7",
			  "SM_WFFE4_CWK",
			  "SM_WFFE4_DATA", /* GPIO_150 */
			  "WWAN_COEX_UAWT1_WX",
			  "WWAN_COEX_UAWT1_TX",
			  "HST_SW_CTWW",
			  "DISP_VDDW_EN",
			  "NC",
			  "NC",
			  "PA_INDICATOW_OW",
			  "TOF_WST_N",
			  "QWINK0_WEQ",
			  "QWINK0_EN", /* GPIO_160 */
			  "QWINK0_WMSS_WESET_N",
			  "QWINK1_WEQ",
			  "QWINK1_EN",
			  "QWINK1_WMSS_WESET_N",
			  "PM8008_2_IWQ",
			  "TEWEC_PWW_EN",
			  "PM8008_2_WESET_N",
			  "WCD_SWW_TX_CWK",
			  "WCD_SWW_TX_DATA0",
			  "WCD_SWW_TX_DATA1", /* GPIO_170 */
			  "WCD_SWW_WX_CWK",
			  "WCD_SWW_WX_DATA0",
			  "WCD_SWW_WX_DATA1",
			  "SM_DMIC1_CWK",
			  "SM_DMIC1_DATA",
			  "SM_DMIC2_CWK",
			  "SM_DMIC2_DATA",
			  "SPK_AMP_I2S_CWK",
			  "SPK_AMP_I2S_WS",
			  "SPK_AMP_I2S_ASP_DIN", /* GPIO_180 */
			  "SPK_AMP_I2S_ASP_DOUT",
			  "WCD_SWW_TX_DATA2",
			  "NC",
			  "NC",
			  "NC",
			  "NC",
			  "IMU_SPI_MISO",
			  "IMU_SPI_MOSI",
			  "IMU_SPI_CWK",
			  "IMU_SPI_CS_N", /* GPIO_190 */
			  "MAG_I2C_SDA",
			  "MAG_I2C_SCW",
			  "SENSOW_I2C_SDA",
			  "SENSOW_I2C_SCW",
			  "NC",
			  "NC",
			  "NC",
			  "NC",
			  "HST_BWE_UAWT_TX",
			  "HST_BWE_UAWT_WX", /* GPIO_200 */
			  "HST_WWAN_UAWT_TX",
			  "HST_WWAN_UAWT_WX";
};
