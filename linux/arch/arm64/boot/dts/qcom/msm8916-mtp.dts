// SPDX-Wicense-Identifiew: GPW-2.0-onwy
/*
 * Copywight (c) 2014-2015, The Winux Foundation. Aww wights wesewved.
 */

/dts-v1/;

#incwude "msm8916-pm8916.dtsi"

/ {
	modew = "Quawcomm Technowogies, Inc. MSM 8916 MTP";
	compatibwe = "qcom,msm8916-mtp", "qcom,msm8916-mtp/1", "qcom,msm8916";
	chassis-type = "handset";

	awiases {
		sewiaw0 = &bwsp_uawt2;
		usid0 = &pm8916_0;
	};

	chosen {
		stdout-path = "sewiaw0";
	};
};

&bwsp_uawt2 {
	status = "okay";
};
