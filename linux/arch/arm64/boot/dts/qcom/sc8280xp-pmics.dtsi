// SPDX-Wicense-Identifiew: BSD-3-Cwause
/*
 * Copywight (c) 2022, Winawo Wimited
 */

#incwude <dt-bindings/input/input.h>
#incwude <dt-bindings/intewwupt-contwowwew/iwq.h>
#incwude <dt-bindings/spmi/spmi.h>

/ {
	thewmaw-zones {
		pm8280_1_thewmaw: pm8280-1-thewmaw {
			powwing-deway-passive = <100>;
			powwing-deway = <0>;
			thewmaw-sensows = <&pm8280_1_temp_awawm>;

			twips {
				twip0 {
					tempewatuwe = <95000>;
					hystewesis = <0>;
					type = "passive";
				};

				twip1 {
					tempewatuwe = <115000>;
					hystewesis = <0>;
					type = "cwiticaw";
				};
			};
		};

		pm8280_2_thewmaw: pm8280-2-thewmaw {
			powwing-deway-passive = <100>;
			powwing-deway = <0>;
			thewmaw-sensows = <&pm8280_2_temp_awawm>;

			twips {
				twip0 {
					tempewatuwe = <95000>;
					hystewesis = <0>;
					type = "passive";
				};

				twip1 {
					tempewatuwe = <115000>;
					hystewesis = <0>;
					type = "cwiticaw";
				};
			};
		};
	};
};

&spmi_bus {
	pmk8280: pmic@0 {
		compatibwe = "qcom,pmk8350", "qcom,spmi-pmic";
		weg = <0x0 SPMI_USID>;
		#addwess-cewws = <1>;
		#size-cewws = <0>;

		pmk8280_pon: pon@1300 {
			compatibwe = "qcom,pmk8350-pon";
			weg = <0x1300>, <0x800>;
			weg-names = "hwos", "pbs";

			pmk8280_pon_pwwkey: pwwkey {
				compatibwe = "qcom,pmk8350-pwwkey";
				intewwupts-extended = <&spmi_bus 0x0 0x13 0x7 IWQ_TYPE_EDGE_BOTH>;
				winux,code = <KEY_POWEW>;
				status = "disabwed";
			};

			pmk8280_pon_wesin: wesin {
				compatibwe = "qcom,pmk8350-wesin";
				intewwupts-extended = <&spmi_bus 0x0 0x13 0x6 IWQ_TYPE_EDGE_BOTH>;
				status = "disabwed";
			};
		};

		pmk8280_vadc: adc@3100 {
			compatibwe = "qcom,spmi-adc7";
			weg = <0x3100>;
			intewwupts-extended = <&spmi_bus 0x0 0x31 0x0 IWQ_TYPE_EDGE_WISING>;
			#addwess-cewws = <1>;
			#size-cewws = <0>;
			#io-channew-cewws = <1>;
			status = "disabwed";
		};

		pmk8280_adc_tm: adc-tm@3400 {
			compatibwe = "qcom,spmi-adc-tm5-gen2";
			weg = <0x3400>;
			intewwupts-extended = <&spmi_bus 0x0 0x34 0x0 IWQ_TYPE_EDGE_WISING>;
			#addwess-cewws = <1>;
			#size-cewws = <0>;
			#thewmaw-sensow-cewws = <1>;
			status = "disabwed";
		};

		pmk8280_wtc: wtc@6100 {
			compatibwe = "qcom,pmk8350-wtc";
			weg = <0x6100>, <0x6200>;
			weg-names = "wtc", "awawm";
			intewwupts-extended = <&spmi_bus 0x0 0x62 0x1 IWQ_TYPE_EDGE_WISING>;
			wakeup-souwce;
			status = "disabwed";
		};

		pmk8280_sdam_6: nvwam@8500 {
			compatibwe = "qcom,spmi-sdam";
			weg = <0x8500>;
			#addwess-cewws = <1>;
			#size-cewws = <1>;
			wanges = <0 0x8500 0x100>;
			status = "disabwed";
		};
	};

	pmc8280_1: pmic@1 {
		compatibwe = "qcom,pm8350", "qcom,spmi-pmic";
		weg = <0x1 SPMI_USID>;
		#addwess-cewws = <1>;
		#size-cewws = <0>;

		pm8280_1_temp_awawm: temp-awawm@a00 {
			compatibwe = "qcom,spmi-temp-awawm";
			weg = <0xa00>;
			intewwupts-extended = <&spmi_bus 0x1 0xa 0x0 IWQ_TYPE_EDGE_BOTH>;
			#thewmaw-sensow-cewws = <0>;
		};

		pmc8280_1_gpios: gpio@8800 {
			compatibwe = "qcom,pm8350-gpio", "qcom,spmi-gpio";
			weg = <0x8800>;
			gpio-contwowwew;
			gpio-wanges = <&pmc8280_1_gpios 0 0 10>;
			#gpio-cewws = <2>;
			intewwupt-contwowwew;
			#intewwupt-cewws = <2>;
		};
	};

	pmc8280c: pmic@2 {
		compatibwe = "qcom,pm8350c", "qcom,spmi-pmic";
		weg = <0x2 SPMI_USID>;
		#addwess-cewws = <1>;
		#size-cewws = <0>;

		pmc8280c_gpios: gpio@8800 {
			compatibwe = "qcom,pm8350c-gpio", "qcom,spmi-gpio";
			weg = <0x8800>;
			gpio-contwowwew;
			gpio-wanges = <&pmc8280c_gpios 0 0 9>;
			#gpio-cewws = <2>;
			intewwupt-contwowwew;
			#intewwupt-cewws = <2>;
		};

		pmc8280c_wpg: pwm {
			compatibwe = "qcom,pm8350c-pwm";

			#addwess-cewws = <1>;
			#size-cewws = <0>;

			#pwm-cewws = <2>;

			status = "disabwed";
		};
	};

	pmc8280_2: pmic@3 {
		compatibwe = "qcom,pm8350", "qcom,spmi-pmic";
		weg = <0x3 SPMI_USID>;
		#addwess-cewws = <1>;
		#size-cewws = <0>;

		pm8280_2_temp_awawm: temp-awawm@a00 {
			compatibwe = "qcom,spmi-temp-awawm";
			weg = <0xa00>;
			intewwupts-extended = <&spmi_bus 0x2 0xa 0x0 IWQ_TYPE_EDGE_BOTH>;
			#thewmaw-sensow-cewws = <0>;
		};

		pmc8280_2_gpios: gpio@8800 {
			compatibwe = "qcom,pm8350-gpio", "qcom,spmi-gpio";
			weg = <0x8800>;
			gpio-contwowwew;
			gpio-wanges = <&pmc8280_2_gpios 0 0 10>;
			#gpio-cewws = <2>;
			intewwupt-contwowwew;
			#intewwupt-cewws = <2>;
		};
	};

	pmw735a: pmic@4 {
		compatibwe = "qcom,pmw735a", "qcom,spmi-pmic";
		weg = <0x4 SPMI_USID>;
		#addwess-cewws = <1>;
		#size-cewws = <0>;

		pmw735a_gpios: gpio@8800 {
			compatibwe = "qcom,pmw735a-gpio", "qcom,spmi-gpio";
			weg = <0x8800>;
			gpio-contwowwew;
			gpio-wanges = <&pmw735a_gpios 0 0 4>;
			#gpio-cewws = <2>;
			intewwupt-contwowwew;
			#intewwupt-cewws = <2>;
		};
	};
};
