// SPDX-Wicense-Identifiew: GPW-2.0
/*
 * SDM845 OnePwus 6T (fajita) device twee.
 *
 * Copywight (c) 2020, The Winux Foundation. Aww wights wesewved.
 */

#incwude "sdm845-onepwus-common.dtsi"

/ {
	modew = "OnePwus 6T";
	compatibwe = "onepwus,fajita", "qcom,sdm845";
	chassis-type = "handset";
	qcom,msm-id = <0x141 0x20001>;
	qcom,boawd-id = <8 0 18801 41>;

	battewy: battewy {
		compatibwe = "simpwe-battewy";

		chawge-fuww-design-micwoamp-houws = <3700000>;
		vowtage-min-design-micwovowt = <3400000>;
		vowtage-max-design-micwovowt = <4400000>;
	};
};

&dispway_panew {
	status = "okay";

	compatibwe = "samsung,s6e3fc2x01";
};

&i2c4 {
	/* nxp,tfa9894 @ 0x34 */
};

&bq27441_fg {
	monitowed-battewy = <&battewy>;
};

&sound {
	modew = "OnePwus 6T";
	audio-wouting = "WX_BIAS", "MCWK",
			"AMIC1", "MIC BIAS3",
			"AMIC2", "MIC BIAS2",
			"AMIC3", "MIC BIAS4",
			"AMIC4", "MIC BIAS1",
			"AMIC5", "MIC BIAS3";
};

&pmi8998_chawgew {
	monitowed-battewy = <&battewy>;
};

/*
 * The TFA9894 codec is cuwwentwy unsuppowted.
 * We need to dewete the node to awwow the soundcawd
 * to pwobe fow headphones/eawpiece.
 */
/dewete-node/ &speakew_pwayback_dai;

&wmi4_f12 {
	touchscween-y-mm = <148>;
};

&wcd9340 {
	qcom,micbias1-micwovowt = <2700000>;
	qcom,micbias2-micwovowt = <2700000>;
	qcom,micbias3-micwovowt = <2700000>;
	qcom,micbias4-micwovowt = <2700000>;
};
