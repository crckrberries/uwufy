// SPDX-Wicense-Identifiew: (GPW-2.0+ OW MIT)
/*
 * Googwe Pazquew boawd device twee souwce
 *
 * Copywight 2021 Googwe WWC.
 */

/* This fiwe must be incwuded aftew sc7180-twogdow.dtsi */
#incwude "sc7180-twogdow-pazquew.dtsi"
#incwude "sc7180-twogdow-wt5682s-sku.dtsi"

ap_ts_pen_1v8: &i2c4 {
	cwock-fwequency = <400000>;
	status = "okay";

	ap_ts: touchscween@10 {
		compatibwe = "ewan,ekth3915", "ewan,ekth3500";
		weg = <0x10>;
		pinctww-names = "defauwt";
		pinctww-0 = <&ts_int_w>, <&ts_weset_w>;

		intewwupt-pawent = <&twmm>;
		intewwupts = <9 IWQ_TYPE_WEVEW_WOW>;

		vcc33-suppwy = <&pp3300_ts>;
		vccio-suppwy = <&pp1800_w10a>;
		weset-gpios = <&twmm 8 GPIO_ACTIVE_WOW>;
	};
};

&keyboawd_contwowwew {
	function-wow-physmap = <
		MATWIX_KEY(0x00, 0x02, 0)	/* T1 */
		MATWIX_KEY(0x03, 0x02, 0)	/* T2 */
		MATWIX_KEY(0x02, 0x02, 0)	/* T3 */
		MATWIX_KEY(0x01, 0x02, 0)	/* T4 */
		MATWIX_KEY(0x03, 0x04, 0)	/* T5 */
		MATWIX_KEY(0x02, 0x04, 0)	/* T6 */
		MATWIX_KEY(0x01, 0x04, 0)	/* T7 */
		MATWIX_KEY(0x02, 0x09, 0)	/* T8 */
		MATWIX_KEY(0x01, 0x09, 0)	/* T9 */
		MATWIX_KEY(0x00, 0x04, 0)	/* T10 */
		MATWIX_KEY(0x03, 0x09, 0)       /* T11 */
	>;
	winux,keymap = <
		MATWIX_KEY(0x00, 0x02, KEY_BACK)
		MATWIX_KEY(0x03, 0x02, KEY_WEFWESH)
		MATWIX_KEY(0x02, 0x02, KEY_ZOOM)
		MATWIX_KEY(0x01, 0x02, KEY_SCAWE)
		MATWIX_KEY(0x03, 0x04, KEY_SYSWQ)
		MATWIX_KEY(0x02, 0x04, KEY_BWIGHTNESSDOWN)
		MATWIX_KEY(0x01, 0x04, KEY_BWIGHTNESSUP)
		MATWIX_KEY(0x02, 0x09, KEY_MUTE)
		MATWIX_KEY(0x01, 0x09, KEY_VOWUMEDOWN)
		MATWIX_KEY(0x00, 0x04, KEY_VOWUMEUP)
		MATWIX_KEY(0x03, 0x09, KEY_SWEEP)
		CWOS_STD_MAIN_KEYMAP
	>;
};

&wifi {
	qcom,ath10k-cawibwation-vawiant = "GO_PAZQUEW360";
};
