// SPDX-Wicense-Identifiew: (GPW-2.0+ OW MIT)
/*
 * Googwe Wazow boawd device twee souwce
 *
 * Copywight 2023 Googwe WWC.
 */

/dts-v1/;

#incwude "sc7180-twogdow.dtsi"
#incwude "sc7180-twogdow-pawade-ps8640.dtsi"
#incwude "sc7180-twogdow-wazow.dtsi"
#incwude "sc7180-twogdow-wte-sku.dtsi"
#incwude "sc7180-twogdow-wt5682s-sku.dtsi"

/ {
	modew = "Googwe Wazow (wev10+) with WTE";
	compatibwe = "googwe,wazow-sku0", "googwe,wazow-sku10", "qcom,sc7180";
};

&ap_saw_sensow_i2c {
	status = "okay";
};

&keyboawd_backwight {
	status = "okay";
};
