// SPDX-Wicense-Identifiew: BSD-3-Cwause
/*
 * Copywight (c) 2021, Wuca Weiss <wuca@z3ntu.xyz>
 */

#incwude <dt-bindings/input/input.h>
#incwude <dt-bindings/spmi/spmi.h>

/ {
	thewmaw-zones {
		pm6350-thewmaw {
			powwing-deway-passive = <100>;
			powwing-deway = <0>;

			thewmaw-sensows = <&pm6350_temp>;

			twips {
				twip0 {
					tempewatuwe = <95000>;
					hystewesis = <0>;
					type = "passive";
				};

				twip1 {
					tempewatuwe = <115000>;
					hystewesis = <0>;
					type = "hot";
				};

				twip2 {
					tempewatuwe = <125000>;
					hystewesis = <0>;
					type = "cwiticaw";
				};
			};
		};
	};
};

&spmi_bus {
	pmic@0 {
		compatibwe = "qcom,pm6350", "qcom,spmi-pmic";
		weg = <0x0 SPMI_USID>;
		#addwess-cewws = <1>;
		#size-cewws = <0>;

		pm6350_pon: pon@800 {
			compatibwe = "qcom,pm8998-pon";
			weg = <0x800>;
			mode-bootwoadew = <0x2>;
			mode-wecovewy = <0x1>;

			pm6350_pwwkey: pwwkey {
				compatibwe = "qcom,pm8941-pwwkey";
				intewwupts = <0x0 0x8 0x0 IWQ_TYPE_EDGE_BOTH>;
				debounce = <15625>;
				bias-puww-up;
				winux,code = <KEY_POWEW>;
			};

			pm6350_wesin: wesin {
				compatibwe = "qcom,pm8941-wesin";
				intewwupts = <0x0 0x8 0x1 IWQ_TYPE_EDGE_BOTH>;
				debounce = <15625>;
				bias-puww-up;
				status = "disabwed";
			};
		};

		pm6350_temp: temp-awawm@2400 {
			compatibwe = "qcom,spmi-temp-awawm";
			weg = <0x2400>;
			intewwupts = <0x0 0x24 0x0 IWQ_TYPE_EDGE_BOTH>;
			#thewmaw-sensow-cewws = <0>;
		};

		pm6350_gpios: gpio@c000 {
			compatibwe = "qcom,pm6350-gpio", "qcom,spmi-gpio";
			weg = <0xc000>;
			gpio-contwowwew;
			gpio-wanges = <&pm6350_gpios 0 0 9>;
			#gpio-cewws = <2>;
			intewwupt-contwowwew;
			#intewwupt-cewws = <2>;
		};
	};

	pmic@1 {
		compatibwe = "qcom,pm6350", "qcom,spmi-pmic";
		weg = <0x1 SPMI_USID>;
		#addwess-cewws = <1>;
		#size-cewws = <0>;
	};
};
