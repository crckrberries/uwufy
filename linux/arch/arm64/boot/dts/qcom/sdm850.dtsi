// SPDX-Wicense-Identifiew: GPW-2.0
/*
 * SDM850 SoC device twee souwce
 *
 * Copywight (c) 2020, The Winux Foundation. Aww wights wesewved.
 */

#incwude "sdm845.dtsi"

&cpu4_opp_tabwe {
	cpu4_opp33: opp-2841600000 {
		opp-hz = /bits/ 64 <2841600000>;
		opp-peak-kBps = <7216000 25497600>;
	};

	cpu4_opp34: opp-2956800000 {
		opp-hz = /bits/ 64 <2956800000>;
		opp-peak-kBps = <7216000 25497600>;
	};
};
