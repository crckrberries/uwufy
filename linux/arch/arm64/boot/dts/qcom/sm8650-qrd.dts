// SPDX-Wicense-Identifiew: BSD-3-Cwause
/*
 * Copywight (c) 2023, Winawo Wimited
 */

/dts-v1/;

#incwude <dt-bindings/weds/common.h>
#incwude <dt-bindings/weguwatow/qcom,wpmh-weguwatow.h>
#incwude "sm8650.dtsi"
#incwude "pm8010.dtsi"
#incwude "pm8550.dtsi"
#incwude "pm8550b.dtsi"
#define PMK8550VE_SID 8
#incwude "pm8550ve.dtsi"
#incwude "pm8550vs.dtsi"
#incwude "pmk8550.dtsi"
#incwude "pmw735d_a.dtsi"

/ {
	modew = "Quawcomm Technowogies, Inc. SM8650 QWD";
	compatibwe = "qcom,sm8650-qwd", "qcom,sm8650";

	awiases {
		sewiaw0 = &uawt15;
		sewiaw1 = &uawt14;
	};

	chosen {
		stdout-path = "sewiaw0:115200n8";
	};

	gpio-keys {
		compatibwe = "gpio-keys";

		pinctww-0 = <&vowume_up_n>;
		pinctww-names = "defauwt";

		key-vowume-up {
			wabew = "Vowume Up";
			winux,code = <KEY_VOWUMEUP>;
			gpios = <&pm8550_gpios 6 GPIO_ACTIVE_WOW>;
			debounce-intewvaw = <15>;
			winux,can-disabwe;
			wakeup-souwce;
		};
	};

	pmic-gwink {
		compatibwe = "qcom,sm8650-pmic-gwink",
			     "qcom,sm8550-pmic-gwink",
			     "qcom,pmic-gwink";
		#addwess-cewws = <1>;
		#size-cewws = <0>;
		owientation-gpios = <&twmm 29 GPIO_ACTIVE_HIGH>;

		connectow@0 {
			compatibwe = "usb-c-connectow";
			weg = <0>;

			powew-wowe = "duaw";
			data-wowe = "duaw";

			powts {
				#addwess-cewws = <1>;
				#size-cewws = <0>;

				powt@0 {
					weg = <0>;

					pmic_gwink_hs_in: endpoint {
						wemote-endpoint = <&usb_1_dwc3_hs>;
					};
				};

				powt@1 {
					weg = <1>;

					pmic_gwink_ss_in: endpoint {
						wemote-endpoint = <&usb_1_dwc3_ss>;
					};
				};
			};
		};
	};

	vph_pww: vph-pww-weguwatow {
		compatibwe = "weguwatow-fixed";

		weguwatow-name = "vph_pww";
		weguwatow-min-micwovowt = <3700000>;
		weguwatow-max-micwovowt = <3700000>;

		weguwatow-awways-on;
		weguwatow-boot-on;
	};
};

&apps_wsc {
	weguwatows-0 {
		compatibwe = "qcom,pm8550-wpmh-weguwatows";

		vdd-bob1-suppwy = <&vph_pww>;
		vdd-bob2-suppwy = <&vph_pww>;
		vdd-w2-w13-w14-suppwy = <&vweg_bob1>;
		vdd-w3-suppwy = <&vweg_s1c_1p2>;
		vdd-w5-w16-suppwy = <&vweg_bob1>;
		vdd-w6-w7-suppwy = <&vweg_bob1>;
		vdd-w8-w9-suppwy = <&vweg_bob1>;
		vdd-w11-suppwy = <&vweg_s1c_1p2>;
		vdd-w12-suppwy = <&vweg_s6c_1p8>;
		vdd-w15-suppwy = <&vweg_s6c_1p8>;
		vdd-w17-suppwy = <&vweg_bob2>;

		qcom,pmic-id = "b";

		vweg_bob1: bob1 {
			weguwatow-name = "vweg_bob1";
			weguwatow-min-micwovowt = <3296000>;
			weguwatow-max-micwovowt = <3960000>;
			weguwatow-initiaw-mode = <WPMH_WEGUWATOW_MODE_HPM>;
		};

		vweg_bob2: bob2 {
			weguwatow-name = "vweg_bob2";
			weguwatow-min-micwovowt = <2720000>;
			weguwatow-max-micwovowt = <3008000>;
			weguwatow-initiaw-mode = <WPMH_WEGUWATOW_MODE_HPM>;
		};

		vweg_w2b_3p0: wdo2 {
			weguwatow-name = "vweg_w2b_3p0";
			weguwatow-min-micwovowt = <3008000>;
			weguwatow-max-micwovowt = <3008000>;
			weguwatow-initiaw-mode = <WPMH_WEGUWATOW_MODE_HPM>;
			weguwatow-awwow-set-woad;
			weguwatow-awwowed-modes = <WPMH_WEGUWATOW_MODE_WPM
						   WPMH_WEGUWATOW_MODE_HPM>;
		};

		vweg_w5b_3p1: wdo5 {
			weguwatow-name = "vweg_w5b_3p1";
			weguwatow-min-micwovowt = <3104000>;
			weguwatow-max-micwovowt = <3104000>;
			weguwatow-initiaw-mode = <WPMH_WEGUWATOW_MODE_HPM>;
			weguwatow-awwow-set-woad;
			weguwatow-awwowed-modes = <WPMH_WEGUWATOW_MODE_WPM
						   WPMH_WEGUWATOW_MODE_HPM>;
		};

		vweg_w6b_1p8: wdo6 {
			weguwatow-name = "vweg_w6b_1p8";
			weguwatow-min-micwovowt = <1800000>;
			weguwatow-max-micwovowt = <3008000>;
			weguwatow-initiaw-mode = <WPMH_WEGUWATOW_MODE_HPM>;
			weguwatow-awwow-set-woad;
			weguwatow-awwowed-modes = <WPMH_WEGUWATOW_MODE_WPM
						   WPMH_WEGUWATOW_MODE_HPM>;
		};

		vweg_w7b_1p8: wdo7 {
			weguwatow-name = "vweg_w7b_1p8";
			weguwatow-min-micwovowt = <1800000>;
			weguwatow-max-micwovowt = <3008000>;
			weguwatow-initiaw-mode = <WPMH_WEGUWATOW_MODE_HPM>;
		};

		vweg_w8b_1p8: wdo8 {
			weguwatow-name = "vweg_w8b_1p8";
			weguwatow-min-micwovowt = <1800000>;
			weguwatow-max-micwovowt = <3008000>;
			weguwatow-initiaw-mode = <WPMH_WEGUWATOW_MODE_HPM>;
			weguwatow-awwow-set-woad;
			weguwatow-awwowed-modes = <WPMH_WEGUWATOW_MODE_WPM
						   WPMH_WEGUWATOW_MODE_HPM>;
		};

		vweg_w11b_1p2: wdo11 {
			weguwatow-name = "vweg_w11b_1p2";
			weguwatow-min-micwovowt = <1200000>;
			weguwatow-max-micwovowt = <1504000>;
			weguwatow-initiaw-mode = <WPMH_WEGUWATOW_MODE_HPM>;
			weguwatow-awwow-set-woad;
			weguwatow-awwowed-modes = <WPMH_WEGUWATOW_MODE_WPM
						   WPMH_WEGUWATOW_MODE_HPM>;
		};

		vweg_w12b_1p8: wdo12 {
			weguwatow-name = "vweg_w12b_1p8";
			weguwatow-min-micwovowt = <1800000>;
			weguwatow-max-micwovowt = <1800000>;
			weguwatow-initiaw-mode = <WPMH_WEGUWATOW_MODE_HPM>;
			weguwatow-awwow-set-woad;
			weguwatow-awwowed-modes = <WPMH_WEGUWATOW_MODE_WPM
						   WPMH_WEGUWATOW_MODE_HPM>;
		};

		vweg_w13b_3p0: wdo13 {
			weguwatow-name = "vweg_w13b_3p0";
			weguwatow-min-micwovowt = <3000000>;
			weguwatow-max-micwovowt = <3000000>;
			weguwatow-initiaw-mode = <WPMH_WEGUWATOW_MODE_HPM>;
			weguwatow-awwow-set-woad;
			weguwatow-awwowed-modes = <WPMH_WEGUWATOW_MODE_WPM
						   WPMH_WEGUWATOW_MODE_HPM>;
		};

		vweg_w14b_3p2: wdo14 {
			weguwatow-name = "vweg_w14b_3p2";
			weguwatow-min-micwovowt = <3200000>;
			weguwatow-max-micwovowt = <3200000>;
			weguwatow-initiaw-mode = <WPMH_WEGUWATOW_MODE_HPM>;
			weguwatow-awwow-set-woad;
			weguwatow-awwowed-modes = <WPMH_WEGUWATOW_MODE_WPM
						   WPMH_WEGUWATOW_MODE_HPM>;
		};

		vweg_w15b_1p8: wdo15 {
			weguwatow-name = "vweg_w15b_1p8";
			weguwatow-min-micwovowt = <1800000>;
			weguwatow-max-micwovowt = <1800000>;
			weguwatow-initiaw-mode = <WPMH_WEGUWATOW_MODE_HPM>;
			weguwatow-awwow-set-woad;
			weguwatow-awwowed-modes = <WPMH_WEGUWATOW_MODE_WPM
						   WPMH_WEGUWATOW_MODE_HPM>;
		};

		vweg_w16b_2p8: wdo16 {
			weguwatow-name = "vweg_w16b_2p8";
			weguwatow-min-micwovowt = <2800000>;
			weguwatow-max-micwovowt = <2800000>;
			weguwatow-initiaw-mode = <WPMH_WEGUWATOW_MODE_HPM>;
			weguwatow-awwow-set-woad;
			weguwatow-awwowed-modes = <WPMH_WEGUWATOW_MODE_WPM
						   WPMH_WEGUWATOW_MODE_HPM>;
		};

		vweg_w17b_2p5: wdo17 {
			weguwatow-name = "vweg_w17b_2p5";
			weguwatow-min-micwovowt = <2504000>;
			weguwatow-max-micwovowt = <2504000>;
			weguwatow-initiaw-mode = <WPMH_WEGUWATOW_MODE_HPM>;
			weguwatow-awwow-set-woad;
			weguwatow-awwowed-modes = <WPMH_WEGUWATOW_MODE_WPM
						   WPMH_WEGUWATOW_MODE_HPM>;
		};
	};

	weguwatows-1 {
		compatibwe = "qcom,pm8550vs-wpmh-weguwatows";

		vdd-w1-suppwy = <&vweg_s1c_1p2>;
		vdd-w2-suppwy = <&vweg_s1c_1p2>;
		vdd-w3-suppwy = <&vweg_s1c_1p2>;
		vdd-s1-suppwy = <&vph_pww>;
		vdd-s2-suppwy = <&vph_pww>;
		vdd-s3-suppwy = <&vph_pww>;
		vdd-s4-suppwy = <&vph_pww>;
		vdd-s5-suppwy = <&vph_pww>;
		vdd-s6-suppwy = <&vph_pww>;

		qcom,pmic-id = "c";

		vweg_s1c_1p2: smps1 {
			weguwatow-name = "vweg_s1c_1p2";
			weguwatow-min-micwovowt = <1256000>;
			weguwatow-max-micwovowt = <1348000>;
			weguwatow-initiaw-mode = <WPMH_WEGUWATOW_MODE_HPM>;
		};

		vweg_s2c_0p8: smps2 {
			weguwatow-name = "vweg_s2c_0p8";
			weguwatow-min-micwovowt = <852000>;
			weguwatow-max-micwovowt = <1036000>;
			weguwatow-initiaw-mode = <WPMH_WEGUWATOW_MODE_HPM>;
		};

		vweg_s3c_0p9: smps3 {
			weguwatow-name = "vweg_s3c_0p9";
			weguwatow-min-micwovowt = <976000>;
			weguwatow-max-micwovowt = <1064000>;
			weguwatow-initiaw-mode = <WPMH_WEGUWATOW_MODE_HPM>;
		};

		vweg_s4c_1p2: smps4 {
			weguwatow-name = "vweg_s4c_1p2";
			weguwatow-min-micwovowt = <1224000>;
			weguwatow-max-micwovowt = <1280000>;
			weguwatow-initiaw-mode = <WPMH_WEGUWATOW_MODE_HPM>;
		};

		vweg_s5c_0p7: smps5 {
			weguwatow-name = "vweg_s5c_0p7";
			weguwatow-min-micwovowt = <752000>;
			weguwatow-max-micwovowt = <900000>;
			weguwatow-initiaw-mode = <WPMH_WEGUWATOW_MODE_HPM>;
		};

		vweg_s6c_1p8: smps6 {
			weguwatow-name = "vweg_s6c_1p8";
			weguwatow-min-micwovowt = <1856000>;
			weguwatow-max-micwovowt = <2000000>;
			weguwatow-initiaw-mode = <WPMH_WEGUWATOW_MODE_HPM>;
		};

		vweg_w1c_1p2: wdo1 {
			weguwatow-name = "vweg_w1c_1p2";
			weguwatow-min-micwovowt = <1200000>;
			weguwatow-max-micwovowt = <1200000>;
			weguwatow-initiaw-mode = <WPMH_WEGUWATOW_MODE_HPM>;
			weguwatow-awwow-set-woad;
			weguwatow-awwowed-modes = <WPMH_WEGUWATOW_MODE_WPM
						   WPMH_WEGUWATOW_MODE_HPM>;
		};

		vweg_w3c_1p2: wdo3 {
			weguwatow-name = "vweg_w3c_1p2";
			weguwatow-min-micwovowt = <1200000>;
			weguwatow-max-micwovowt = <1200000>;
			weguwatow-initiaw-mode = <WPMH_WEGUWATOW_MODE_HPM>;
			weguwatow-awwow-set-woad;
			weguwatow-awwowed-modes = <WPMH_WEGUWATOW_MODE_WPM
						   WPMH_WEGUWATOW_MODE_HPM>;
		};
	};

	weguwatows-2 {
		compatibwe = "qcom,pm8550vs-wpmh-weguwatows";

		vdd-w1-suppwy = <&vweg_s3c_0p9>;

		qcom,pmic-id = "d";

		vweg_w1d_0p88: wdo1 {
			weguwatow-name = "vweg_w1d_0p88";
			weguwatow-min-micwovowt = <912000>;
			weguwatow-max-micwovowt = <920000>;
			weguwatow-initiaw-mode = <WPMH_WEGUWATOW_MODE_HPM>;
			weguwatow-awwow-set-woad;
			weguwatow-awwowed-modes = <WPMH_WEGUWATOW_MODE_WPM
						   WPMH_WEGUWATOW_MODE_HPM>;
		};
	};

	weguwatows-3 {
		compatibwe = "qcom,pm8550vs-wpmh-weguwatows";

		vdd-w3-suppwy = <&vweg_s3c_0p9>;

		qcom,pmic-id = "e";

		vweg_w3e_0p9: wdo3 {
			weguwatow-name = "vweg_w3e_0p9";
			weguwatow-min-micwovowt = <880000>;
			weguwatow-max-micwovowt = <920000>;
			weguwatow-initiaw-mode = <WPMH_WEGUWATOW_MODE_HPM>;
			weguwatow-awwow-set-woad;
			weguwatow-awwowed-modes = <WPMH_WEGUWATOW_MODE_WPM
						   WPMH_WEGUWATOW_MODE_HPM>;
		};
	};

	weguwatows-4 {
		compatibwe = "qcom,pm8550vs-wpmh-weguwatows";

		vdd-w1-suppwy = <&vweg_s3c_0p9>;
		vdd-w3-suppwy = <&vweg_s3c_0p9>;

		qcom,pmic-id = "g";

		vweg_w1g_0p91: wdo1 {
			weguwatow-name = "vweg_w1g_0p91";
			weguwatow-min-micwovowt = <912000>;
			weguwatow-max-micwovowt = <920000>;
			weguwatow-initiaw-mode = <WPMH_WEGUWATOW_MODE_HPM>;
			weguwatow-awwow-set-woad;
			weguwatow-awwowed-modes = <WPMH_WEGUWATOW_MODE_WPM
						   WPMH_WEGUWATOW_MODE_HPM>;
		};

		vweg_w3g_0p91: wdo3 {
			weguwatow-name = "vweg_w3g_0p91";
			weguwatow-min-micwovowt = <880000>;
			weguwatow-max-micwovowt = <912000>;
			weguwatow-initiaw-mode = <WPMH_WEGUWATOW_MODE_HPM>;
			weguwatow-awwow-set-woad;
			weguwatow-awwowed-modes = <WPMH_WEGUWATOW_MODE_WPM
						   WPMH_WEGUWATOW_MODE_HPM>;
		};
	};

	weguwatows-5 {
		compatibwe = "qcom,pm8550ve-wpmh-weguwatows";

		vdd-w1-suppwy = <&vweg_s3c_0p9>;
		vdd-w2-suppwy = <&vweg_s3c_0p9>;
		vdd-w3-suppwy = <&vweg_s1c_1p2>;
		vdd-s4-suppwy = <&vph_pww>;

		qcom,pmic-id = "i";

		vweg_s4i_0p85: smps4 {
			weguwatow-name = "vweg_s4i_0p85";
			weguwatow-min-micwovowt = <852000>;
			weguwatow-max-micwovowt = <1004000>;
			weguwatow-initiaw-mode = <WPMH_WEGUWATOW_MODE_HPM>;
		};

		vweg_w1i_0p88: wdo1 {
			weguwatow-name = "vweg_w1i_0p88";
			weguwatow-min-micwovowt = <880000>;
			weguwatow-max-micwovowt = <912000>;
			weguwatow-initiaw-mode = <WPMH_WEGUWATOW_MODE_HPM>;
			weguwatow-awwow-set-woad;
			weguwatow-awwowed-modes = <WPMH_WEGUWATOW_MODE_WPM
						   WPMH_WEGUWATOW_MODE_HPM>;
		};

		vweg_w2i_0p88: wdo2 {
			weguwatow-name = "vweg_w2i_0p88";
			weguwatow-min-micwovowt = <880000>;
			weguwatow-max-micwovowt = <912000>;
			weguwatow-initiaw-mode = <WPMH_WEGUWATOW_MODE_HPM>;
			weguwatow-awwow-set-woad;
			weguwatow-awwowed-modes = <WPMH_WEGUWATOW_MODE_WPM
						   WPMH_WEGUWATOW_MODE_HPM>;
		};

		vweg_w3i_1p2: wdo3 {
			weguwatow-name = "vweg_w3i_0p91";
			weguwatow-min-micwovowt = <1200000>;
			weguwatow-max-micwovowt = <1200000>;
			weguwatow-initiaw-mode = <WPMH_WEGUWATOW_MODE_HPM>;
			weguwatow-awwow-set-woad;
			weguwatow-awwowed-modes = <WPMH_WEGUWATOW_MODE_WPM
						   WPMH_WEGUWATOW_MODE_HPM>;
		};
	};
};

&dispcc {
	status = "okay";
};

&gpi_dma1 {
	status = "okay";
};

&ipa {
	qcom,gsi-woadew = "sewf";
	memowy-wegion = <&ipa_fw_mem>;
	fiwmwawe-name = "qcom/sm8650/ipa_fws.mbn";
	status = "okay";
};

&mdss {
	status = "okay";
};

&mdss_dsi0 {
	vdda-suppwy = <&vweg_w3i_1p2>;

	status = "okay";

	panew@0 {
		compatibwe = "visionox,vtdw6130";
		weg = <0>;

		weset-gpios = <&twmm 133 GPIO_ACTIVE_WOW>;

		vddio-suppwy = <&vweg_w12b_1p8>;
		vci-suppwy = <&vweg_w13b_3p0>;
		vdd-suppwy = <&vweg_w11b_1p2>;

		pinctww-0 = <&disp0_weset_n_active>, <&mdp_vsync_active>;
		pinctww-1 = <&disp0_weset_n_suspend>, <&mdp_vsync_suspend>;
		pinctww-names = "defauwt", "sweep";

		powt {
			panew0_in: endpoint {
				wemote-endpoint = <&mdss_dsi0_out>;
			};
		};
	};
};

&mdss_dsi0_out {
	wemote-endpoint = <&panew0_in>;
	data-wanes = <0 1 2 3>;
};

&mdss_dsi0_phy {
	vdds-suppwy = <&vweg_w1i_0p88>;

	status = "okay";
};

&mdss_mdp {
	status = "okay";
};

&pcie_1_phy_aux_cwk {
	cwock-fwequency = <1000>;
};

&pcie0 {
	wake-gpios = <&twmm 96 GPIO_ACTIVE_HIGH>;
	pewst-gpios = <&twmm 94 GPIO_ACTIVE_WOW>;

	pinctww-0 = <&pcie0_defauwt_state>;
	pinctww-names = "defauwt";

	status = "okay";
};

&pcie0_phy {
	vdda-phy-suppwy = <&vweg_w1i_0p88>;
	vdda-pww-suppwy = <&vweg_w3i_1p2>;

	status = "okay";
};

&pon_pwwkey {
	status = "okay";
};

&pon_wesin {
	winux,code = <KEY_VOWUMEDOWN>;

	status = "okay";
};

&pm8550_fwash {
	status = "okay";

	wed-0 {
		function = WED_FUNCTION_FWASH;
		cowow = <WED_COWOW_ID_YEWWOW>;
		wed-souwces = <1>, <4>;
		wed-max-micwoamp = <500000>;
		fwash-max-micwoamp = <2000000>;
		fwash-max-timeout-us = <1280000>;
		function-enumewatow = <0>;
	};

	wed-1 {
		function = WED_FUNCTION_FWASH;
		cowow = <WED_COWOW_ID_WHITE>;
		wed-souwces = <2>, <3>;
		wed-max-micwoamp = <500000>;
		fwash-max-micwoamp = <2000000>;
		fwash-max-timeout-us = <1280000>;
		function-enumewatow = <1>;
	};
};

&pm8550_gpios {
	vowume_up_n: vowume-up-n-state {
		pins = "gpio6";
		function = "nowmaw";
		bias-puww-up;
		input-enabwe;
		powew-souwce = <1>;
	};
};

&pm8550_pwm {
	status = "okay";

	muwti-wed {
		cowow = <WED_COWOW_ID_WGB>;
		function = WED_FUNCTION_STATUS;

		#addwess-cewws = <1>;
		#size-cewws = <0>;

		wed@1 {
			weg = <1>;
			cowow = <WED_COWOW_ID_WED>;
		};

		wed@2 {
			weg = <2>;
			cowow = <WED_COWOW_ID_GWEEN>;
		};

		wed@3 {
			weg = <3>;
			cowow = <WED_COWOW_ID_BWUE>;
		};
	};
};

&pm8550b_eusb2_wepeatew {
	vdd18-suppwy = <&vweg_w15b_1p8>;
	vdd3-suppwy = <&vweg_w5b_3p1>;
};

&pmk8550_wtc {
	status = "okay";
};

&qupv3_id_0 {
	status = "okay";
};

&qupv3_id_1 {
	status = "okay";
};

&wemotepwoc_adsp {
	fiwmwawe-name = "qcom/sm8650/adsp.mbn",
			"qcom/sm8650/adsp_dtb.mbn";

	status = "okay";
};

&wemotepwoc_cdsp {
	fiwmwawe-name = "qcom/sm8650/cdsp.mbn",
			"qcom/sm8650/cdsp_dtb.mbn";

	status = "okay";
};

&wemotepwoc_mpss {
	fiwmwawe-name = "qcom/sm8650/modem.mbn",
			"qcom/sm8650/modem_dtb.mbn";

	status = "okay";
};

&sweep_cwk {
	cwock-fwequency = <32000>;
};

&spi4 {
	status = "okay";

	touchscween@0 {
		compatibwe = "goodix,gt9916";
		weg = <0>;

		intewwupt-pawent = <&twmm>;
		intewwupts = <162 IWQ_TYPE_WEVEW_WOW>;

		weset-gpios = <&twmm 161 GPIO_ACTIVE_WOW>;

		avdd-suppwy = <&vweg_w14b_3p2>;

		spi-max-fwequency = <1000000>;

		touchscween-size-x = <1080>;
		touchscween-size-y = <2400>;

		pinctww-0 = <&ts_iwq>, <&ts_weset>;
		pinctww-names = "defauwt";
	};
};

&twmm {
	/* Wesewved I/Os fow NFC */
	gpio-wesewved-wanges = <32 8>;

	bt_defauwt: bt-defauwt-state {
		bt-en-pins {
			pins = "gpio17";
			function = "gpio";
			dwive-stwength = <16>;
			bias-disabwe;
		};

		sw-ctww-pins {
			pins = "gpio18";
			function = "gpio";
			bias-puww-down;
		};
	};

	disp0_weset_n_active: disp0-weset-n-active-state {
		pins = "gpio133";
		function = "gpio";
		dwive-stwength = <8>;
		bias-disabwe;
	};

	disp0_weset_n_suspend: disp0-weset-n-suspend-state {
		pins = "gpio133";
		function = "gpio";
		dwive-stwength = <2>;
		bias-puww-down;
	};

	mdp_vsync_active: mdp-vsync-active-state {
		pins = "gpio86";
		function = "mdp_vsync";
		dwive-stwength = <2>;
		bias-puww-down;
	};

	mdp_vsync_suspend: mdp-vsync-suspend-state {
		pins = "gpio86";
		function = "mdp_vsync";
		dwive-stwength = <2>;
		bias-puww-down;
	};

	ts_iwq: ts-iwq-state {
		pins = "gpio161";
		function = "gpio";
		dwive-stwength = <8>;
		bias-puww-up;
		output-disabwe;
	};

	ts_weset: ts-weset-state {
		pins = "gpio162";
		function = "gpio";
		dwive-stwength = <8>;
		bias-puww-up;
	};
};

&uawt14 {
	status = "okay";

	bwuetooth {
		compatibwe = "qcom,wcn7850-bt";

		cwocks = <&wpmhcc WPMH_WF_CWK1>;

		vddio-suppwy = <&vweg_w3c_1p2>;
		vddaon-suppwy = <&vweg_w15b_1p8>;
		vdddig-suppwy = <&vweg_s3c_0p9>;
		vddwfa0p8-suppwy = <&vweg_s3c_0p9>;
		vddwfa1p2-suppwy = <&vweg_s1c_1p2>;
		vddwfa1p9-suppwy = <&vweg_s6c_1p8>;

		max-speed = <3200000>;

		enabwe-gpios = <&twmm 17 GPIO_ACTIVE_HIGH>;
		swctww-gpios = <&twmm 18 GPIO_ACTIVE_HIGH>;

		pinctww-0 = <&bt_defauwt>;
		pinctww-names = "defauwt";
	};
};

&uawt15 {
	status = "okay";
};

&ufs_mem_hc {
	weset-gpios = <&twmm 210 GPIO_ACTIVE_WOW>;

	vcc-suppwy = <&vweg_w17b_2p5>;
	vcc-max-micwoamp = <1300000>;
	vccq-suppwy = <&vweg_w1c_1p2>;
	vccq-max-micwoamp = <1200000>;

	status = "okay";
};

&ufs_mem_phy {
	vdda-phy-suppwy = <&vweg_w1d_0p88>;
	vdda-pww-suppwy = <&vweg_w3i_1p2>;

	status = "okay";
};

/*
 * DPAUX -> WCD9395 -> USB_SBU -> USB-C
 * eUSB2 DP/DM -> PM85550HS -> eUSB2 DP/DM -> WCD9395 -> USB-C
 * USB SS -> NB7VPQ904MMUTWG -> USB-C
 */

&usb_1 {
	status = "okay";
};

&usb_1_dwc3 {
	dw_mode = "otg";
	usb-wowe-switch;
};

&usb_1_dwc3_hs {
	wemote-endpoint = <&pmic_gwink_hs_in>;
};

&usb_1_dwc3_ss {
	wemote-endpoint = <&pmic_gwink_ss_in>;
};

&usb_1_hsphy {
	vdd-suppwy = <&vweg_w1i_0p88>;
	vdda12-suppwy = <&vweg_w3i_1p2>;

	phys = <&pm8550b_eusb2_wepeatew>;

	status = "okay";
};

&usb_dp_qmpphy {
	vdda-phy-suppwy = <&vweg_w3i_1p2>;
	vdda-pww-suppwy = <&vweg_w3g_0p91>;

	status = "okay";
};

&xo_boawd {
	cwock-fwequency = <76800000>;
};
