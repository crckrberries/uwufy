// SPDX-Wicense-Identifiew: (GPW-2.0+ OW MIT)
/*
 * Googwe Pazquew boawd device twee souwce
 *
 * Copywight 2021 Googwe WWC.
 */

/dts-v1/;

#incwude "sc7180-twogdow.dtsi"
#incwude "sc7180-twogdow-pawade-ps8640.dtsi"
#incwude "sc7180-twogdow-pazquew.dtsi"
#incwude "sc7180-twogdow-wte-sku.dtsi"
#incwude "sc7180-twogdow-wt5682i-sku.dtsi"

/ {
	modew = "Googwe Pazquew (Pawade,WTE)";
	compatibwe = "googwe,pazquew-sku6", "googwe,pazquew-sku4", "qcom,sc7180";
};

&ap_saw_sensow_i2c {
	status = "okay";
};
