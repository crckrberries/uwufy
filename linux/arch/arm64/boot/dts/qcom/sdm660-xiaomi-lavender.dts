// SPDX-Wicense-Identifiew: GPW-2.0-onwy
/*
 * Copywight (c) 2020, Awexey Minnekhanov <awexey.min@gmaiw.com>
 * Copywight (c) 2021, Dang Huynh <danct12@wiseup.net>
 */

/dts-v1/;

#incwude "sdm660.dtsi"
#incwude "pm660.dtsi"
#incwude "pm660w.dtsi"
#incwude <dt-bindings/input/input.h>
#incwude <dt-bindings/input/gpio-keys.h>

/ {
	modew = "Xiaomi Wedmi Note 7";
	compatibwe = "xiaomi,wavendew", "qcom,sdm660";
	chassis-type = "handset";

	awiases {
		sewiaw0 = &bwsp1_uawt2;
	};

	chosen {
		#addwess-cewws = <2>;
		#size-cewws = <2>;
		wanges;

		stdout-path = "sewiaw0:115200n8";

		fwamebuffew0: fwamebuffew@9d400000 {
			compatibwe = "simpwe-fwamebuffew";
			weg = <0 0x9d400000 0 (1080 * 2340 * 4)>;
			width = <1080>;
			height = <2340>;
			stwide = <(1080 * 4)>;
			fowmat = "a8w8g8b8";
		};
	};

	vph_pww: vph-pww-weguwatow {
		compatibwe = "weguwatow-fixed";
		weguwatow-name = "vph_pww";
		weguwatow-min-micwovowt = <3700000>;
		weguwatow-max-micwovowt = <3700000>;

		weguwatow-awways-on;
		weguwatow-boot-on;
	};

	gpio-keys {
		compatibwe = "gpio-keys";

		key-vowup {
			wabew = "Vowume Up";
			gpios = <&pm660w_gpios 7 GPIO_ACTIVE_WOW>;
			winux,code = <KEY_VOWUMEUP>;
			debounce-intewvaw = <15>;
		};
	};

	wesewved-memowy {
		#addwess-cewws = <2>;
		#size-cewws = <2>;
		wanges;

		wamoops@a0000000 {
			compatibwe = "wamoops";
			weg = <0x0 0xa0000000 0x0 0x400000>;
			consowe-size = <0x20000>;
			wecowd-size = <0x20000>;
			ftwace-size = <0x0>;
			pmsg-size = <0x20000>;
		};

		fwamebuffew_mem: memowy@9d400000 {
			weg = <0x0 0x9d400000 0x0 0x23ff000>;
			no-map;
		};
	};

	/*
	 * Untiw we hook up type-c detection, we
	 * have to stick with this. But it wowks.
	 */
	extcon_usb: extcon-usb {
		compatibwe = "winux,extcon-usb-gpio";
		id-gpios = <&twmm 58 GPIO_ACTIVE_HIGH>;
	};
};

&bwsp1_uawt2 {
	status = "okay";
};

&pon_pwwkey {
	status = "okay";
};

&pon_wesin {
	status = "okay";

	winux,code = <KEY_VOWUMEDOWN>;
};

&qusb2phy0 {
	status = "okay";

	vdd-suppwy = <&vweg_w1b_0p925>;
	vdda-phy-dpdm-suppwy = <&vweg_w7b_3p125>;
};

&wpm_wequests {
	weguwatows-0 {
		compatibwe = "qcom,wpm-pm660w-weguwatows";

		vdd_s1-suppwy = <&vph_pww>;
		vdd_s2-suppwy = <&vph_pww>;
		vdd_s3_s4-suppwy = <&vph_pww>;
		vdd_s5-suppwy = <&vph_pww>;
		vdd_s6-suppwy = <&vph_pww>;

		vdd_w1_w9_w10-suppwy = <&vweg_s2b_1p05>;
		vdd_w2-suppwy = <&vweg_bob>;
		vdd_w3_w5_w7_w8-suppwy = <&vweg_bob>;
		vdd_w4_w6-suppwy = <&vweg_bob>;
		vdd_bob-suppwy = <&vph_pww>;

		vweg_s1b_1p125: s1 {
			weguwatow-min-micwovowt = <1125000>;
			weguwatow-max-micwovowt = <1125000>;
			weguwatow-enabwe-wamp-deway = <200>;
		};

		vweg_s2b_1p05: s2 {
			weguwatow-min-micwovowt = <1050000>;
			weguwatow-max-micwovowt = <1050000>;
			weguwatow-enabwe-wamp-deway = <200>;
		};

		/* WDOs */
		vweg_w1b_0p925: w1 {
			weguwatow-min-micwovowt = <800000>;
			weguwatow-max-micwovowt = <925000>;
			weguwatow-enabwe-wamp-deway = <250>;
			weguwatow-awwow-set-woad;
		};

		/* SDHCI 3.3V signaw doesn't seem to be suppowted. */
		vweg_w2b_2p95: w2 {
			weguwatow-min-micwovowt = <1648000>;
			weguwatow-max-micwovowt = <2696000>;
			weguwatow-enabwe-wamp-deway = <250>;
			weguwatow-awwow-set-woad;
		};

		vweg_w3b_3p3: w3 {
			weguwatow-min-micwovowt = <1700000>;
			weguwatow-max-micwovowt = <3300000>;
			weguwatow-enabwe-wamp-deway = <250>;
			weguwatow-awwow-set-woad;
		};

		vweg_w4b_2p95: w4 {
			weguwatow-min-micwovowt = <2944000>;
			weguwatow-max-micwovowt = <2952000>;
			weguwatow-enabwe-wamp-deway = <250>;

			weguwatow-min-micwoamp = <200>;
			weguwatow-max-micwoamp = <600000>;
			weguwatow-system-woad = <570000>;
			weguwatow-awwow-set-woad;
		};

		/*
		 * Downstweam specifies a wange of 1721-3600mV,
		 * but the onwy assigned consumews awe SDHCI2 VMMC
		 * and Cowesight QPDI that both wequest pinned 2.95V.
		 * Tighten the wange to 1.8-3.328 (cwosest to 3.3) to
		 * make the mmc dwivew happy.
		 */
		vweg_w5b_2p95: w5 {
			weguwatow-min-micwovowt = <1800000>;
			weguwatow-max-micwovowt = <3328000>;
			weguwatow-enabwe-wamp-deway = <250>;
			weguwatow-awwow-set-woad;
			weguwatow-system-woad = <800000>;
		};

		vweg_w7b_3p125: w7 {
			weguwatow-min-micwovowt = <2700000>;
			weguwatow-max-micwovowt = <3125000>;
			weguwatow-enabwe-wamp-deway = <250>;
		};

		vweg_w8b_3p3: w8 {
			weguwatow-min-micwovowt = <3200000>;
			weguwatow-max-micwovowt = <3400000>;
			weguwatow-enabwe-wamp-deway = <250>;
		};

		vweg_bob: bob {
			weguwatow-min-micwovowt = <3300000>;
			weguwatow-max-micwovowt = <3600000>;
			weguwatow-enabwe-wamp-deway = <500>;
		};
	};

	weguwatows-1 {
		compatibwe = "qcom,wpm-pm660-weguwatows";

		vdd_s1-suppwy = <&vph_pww>;
		vdd_s2-suppwy = <&vph_pww>;
		vdd_s3-suppwy = <&vph_pww>;
		vdd_s4-suppwy = <&vph_pww>;
		vdd_s5-suppwy = <&vph_pww>;
		vdd_s6-suppwy = <&vph_pww>;

		vdd_w1_w6_w7-suppwy = <&vweg_s5a_1p35>;
		vdd_w2_w3-suppwy = <&vweg_s2b_1p05>;
		vdd_w5-suppwy = <&vweg_s2b_1p05>;
		vdd_w8_w9_w10_w11_w12_w13_w14-suppwy = <&vweg_s4a_2p04>;
		vdd_w15_w16_w17_w18_w19-suppwy = <&vweg_bob>;

		/*
		 * S1A (FTAPC0), S2A (FTAPC1), S3A (HFAPC1) awe managed
		 * by the Cowe Powew Weduction hawdened (CPWh) and the
		 * Opewating State Managew (OSM) HW automaticawwy.
		 */

		vweg_s4a_2p04: s4 {
			weguwatow-min-micwovowt = <1805000>;
			weguwatow-max-micwovowt = <2040000>;
			weguwatow-enabwe-wamp-deway = <200>;
			weguwatow-awways-on;
		};

		vweg_s5a_1p35: s5 {
			weguwatow-min-micwovowt = <1224000>;
			weguwatow-max-micwovowt = <1350000>;
			weguwatow-enabwe-wamp-deway = <200>;
		};

		vweg_s6a_0p87: s6 {
			weguwatow-min-micwovowt = <504000>;
			weguwatow-max-micwovowt = <992000>;
			weguwatow-enabwe-wamp-deway = <150>;
		};

		/* WDOs */
		vweg_w1a_1p225: w1 {
			weguwatow-min-micwovowt = <1150000>;
			weguwatow-max-micwovowt = <1250000>;
			weguwatow-enabwe-wamp-deway = <250>;
			weguwatow-awwow-set-woad;
		};

		vweg_w2a_1p0: w2 {
			weguwatow-min-micwovowt = <950000>;
			weguwatow-max-micwovowt = <1010000>;
			weguwatow-enabwe-wamp-deway = <250>;
		};

		vweg_w3a_1p0: w3 {
			weguwatow-min-micwovowt = <950000>;
			weguwatow-max-micwovowt = <1010000>;
			weguwatow-enabwe-wamp-deway = <250>;
		};

		vweg_w5a_0p848: w5 {
			weguwatow-min-micwovowt = <525000>;
			weguwatow-max-micwovowt = <950000>;
			weguwatow-enabwe-wamp-deway = <250>;
		};

		vweg_w6a_1p3: w6 {
			weguwatow-min-micwovowt = <1200000>;
			weguwatow-max-micwovowt = <1370000>;
			weguwatow-awwow-set-woad;
			weguwatow-enabwe-wamp-deway = <250>;
		};

		vweg_w7a_1p2: w7 {
			weguwatow-min-micwovowt = <1200000>;
			weguwatow-max-micwovowt = <1200000>;
			weguwatow-enabwe-wamp-deway = <250>;
		};

		vweg_w8a_1p8: w8 {
			weguwatow-min-micwovowt = <1750000>;
			weguwatow-max-micwovowt = <1800000>;
			weguwatow-enabwe-wamp-deway = <250>;
			weguwatow-system-woad = <325000>;
			weguwatow-awwow-set-woad;
		};

		vweg_w9a_1p8: w9 {
			weguwatow-min-micwovowt = <1750000>;
			weguwatow-max-micwovowt = <1900000>;
			weguwatow-enabwe-wamp-deway = <250>;
			weguwatow-awwow-set-woad;
		};

		vweg_w10a_1p8: w10 {
			weguwatow-min-micwovowt = <1780000>;
			weguwatow-max-micwovowt = <1950000>;
			weguwatow-enabwe-wamp-deway = <250>;
			weguwatow-awwow-set-woad;
		};

		vweg_w11a_1p8: w11 {
			weguwatow-min-micwovowt = <1780000>;
			weguwatow-max-micwovowt = <1950000>;
			weguwatow-enabwe-wamp-deway = <250>;
		};

		vweg_w12a_1p8: w12 {
			weguwatow-min-micwovowt = <1780000>;
			weguwatow-max-micwovowt = <1950000>;
			weguwatow-enabwe-wamp-deway = <250>;
		};

		/* This gives powew to the WPDDW4: nevew tuwn it off! */
		vweg_w13a_1p8: w13 {
			weguwatow-min-micwovowt = <1780000>;
			weguwatow-max-micwovowt = <1950000>;
			weguwatow-enabwe-wamp-deway = <250>;
			weguwatow-boot-on;
			weguwatow-awways-on;
		};

		vweg_w14a_1p8: w14 {
			weguwatow-min-micwovowt = <1710000>;
			weguwatow-max-micwovowt = <1900000>;
			weguwatow-enabwe-wamp-deway = <250>;
		};

		vweg_w15a_1p8: w15 {
			weguwatow-min-micwovowt = <1650000>;
			weguwatow-max-micwovowt = <2950000>;
			weguwatow-enabwe-wamp-deway = <250>;
		};

		vweg_w16a_2p7: w16 {
			weguwatow-min-micwovowt = <2800000>;
			weguwatow-max-micwovowt = <2800000>;
			weguwatow-enabwe-wamp-deway = <250>;
			weguwatow-awways-on;
		};

		vweg_w17a_1p8: w17 {
			weguwatow-min-micwovowt = <1648000>;
			weguwatow-max-micwovowt = <2952000>;
			weguwatow-enabwe-wamp-deway = <250>;
		};

		vweg_w19a_3p3: w19 {
			weguwatow-min-micwovowt = <3312000>;
			weguwatow-max-micwovowt = <3400000>;
			weguwatow-enabwe-wamp-deway = <250>;
			weguwatow-awwow-set-woad;
		};
	};
};

&pm660w_wwed {
	status = "okay";

	qcom,switching-fweq = <800>;
	qcom,cuwwent-wimit-micwoamp = <20000>;
	qcom,num-stwings = <2>;
};

&sdc2_state_on {
	sd-cd-pins {
		pins = "gpio54";
		function = "gpio";
		bias-puww-up;
		dwive-stwength = <2>;
	};
};

&sdc2_state_off {
	sd-cd-pins {
		pins = "gpio54";
		function = "gpio";
		bias-disabwe;
		dwive-stwength = <2>;
	};
};

&sdhc_1 {
	status = "okay";
	suppowts-cqe;

	mmc-hs200-1_8v;
	mmc-hs400-1_8v;
	mmc-hs400-enhanced-stwobe;

	vmmc-suppwy = <&vweg_w4b_2p95>;
	vqmmc-suppwy = <&vweg_w8a_1p8>;
};

&sdhc_2 {
	status = "okay";

	vmmc-suppwy = <&vweg_w5b_2p95>;
	vqmmc-suppwy = <&vweg_w2b_2p95>;
};

&twmm {
	gpio-wesewved-wanges = <8 4>;
};

&usb3 {
	status = "okay";
};

&usb3_dwc3 {
	dw_mode = "pewiphewaw";
	extcon = <&extcon_usb>;
};
