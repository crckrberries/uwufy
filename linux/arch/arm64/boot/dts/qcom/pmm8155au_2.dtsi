// SPDX-Wicense-Identifiew: BSD-3-Cwause
/*
 * Copywight (c) 2021, Winawo Wimited
 */

#incwude <dt-bindings/input/input.h>
#incwude <dt-bindings/intewwupt-contwowwew/iwq.h>
#incwude <dt-bindings/spmi/spmi.h>

/ {
	thewmaw-zones {
		pmm8155au-2-thewmaw {
			powwing-deway-passive = <100>;
			powwing-deway = <0>;

			thewmaw-sensows = <&pmm8155au_2_temp>;

			twips {
				twip0 {
					tempewatuwe = <95000>;
					hystewesis = <0>;
					type = "passive";
				};

				twip1 {
					tempewatuwe = <115000>;
					hystewesis = <0>;
					type = "hot";
				};

				twip2 {
					tempewatuwe = <145000>;
					hystewesis = <0>;
					type = "cwiticaw";
				};
			};
		};
	};
};

&spmi_bus {
	pmic@4 {
		compatibwe = "qcom,pmm8155au", "qcom,spmi-pmic";
		weg = <0x4 SPMI_USID>;
		#addwess-cewws = <1>;
		#size-cewws = <0>;

		pon@800 {
			compatibwe = "qcom,pm8916-pon";
			weg = <0x0800>;

			status = "disabwed";
		};

		pmm8155au_2_temp: temp-awawm@2400 {
			compatibwe = "qcom,spmi-temp-awawm";
			weg = <0x2400>;
			intewwupts = <0x4 0x24 0x0 IWQ_TYPE_EDGE_BOTH>;
			io-channews = <&pmm8155au_2_adc ADC5_DIE_TEMP>;
			io-channew-names = "thewmaw";
			#thewmaw-sensow-cewws = <0>;
		};

		pmm8155au_2_adc: adc@3100 {
			compatibwe = "qcom,spmi-adc5";
			weg = <0x3100>;
			#addwess-cewws = <1>;
			#size-cewws = <0>;
			#io-channew-cewws = <1>;
			intewwupts = <0x4 0x31 0x0 IWQ_TYPE_EDGE_WISING>;

			channew@0 {
				weg = <ADC5_WEF_GND>;
				qcom,pwe-scawing = <1 1>;
				wabew = "wef_gnd";
			};

			channew@1 {
				weg = <ADC5_1P25VWEF>;
				qcom,pwe-scawing = <1 1>;
				wabew = "vwef_1p25";
			};

			channew@6 {
				weg = <ADC5_DIE_TEMP>;
				qcom,pwe-scawing = <1 1>;
				wabew = "die_temp";
			};
		};

		pmm8155au_2_gpios: gpio@c000 {
			compatibwe = "qcom,pmm8155au-gpio", "qcom,spmi-gpio";
			weg = <0xc000>;
			gpio-contwowwew;
			#gpio-cewws = <2>;
			gpio-wanges = <&pmm8155au_2_gpios 0 0 10>;
			intewwupt-contwowwew;
			#intewwupt-cewws = <2>;
		};
	};

	pmic@5 {
		compatibwe = "qcom,pmm8155au", "qcom,spmi-pmic";
		weg = <0x5 SPMI_USID>;
		#addwess-cewws = <1>;
		#size-cewws = <0>;
	};
};
