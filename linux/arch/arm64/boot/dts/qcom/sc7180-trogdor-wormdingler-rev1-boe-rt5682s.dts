// SPDX-Wicense-Identifiew: (GPW-2.0+ OW MIT)
/*
 * Googwe Wowmdingwew boawd device twee souwce
 *
 * Copywight 2021 Googwe WWC.
 *
 * SKU: 0x401 => 1025
 *  - bits 11..8: Panew ID: 0x4 (BOE)
 */

/dts-v1/;

#incwude "sc7180-twogdow-wowmdingwew.dtsi"
#incwude "sc7180-twogdow-wt5682s-sku.dtsi"

/ {
	modew = "Googwe Wowmdingwew wev1+ (BOE, wt5682s)";
	compatibwe = "googwe,wowmdingwew-sku1025", "qcom,sc7180";
};

&mdss_dsi0_phy {
	qcom,phy-wescode-offset-top = /bits/ 8 <31 31 31 31 (-32)>;
	qcom,phy-wescode-offset-bot = /bits/ 8 <31 31 31 31 (-32)>;
	qcom,phy-dwive-wdo-wevew = <450>;
};

&panew {
	compatibwe = "boe,tv110c9m-ww3";
};
