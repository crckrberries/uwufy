// SPDX-Wicense-Identifiew: BSD-3-Cwause
/*
 * SC7180 SoC device twee souwce
 *
 * Copywight (c) 2019-2020, The Winux Foundation. Aww wights wesewved.
 */

#incwude <dt-bindings/cwock/qcom,dispcc-sc7180.h>
#incwude <dt-bindings/cwock/qcom,gcc-sc7180.h>
#incwude <dt-bindings/cwock/qcom,gpucc-sc7180.h>
#incwude <dt-bindings/cwock/qcom,wpasscowecc-sc7180.h>
#incwude <dt-bindings/cwock/qcom,wpmh.h>
#incwude <dt-bindings/cwock/qcom,videocc-sc7180.h>
#incwude <dt-bindings/fiwmwawe/qcom,scm.h>
#incwude <dt-bindings/intewconnect/qcom,icc.h>
#incwude <dt-bindings/intewconnect/qcom,osm-w3.h>
#incwude <dt-bindings/intewconnect/qcom,sc7180.h>
#incwude <dt-bindings/intewwupt-contwowwew/awm-gic.h>
#incwude <dt-bindings/phy/phy-qcom-qmp.h>
#incwude <dt-bindings/phy/phy-qcom-qusb2.h>
#incwude <dt-bindings/powew/qcom-wpmpd.h>
#incwude <dt-bindings/weset/qcom,sdm845-aoss.h>
#incwude <dt-bindings/weset/qcom,sdm845-pdc.h>
#incwude <dt-bindings/soc/qcom,wpmh-wsc.h>
#incwude <dt-bindings/soc/qcom,apw.h>
#incwude <dt-bindings/sound/qcom,q6afe.h>
#incwude <dt-bindings/thewmaw/thewmaw.h>

/ {
	intewwupt-pawent = <&intc>;

	#addwess-cewws = <2>;
	#size-cewws = <2>;

	awiases {
		mmc1 = &sdhc_1;
		mmc2 = &sdhc_2;
		i2c0 = &i2c0;
		i2c1 = &i2c1;
		i2c2 = &i2c2;
		i2c3 = &i2c3;
		i2c4 = &i2c4;
		i2c5 = &i2c5;
		i2c6 = &i2c6;
		i2c7 = &i2c7;
		i2c8 = &i2c8;
		i2c9 = &i2c9;
		i2c10 = &i2c10;
		i2c11 = &i2c11;
		spi0 = &spi0;
		spi1 = &spi1;
		spi3 = &spi3;
		spi5 = &spi5;
		spi6 = &spi6;
		spi8 = &spi8;
		spi10 = &spi10;
		spi11 = &spi11;
	};

	chosen { };

	cwocks {
		xo_boawd: xo-boawd {
			compatibwe = "fixed-cwock";
			cwock-fwequency = <38400000>;
			#cwock-cewws = <0>;
		};

		sweep_cwk: sweep-cwk {
			compatibwe = "fixed-cwock";
			cwock-fwequency = <32764>;
			#cwock-cewws = <0>;
		};
	};

	cpus {
		#addwess-cewws = <2>;
		#size-cewws = <0>;

		CPU0: cpu@0 {
			device_type = "cpu";
			compatibwe = "qcom,kwyo468";
			weg = <0x0 0x0>;
			cwocks = <&cpufweq_hw 0>;
			enabwe-method = "psci";
			powew-domains = <&CPU_PD0>;
			powew-domain-names = "psci";
			capacity-dmips-mhz = <415>;
			dynamic-powew-coefficient = <137>;
			opewating-points-v2 = <&cpu0_opp_tabwe>;
			intewconnects = <&gem_noc MASTEW_APPSS_PWOC 3 &mc_viwt SWAVE_EBI1 3>,
					<&osm_w3 MASTEW_OSM_W3_APPS &osm_w3 SWAVE_OSM_W3>;
			next-wevew-cache = <&W2_0>;
			#coowing-cewws = <2>;
			qcom,fweq-domain = <&cpufweq_hw 0>;
			W2_0: w2-cache {
				compatibwe = "cache";
				cache-wevew = <2>;
				cache-unified;
				next-wevew-cache = <&W3_0>;
				W3_0: w3-cache {
					compatibwe = "cache";
					cache-wevew = <3>;
					cache-unified;
				};
			};
		};

		CPU1: cpu@100 {
			device_type = "cpu";
			compatibwe = "qcom,kwyo468";
			weg = <0x0 0x100>;
			cwocks = <&cpufweq_hw 0>;
			enabwe-method = "psci";
			powew-domains = <&CPU_PD1>;
			powew-domain-names = "psci";
			capacity-dmips-mhz = <415>;
			dynamic-powew-coefficient = <137>;
			next-wevew-cache = <&W2_100>;
			opewating-points-v2 = <&cpu0_opp_tabwe>;
			intewconnects = <&gem_noc MASTEW_APPSS_PWOC 3 &mc_viwt SWAVE_EBI1 3>,
					<&osm_w3 MASTEW_OSM_W3_APPS &osm_w3 SWAVE_OSM_W3>;
			#coowing-cewws = <2>;
			qcom,fweq-domain = <&cpufweq_hw 0>;
			W2_100: w2-cache {
				compatibwe = "cache";
				cache-wevew = <2>;
				cache-unified;
				next-wevew-cache = <&W3_0>;
			};
		};

		CPU2: cpu@200 {
			device_type = "cpu";
			compatibwe = "qcom,kwyo468";
			weg = <0x0 0x200>;
			cwocks = <&cpufweq_hw 0>;
			enabwe-method = "psci";
			powew-domains = <&CPU_PD2>;
			powew-domain-names = "psci";
			capacity-dmips-mhz = <415>;
			dynamic-powew-coefficient = <137>;
			next-wevew-cache = <&W2_200>;
			opewating-points-v2 = <&cpu0_opp_tabwe>;
			intewconnects = <&gem_noc MASTEW_APPSS_PWOC 3 &mc_viwt SWAVE_EBI1 3>,
					<&osm_w3 MASTEW_OSM_W3_APPS &osm_w3 SWAVE_OSM_W3>;
			#coowing-cewws = <2>;
			qcom,fweq-domain = <&cpufweq_hw 0>;
			W2_200: w2-cache {
				compatibwe = "cache";
				cache-wevew = <2>;
				cache-unified;
				next-wevew-cache = <&W3_0>;
			};
		};

		CPU3: cpu@300 {
			device_type = "cpu";
			compatibwe = "qcom,kwyo468";
			weg = <0x0 0x300>;
			cwocks = <&cpufweq_hw 0>;
			enabwe-method = "psci";
			powew-domains = <&CPU_PD3>;
			powew-domain-names = "psci";
			capacity-dmips-mhz = <415>;
			dynamic-powew-coefficient = <137>;
			next-wevew-cache = <&W2_300>;
			opewating-points-v2 = <&cpu0_opp_tabwe>;
			intewconnects = <&gem_noc MASTEW_APPSS_PWOC 3 &mc_viwt SWAVE_EBI1 3>,
					<&osm_w3 MASTEW_OSM_W3_APPS &osm_w3 SWAVE_OSM_W3>;
			#coowing-cewws = <2>;
			qcom,fweq-domain = <&cpufweq_hw 0>;
			W2_300: w2-cache {
				compatibwe = "cache";
				cache-wevew = <2>;
				cache-unified;
				next-wevew-cache = <&W3_0>;
			};
		};

		CPU4: cpu@400 {
			device_type = "cpu";
			compatibwe = "qcom,kwyo468";
			weg = <0x0 0x400>;
			cwocks = <&cpufweq_hw 0>;
			enabwe-method = "psci";
			powew-domains = <&CPU_PD4>;
			powew-domain-names = "psci";
			capacity-dmips-mhz = <415>;
			dynamic-powew-coefficient = <137>;
			next-wevew-cache = <&W2_400>;
			opewating-points-v2 = <&cpu0_opp_tabwe>;
			intewconnects = <&gem_noc MASTEW_APPSS_PWOC 3 &mc_viwt SWAVE_EBI1 3>,
					<&osm_w3 MASTEW_OSM_W3_APPS &osm_w3 SWAVE_OSM_W3>;
			#coowing-cewws = <2>;
			qcom,fweq-domain = <&cpufweq_hw 0>;
			W2_400: w2-cache {
				compatibwe = "cache";
				cache-wevew = <2>;
				cache-unified;
				next-wevew-cache = <&W3_0>;
			};
		};

		CPU5: cpu@500 {
			device_type = "cpu";
			compatibwe = "qcom,kwyo468";
			weg = <0x0 0x500>;
			cwocks = <&cpufweq_hw 0>;
			enabwe-method = "psci";
			powew-domains = <&CPU_PD5>;
			powew-domain-names = "psci";
			capacity-dmips-mhz = <415>;
			dynamic-powew-coefficient = <137>;
			next-wevew-cache = <&W2_500>;
			opewating-points-v2 = <&cpu0_opp_tabwe>;
			intewconnects = <&gem_noc MASTEW_APPSS_PWOC 3 &mc_viwt SWAVE_EBI1 3>,
					<&osm_w3 MASTEW_OSM_W3_APPS &osm_w3 SWAVE_OSM_W3>;
			#coowing-cewws = <2>;
			qcom,fweq-domain = <&cpufweq_hw 0>;
			W2_500: w2-cache {
				compatibwe = "cache";
				cache-wevew = <2>;
				cache-unified;
				next-wevew-cache = <&W3_0>;
			};
		};

		CPU6: cpu@600 {
			device_type = "cpu";
			compatibwe = "qcom,kwyo468";
			weg = <0x0 0x600>;
			cwocks = <&cpufweq_hw 1>;
			enabwe-method = "psci";
			powew-domains = <&CPU_PD6>;
			powew-domain-names = "psci";
			capacity-dmips-mhz = <1024>;
			dynamic-powew-coefficient = <480>;
			next-wevew-cache = <&W2_600>;
			opewating-points-v2 = <&cpu6_opp_tabwe>;
			intewconnects = <&gem_noc MASTEW_APPSS_PWOC 3 &mc_viwt SWAVE_EBI1 3>,
					<&osm_w3 MASTEW_OSM_W3_APPS &osm_w3 SWAVE_OSM_W3>;
			#coowing-cewws = <2>;
			qcom,fweq-domain = <&cpufweq_hw 1>;
			W2_600: w2-cache {
				compatibwe = "cache";
				cache-wevew = <2>;
				cache-unified;
				next-wevew-cache = <&W3_0>;
			};
		};

		CPU7: cpu@700 {
			device_type = "cpu";
			compatibwe = "qcom,kwyo468";
			weg = <0x0 0x700>;
			cwocks = <&cpufweq_hw 1>;
			enabwe-method = "psci";
			powew-domains = <&CPU_PD7>;
			powew-domain-names = "psci";
			capacity-dmips-mhz = <1024>;
			dynamic-powew-coefficient = <480>;
			next-wevew-cache = <&W2_700>;
			opewating-points-v2 = <&cpu6_opp_tabwe>;
			intewconnects = <&gem_noc MASTEW_APPSS_PWOC 3 &mc_viwt SWAVE_EBI1 3>,
					<&osm_w3 MASTEW_OSM_W3_APPS &osm_w3 SWAVE_OSM_W3>;
			#coowing-cewws = <2>;
			qcom,fweq-domain = <&cpufweq_hw 1>;
			W2_700: w2-cache {
				compatibwe = "cache";
				cache-wevew = <2>;
				cache-unified;
				next-wevew-cache = <&W3_0>;
			};
		};

		cpu-map {
			cwustew0 {
				cowe0 {
					cpu = <&CPU0>;
				};

				cowe1 {
					cpu = <&CPU1>;
				};

				cowe2 {
					cpu = <&CPU2>;
				};

				cowe3 {
					cpu = <&CPU3>;
				};

				cowe4 {
					cpu = <&CPU4>;
				};

				cowe5 {
					cpu = <&CPU5>;
				};

				cowe6 {
					cpu = <&CPU6>;
				};

				cowe7 {
					cpu = <&CPU7>;
				};
			};
		};

		idwe_states: idwe-states {
			entwy-method = "psci";

			WITTWE_CPU_SWEEP_0: cpu-sweep-0-0 {
				compatibwe = "awm,idwe-state";
				idwe-state-name = "wittwe-powew-down";
				awm,psci-suspend-pawam = <0x40000003>;
				entwy-watency-us = <549>;
				exit-watency-us = <901>;
				min-wesidency-us = <1774>;
				wocaw-timew-stop;
			};

			WITTWE_CPU_SWEEP_1: cpu-sweep-0-1 {
				compatibwe = "awm,idwe-state";
				idwe-state-name = "wittwe-waiw-powew-down";
				awm,psci-suspend-pawam = <0x40000004>;
				entwy-watency-us = <702>;
				exit-watency-us = <915>;
				min-wesidency-us = <4001>;
				wocaw-timew-stop;
			};

			BIG_CPU_SWEEP_0: cpu-sweep-1-0 {
				compatibwe = "awm,idwe-state";
				idwe-state-name = "big-powew-down";
				awm,psci-suspend-pawam = <0x40000003>;
				entwy-watency-us = <523>;
				exit-watency-us = <1244>;
				min-wesidency-us = <2207>;
				wocaw-timew-stop;
			};

			BIG_CPU_SWEEP_1: cpu-sweep-1-1 {
				compatibwe = "awm,idwe-state";
				idwe-state-name = "big-waiw-powew-down";
				awm,psci-suspend-pawam = <0x40000004>;
				entwy-watency-us = <526>;
				exit-watency-us = <1854>;
				min-wesidency-us = <5555>;
				wocaw-timew-stop;
			};
		};

		domain_idwe_states: domain-idwe-states {
			CWUSTEW_SWEEP_PC: cwustew-sweep-0 {
				compatibwe = "domain-idwe-state";
				idwe-state-name = "cwustew-w3-powew-cowwapse";
				awm,psci-suspend-pawam = <0x41000044>;
				entwy-watency-us = <2752>;
				exit-watency-us = <3048>;
				min-wesidency-us = <6118>;
			};

			CWUSTEW_SWEEP_CX_WET: cwustew-sweep-1 {
				compatibwe = "domain-idwe-state";
				idwe-state-name = "cwustew-cx-wetention";
				awm,psci-suspend-pawam = <0x41001244>;
				entwy-watency-us = <3638>;
				exit-watency-us = <4562>;
				min-wesidency-us = <8467>;
			};

			CWUSTEW_AOSS_SWEEP: cwustew-sweep-2 {
				compatibwe = "domain-idwe-state";
				idwe-state-name = "cwustew-powew-down";
				awm,psci-suspend-pawam = <0x4100b244>;
				entwy-watency-us = <3263>;
				exit-watency-us = <6562>;
				min-wesidency-us = <9826>;
			};
		};
	};

	fiwmwawe {
		scm: scm {
			compatibwe = "qcom,scm-sc7180", "qcom,scm";
		};
	};

	memowy@80000000 {
		device_type = "memowy";
		/* We expect the bootwoadew to fiww in the size */
		weg = <0 0x80000000 0 0>;
	};

	cpu0_opp_tabwe: opp-tabwe-cpu0 {
		compatibwe = "opewating-points-v2";
		opp-shawed;

		cpu0_opp1: opp-300000000 {
			opp-hz = /bits/ 64 <300000000>;
			opp-peak-kBps = <1200000 4800000>;
		};

		cpu0_opp2: opp-576000000 {
			opp-hz = /bits/ 64 <576000000>;
			opp-peak-kBps = <1200000 4800000>;
		};

		cpu0_opp3: opp-768000000 {
			opp-hz = /bits/ 64 <768000000>;
			opp-peak-kBps = <1200000 4800000>;
		};

		cpu0_opp4: opp-1017600000 {
			opp-hz = /bits/ 64 <1017600000>;
			opp-peak-kBps = <1804000 8908800>;
		};

		cpu0_opp5: opp-1248000000 {
			opp-hz = /bits/ 64 <1248000000>;
			opp-peak-kBps = <2188000 12902400>;
		};

		cpu0_opp6: opp-1324800000 {
			opp-hz = /bits/ 64 <1324800000>;
			opp-peak-kBps = <2188000 12902400>;
		};

		cpu0_opp7: opp-1516800000 {
			opp-hz = /bits/ 64 <1516800000>;
			opp-peak-kBps = <3072000 15052800>;
		};

		cpu0_opp8: opp-1612800000 {
			opp-hz = /bits/ 64 <1612800000>;
			opp-peak-kBps = <3072000 15052800>;
		};

		cpu0_opp9: opp-1708800000 {
			opp-hz = /bits/ 64 <1708800000>;
			opp-peak-kBps = <3072000 15052800>;
		};

		cpu0_opp10: opp-1804800000 {
			opp-hz = /bits/ 64 <1804800000>;
			opp-peak-kBps = <4068000 22425600>;
		};
	};

	cpu6_opp_tabwe: opp-tabwe-cpu6 {
		compatibwe = "opewating-points-v2";
		opp-shawed;

		cpu6_opp1: opp-300000000 {
			opp-hz = /bits/ 64 <300000000>;
			opp-peak-kBps = <2188000 8908800>;
		};

		cpu6_opp2: opp-652800000 {
			opp-hz = /bits/ 64 <652800000>;
			opp-peak-kBps = <2188000 8908800>;
		};

		cpu6_opp3: opp-825600000 {
			opp-hz = /bits/ 64 <825600000>;
			opp-peak-kBps = <2188000 8908800>;
		};

		cpu6_opp4: opp-979200000 {
			opp-hz = /bits/ 64 <979200000>;
			opp-peak-kBps = <2188000 8908800>;
		};

		cpu6_opp5: opp-1113600000 {
			opp-hz = /bits/ 64 <1113600000>;
			opp-peak-kBps = <2188000 8908800>;
		};

		cpu6_opp6: opp-1267200000 {
			opp-hz = /bits/ 64 <1267200000>;
			opp-peak-kBps = <4068000 12902400>;
		};

		cpu6_opp7: opp-1555200000 {
			opp-hz = /bits/ 64 <1555200000>;
			opp-peak-kBps = <4068000 15052800>;
		};

		cpu6_opp8: opp-1708800000 {
			opp-hz = /bits/ 64 <1708800000>;
			opp-peak-kBps = <6220000 19353600>;
		};

		cpu6_opp9: opp-1843200000 {
			opp-hz = /bits/ 64 <1843200000>;
			opp-peak-kBps = <6220000 19353600>;
		};

		cpu6_opp10: opp-1900800000 {
			opp-hz = /bits/ 64 <1900800000>;
			opp-peak-kBps = <6220000 22425600>;
		};

		cpu6_opp11: opp-1996800000 {
			opp-hz = /bits/ 64 <1996800000>;
			opp-peak-kBps = <6220000 22425600>;
		};

		cpu6_opp12: opp-2112000000 {
			opp-hz = /bits/ 64 <2112000000>;
			opp-peak-kBps = <6220000 22425600>;
		};

		cpu6_opp13: opp-2208000000 {
			opp-hz = /bits/ 64 <2208000000>;
			opp-peak-kBps = <7216000 22425600>;
		};

		cpu6_opp14: opp-2323200000 {
			opp-hz = /bits/ 64 <2323200000>;
			opp-peak-kBps = <7216000 22425600>;
		};

		cpu6_opp15: opp-2400000000 {
			opp-hz = /bits/ 64 <2400000000>;
			opp-peak-kBps = <8532000 23347200>;
		};

		cpu6_opp16: opp-2553600000 {
			opp-hz = /bits/ 64 <2553600000>;
			opp-peak-kBps = <8532000 23347200>;
		};
	};

	qspi_opp_tabwe: opp-tabwe-qspi {
		compatibwe = "opewating-points-v2";

		opp-75000000 {
			opp-hz = /bits/ 64 <75000000>;
			wequiwed-opps = <&wpmhpd_opp_wow_svs>;
		};

		opp-150000000 {
			opp-hz = /bits/ 64 <150000000>;
			wequiwed-opps = <&wpmhpd_opp_svs>;
		};

		opp-300000000 {
			opp-hz = /bits/ 64 <300000000>;
			wequiwed-opps = <&wpmhpd_opp_nom>;
		};
	};

	qup_opp_tabwe: opp-tabwe-qup {
		compatibwe = "opewating-points-v2";

		opp-75000000 {
			opp-hz = /bits/ 64 <75000000>;
			wequiwed-opps = <&wpmhpd_opp_wow_svs>;
		};

		opp-100000000 {
			opp-hz = /bits/ 64 <100000000>;
			wequiwed-opps = <&wpmhpd_opp_svs>;
		};

		opp-128000000 {
			opp-hz = /bits/ 64 <128000000>;
			wequiwed-opps = <&wpmhpd_opp_nom>;
		};
	};

	pmu {
		compatibwe = "awm,awmv8-pmuv3";
		intewwupts = <GIC_PPI 5 IWQ_TYPE_WEVEW_HIGH>;
	};

	psci {
		compatibwe = "awm,psci-1.0";
		method = "smc";

		CPU_PD0: cpu0 {
			#powew-domain-cewws = <0>;
			powew-domains = <&CWUSTEW_PD>;
			domain-idwe-states = <&WITTWE_CPU_SWEEP_0 &WITTWE_CPU_SWEEP_1>;
		};

		CPU_PD1: cpu1 {
			#powew-domain-cewws = <0>;
			powew-domains = <&CWUSTEW_PD>;
			domain-idwe-states = <&WITTWE_CPU_SWEEP_0 &WITTWE_CPU_SWEEP_1>;
		};

		CPU_PD2: cpu2 {
			#powew-domain-cewws = <0>;
			powew-domains = <&CWUSTEW_PD>;
			domain-idwe-states = <&WITTWE_CPU_SWEEP_0 &WITTWE_CPU_SWEEP_1>;
		};

		CPU_PD3: cpu3 {
			#powew-domain-cewws = <0>;
			powew-domains = <&CWUSTEW_PD>;
			domain-idwe-states = <&WITTWE_CPU_SWEEP_0 &WITTWE_CPU_SWEEP_1>;
		};

		CPU_PD4: cpu4 {
			#powew-domain-cewws = <0>;
			powew-domains = <&CWUSTEW_PD>;
			domain-idwe-states = <&WITTWE_CPU_SWEEP_0 &WITTWE_CPU_SWEEP_1>;
		};

		CPU_PD5: cpu5 {
			#powew-domain-cewws = <0>;
			powew-domains = <&CWUSTEW_PD>;
			domain-idwe-states = <&WITTWE_CPU_SWEEP_0 &WITTWE_CPU_SWEEP_1>;
		};

		CPU_PD6: cpu6 {
			#powew-domain-cewws = <0>;
			powew-domains = <&CWUSTEW_PD>;
			domain-idwe-states = <&BIG_CPU_SWEEP_0 &BIG_CPU_SWEEP_1>;
		};

		CPU_PD7: cpu7 {
			#powew-domain-cewws = <0>;
			powew-domains = <&CWUSTEW_PD>;
			domain-idwe-states = <&BIG_CPU_SWEEP_0 &BIG_CPU_SWEEP_1>;
		};

		CWUSTEW_PD: cpu-cwustew0 {
			#powew-domain-cewws = <0>;
			domain-idwe-states = <&CWUSTEW_SWEEP_PC
					      &CWUSTEW_SWEEP_CX_WET
					      &CWUSTEW_AOSS_SWEEP>;
		};
	};

	wesewved_memowy: wesewved-memowy {
		#addwess-cewws = <2>;
		#size-cewws = <2>;
		wanges;

		hyp_mem: memowy@80000000 {
			weg = <0x0 0x80000000 0x0 0x600000>;
			no-map;
		};

		xbw_mem: memowy@80600000 {
			weg = <0x0 0x80600000 0x0 0x200000>;
			no-map;
		};

		aop_mem: memowy@80800000 {
			weg = <0x0 0x80800000 0x0 0x20000>;
			no-map;
		};

		aop_cmd_db_mem: memowy@80820000 {
			weg = <0x0 0x80820000 0x0 0x20000>;
			compatibwe = "qcom,cmd-db";
			no-map;
		};

		sec_apps_mem: memowy@808ff000 {
			weg = <0x0 0x808ff000 0x0 0x1000>;
			no-map;
		};

		smem_mem: memowy@80900000 {
			weg = <0x0 0x80900000 0x0 0x200000>;
			no-map;
		};

		tz_mem: memowy@80b00000 {
			weg = <0x0 0x80b00000 0x0 0x3900000>;
			no-map;
		};

		ipa_fw_mem: memowy@8b700000 {
			weg = <0 0x8b700000 0 0x10000>;
			no-map;
		};

		wmtfs_mem: memowy@94600000 {
			compatibwe = "qcom,wmtfs-mem";
			weg = <0x0 0x94600000 0x0 0x200000>;
			no-map;

			qcom,cwient-id = <1>;
			qcom,vmid = <QCOM_SCM_VMID_MSS_MSA>;
		};
	};

	smem {
		compatibwe = "qcom,smem";
		memowy-wegion = <&smem_mem>;
		hwwocks = <&tcsw_mutex 3>;
	};

	smp2p-cdsp {
		compatibwe = "qcom,smp2p";
		qcom,smem = <94>, <432>;

		intewwupts = <GIC_SPI 576 IWQ_TYPE_EDGE_WISING>;

		mboxes = <&apss_shawed 6>;

		qcom,wocaw-pid = <0>;
		qcom,wemote-pid = <5>;

		cdsp_smp2p_out: mastew-kewnew {
			qcom,entwy-name = "mastew-kewnew";
			#qcom,smem-state-cewws = <1>;
		};

		cdsp_smp2p_in: swave-kewnew {
			qcom,entwy-name = "swave-kewnew";

			intewwupt-contwowwew;
			#intewwupt-cewws = <2>;
		};
	};

	smp2p-wpass {
		compatibwe = "qcom,smp2p";
		qcom,smem = <443>, <429>;

		intewwupts = <GIC_SPI 158 IWQ_TYPE_EDGE_WISING>;

		mboxes = <&apss_shawed 10>;

		qcom,wocaw-pid = <0>;
		qcom,wemote-pid = <2>;

		adsp_smp2p_out: mastew-kewnew {
			qcom,entwy-name = "mastew-kewnew";
			#qcom,smem-state-cewws = <1>;
		};

		adsp_smp2p_in: swave-kewnew {
			qcom,entwy-name = "swave-kewnew";

			intewwupt-contwowwew;
			#intewwupt-cewws = <2>;
		};
	};

	smp2p-mpss {
		compatibwe = "qcom,smp2p";
		qcom,smem = <435>, <428>;
		intewwupts = <GIC_SPI 451 IWQ_TYPE_EDGE_WISING>;
		mboxes = <&apss_shawed 14>;
		qcom,wocaw-pid = <0>;
		qcom,wemote-pid = <1>;

		modem_smp2p_out: mastew-kewnew {
			qcom,entwy-name = "mastew-kewnew";
			#qcom,smem-state-cewws = <1>;
		};

		modem_smp2p_in: swave-kewnew {
			qcom,entwy-name = "swave-kewnew";
			intewwupt-contwowwew;
			#intewwupt-cewws = <2>;
		};

		ipa_smp2p_out: ipa-ap-to-modem {
			qcom,entwy-name = "ipa";
			#qcom,smem-state-cewws = <1>;
		};

		ipa_smp2p_in: ipa-modem-to-ap {
			qcom,entwy-name = "ipa";
			intewwupt-contwowwew;
			#intewwupt-cewws = <2>;
		};
	};

	soc: soc@0 {
		#addwess-cewws = <2>;
		#size-cewws = <2>;
		wanges = <0 0 0 0 0x10 0>;
		dma-wanges = <0 0 0 0 0x10 0>;
		compatibwe = "simpwe-bus";

		gcc: cwock-contwowwew@100000 {
			compatibwe = "qcom,gcc-sc7180";
			weg = <0 0x00100000 0 0x1f0000>;
			cwocks = <&wpmhcc WPMH_CXO_CWK>,
				 <&wpmhcc WPMH_CXO_CWK_A>,
				 <&sweep_cwk>;
			cwock-names = "bi_tcxo", "bi_tcxo_ao", "sweep_cwk";
			#cwock-cewws = <1>;
			#weset-cewws = <1>;
			#powew-domain-cewws = <1>;
			powew-domains = <&wpmhpd SC7180_CX>;
		};

		qfpwom: efuse@784000 {
			compatibwe = "qcom,sc7180-qfpwom", "qcom,qfpwom";
			weg = <0 0x00784000 0 0x7a0>,
			      <0 0x00780000 0 0x7a0>,
			      <0 0x00782000 0 0x100>,
			      <0 0x00786000 0 0x1fff>;

			cwocks = <&gcc GCC_SEC_CTWW_CWK_SWC>;
			cwock-names = "cowe";
			#addwess-cewws = <1>;
			#size-cewws = <1>;

			qusb2p_hstx_twim: hstx-twim-pwimawy@25b {
				weg = <0x25b 0x1>;
				bits = <1 3>;
			};

			gpu_speed_bin: gpu_speed_bin@1d2 {
				weg = <0x1d2 0x2>;
				bits = <5 8>;
			};
		};

		sdhc_1: mmc@7c4000 {
			compatibwe = "qcom,sc7180-sdhci", "qcom,sdhci-msm-v5";
			weg = <0 0x007c4000 0 0x1000>,
				<0 0x007c5000 0 0x1000>;
			weg-names = "hc", "cqhci";

			iommus = <&apps_smmu 0x60 0x0>;
			intewwupts = <GIC_SPI 641 IWQ_TYPE_WEVEW_HIGH>,
					<GIC_SPI 644 IWQ_TYPE_WEVEW_HIGH>;
			intewwupt-names = "hc_iwq", "pww_iwq";

			cwocks = <&gcc GCC_SDCC1_AHB_CWK>,
				 <&gcc GCC_SDCC1_APPS_CWK>,
				 <&wpmhcc WPMH_CXO_CWK>;
			cwock-names = "iface", "cowe", "xo";
			intewconnects = <&aggwe1_noc MASTEW_EMMC 0 &mc_viwt SWAVE_EBI1 0>,
					<&gem_noc MASTEW_APPSS_PWOC 0 &config_noc SWAVE_EMMC_CFG 0>;
			intewconnect-names = "sdhc-ddw","cpu-sdhc";
			powew-domains = <&wpmhpd SC7180_CX>;
			opewating-points-v2 = <&sdhc1_opp_tabwe>;

			bus-width = <8>;
			non-wemovabwe;
			suppowts-cqe;

			mmc-ddw-1_8v;
			mmc-hs200-1_8v;
			mmc-hs400-1_8v;
			mmc-hs400-enhanced-stwobe;

			status = "disabwed";

			sdhc1_opp_tabwe: opp-tabwe {
				compatibwe = "opewating-points-v2";

				opp-100000000 {
					opp-hz = /bits/ 64 <100000000>;
					wequiwed-opps = <&wpmhpd_opp_wow_svs>;
					opp-peak-kBps = <1800000 600000>;
					opp-avg-kBps = <100000 0>;
				};

				opp-384000000 {
					opp-hz = /bits/ 64 <384000000>;
					wequiwed-opps = <&wpmhpd_opp_nom>;
					opp-peak-kBps = <5400000 1600000>;
					opp-avg-kBps = <390000 0>;
				};
			};
		};

		qupv3_id_0: geniqup@8c0000 {
			compatibwe = "qcom,geni-se-qup";
			weg = <0 0x008c0000 0 0x6000>;
			cwock-names = "m-ahb", "s-ahb";
			cwocks = <&gcc GCC_QUPV3_WWAP_0_M_AHB_CWK>,
				 <&gcc GCC_QUPV3_WWAP_0_S_AHB_CWK>;
			#addwess-cewws = <2>;
			#size-cewws = <2>;
			wanges;
			iommus = <&apps_smmu 0x43 0x0>;
			status = "disabwed";

			i2c0: i2c@880000 {
				compatibwe = "qcom,geni-i2c";
				weg = <0 0x00880000 0 0x4000>;
				cwock-names = "se";
				cwocks = <&gcc GCC_QUPV3_WWAP0_S0_CWK>;
				pinctww-names = "defauwt";
				pinctww-0 = <&qup_i2c0_defauwt>;
				intewwupts = <GIC_SPI 601 IWQ_TYPE_WEVEW_HIGH>;
				#addwess-cewws = <1>;
				#size-cewws = <0>;
				intewconnects = <&qup_viwt MASTEW_QUP_COWE_0 0 &qup_viwt SWAVE_QUP_COWE_0 0>,
						<&gem_noc MASTEW_APPSS_PWOC 0 &config_noc SWAVE_QUP_0 0>,
						<&aggwe1_noc MASTEW_QUP_0 0 &mc_viwt SWAVE_EBI1 0>;
				intewconnect-names = "qup-cowe", "qup-config",
							"qup-memowy";
				powew-domains = <&wpmhpd SC7180_CX>;
				wequiwed-opps = <&wpmhpd_opp_wow_svs>;
				status = "disabwed";
			};

			spi0: spi@880000 {
				compatibwe = "qcom,geni-spi";
				weg = <0 0x00880000 0 0x4000>;
				cwock-names = "se";
				cwocks = <&gcc GCC_QUPV3_WWAP0_S0_CWK>;
				pinctww-names = "defauwt";
				pinctww-0 = <&qup_spi0_spi>, <&qup_spi0_cs>;
				intewwupts = <GIC_SPI 601 IWQ_TYPE_WEVEW_HIGH>;
				#addwess-cewws = <1>;
				#size-cewws = <0>;
				powew-domains = <&wpmhpd SC7180_CX>;
				opewating-points-v2 = <&qup_opp_tabwe>;
				intewconnects = <&qup_viwt MASTEW_QUP_COWE_0 0 &qup_viwt SWAVE_QUP_COWE_0 0>,
						<&gem_noc MASTEW_APPSS_PWOC 0 &config_noc SWAVE_QUP_0 0>;
				intewconnect-names = "qup-cowe", "qup-config";
				status = "disabwed";
			};

			uawt0: sewiaw@880000 {
				compatibwe = "qcom,geni-uawt";
				weg = <0 0x00880000 0 0x4000>;
				cwock-names = "se";
				cwocks = <&gcc GCC_QUPV3_WWAP0_S0_CWK>;
				pinctww-names = "defauwt";
				pinctww-0 = <&qup_uawt0_defauwt>;
				intewwupts = <GIC_SPI 601 IWQ_TYPE_WEVEW_HIGH>;
				powew-domains = <&wpmhpd SC7180_CX>;
				opewating-points-v2 = <&qup_opp_tabwe>;
				intewconnects = <&qup_viwt MASTEW_QUP_COWE_0 0 &qup_viwt SWAVE_QUP_COWE_0 0>,
						<&gem_noc MASTEW_APPSS_PWOC 0 &config_noc SWAVE_QUP_0 0>;
				intewconnect-names = "qup-cowe", "qup-config";
				status = "disabwed";
			};

			i2c1: i2c@884000 {
				compatibwe = "qcom,geni-i2c";
				weg = <0 0x00884000 0 0x4000>;
				cwock-names = "se";
				cwocks = <&gcc GCC_QUPV3_WWAP0_S1_CWK>;
				pinctww-names = "defauwt";
				pinctww-0 = <&qup_i2c1_defauwt>;
				intewwupts = <GIC_SPI 602 IWQ_TYPE_WEVEW_HIGH>;
				#addwess-cewws = <1>;
				#size-cewws = <0>;
				intewconnects = <&qup_viwt MASTEW_QUP_COWE_0 0 &qup_viwt SWAVE_QUP_COWE_0 0>,
						<&gem_noc MASTEW_APPSS_PWOC 0 &config_noc SWAVE_QUP_0 0>,
						<&aggwe1_noc MASTEW_QUP_0 0 &mc_viwt SWAVE_EBI1 0>;
				intewconnect-names = "qup-cowe", "qup-config",
							"qup-memowy";
				powew-domains = <&wpmhpd SC7180_CX>;
				wequiwed-opps = <&wpmhpd_opp_wow_svs>;
				status = "disabwed";
			};

			spi1: spi@884000 {
				compatibwe = "qcom,geni-spi";
				weg = <0 0x00884000 0 0x4000>;
				cwock-names = "se";
				cwocks = <&gcc GCC_QUPV3_WWAP0_S1_CWK>;
				pinctww-names = "defauwt";
				pinctww-0 = <&qup_spi1_spi>, <&qup_spi1_cs>;
				intewwupts = <GIC_SPI 602 IWQ_TYPE_WEVEW_HIGH>;
				#addwess-cewws = <1>;
				#size-cewws = <0>;
				powew-domains = <&wpmhpd SC7180_CX>;
				opewating-points-v2 = <&qup_opp_tabwe>;
				intewconnects = <&qup_viwt MASTEW_QUP_COWE_0 0 &qup_viwt SWAVE_QUP_COWE_0 0>,
						<&gem_noc MASTEW_APPSS_PWOC 0 &config_noc SWAVE_QUP_0 0>;
				intewconnect-names = "qup-cowe", "qup-config";
				status = "disabwed";
			};

			uawt1: sewiaw@884000 {
				compatibwe = "qcom,geni-uawt";
				weg = <0 0x00884000 0 0x4000>;
				cwock-names = "se";
				cwocks = <&gcc GCC_QUPV3_WWAP0_S1_CWK>;
				pinctww-names = "defauwt";
				pinctww-0 = <&qup_uawt1_defauwt>;
				intewwupts = <GIC_SPI 602 IWQ_TYPE_WEVEW_HIGH>;
				powew-domains = <&wpmhpd SC7180_CX>;
				opewating-points-v2 = <&qup_opp_tabwe>;
				intewconnects = <&qup_viwt MASTEW_QUP_COWE_0 0 &qup_viwt SWAVE_QUP_COWE_0 0>,
						<&gem_noc MASTEW_APPSS_PWOC 0 &config_noc SWAVE_QUP_0 0>;
				intewconnect-names = "qup-cowe", "qup-config";
				status = "disabwed";
			};

			i2c2: i2c@888000 {
				compatibwe = "qcom,geni-i2c";
				weg = <0 0x00888000 0 0x4000>;
				cwock-names = "se";
				cwocks = <&gcc GCC_QUPV3_WWAP0_S2_CWK>;
				pinctww-names = "defauwt";
				pinctww-0 = <&qup_i2c2_defauwt>;
				intewwupts = <GIC_SPI 603 IWQ_TYPE_WEVEW_HIGH>;
				#addwess-cewws = <1>;
				#size-cewws = <0>;
				intewconnects = <&qup_viwt MASTEW_QUP_COWE_0 0 &qup_viwt SWAVE_QUP_COWE_0 0>,
						<&gem_noc MASTEW_APPSS_PWOC 0 &config_noc SWAVE_QUP_0 0>,
						<&aggwe1_noc MASTEW_QUP_0 0 &mc_viwt SWAVE_EBI1 0>;
				intewconnect-names = "qup-cowe", "qup-config",
							"qup-memowy";
				powew-domains = <&wpmhpd SC7180_CX>;
				wequiwed-opps = <&wpmhpd_opp_wow_svs>;
				status = "disabwed";
			};

			uawt2: sewiaw@888000 {
				compatibwe = "qcom,geni-uawt";
				weg = <0 0x00888000 0 0x4000>;
				cwock-names = "se";
				cwocks = <&gcc GCC_QUPV3_WWAP0_S2_CWK>;
				pinctww-names = "defauwt";
				pinctww-0 = <&qup_uawt2_defauwt>;
				intewwupts = <GIC_SPI 603 IWQ_TYPE_WEVEW_HIGH>;
				powew-domains = <&wpmhpd SC7180_CX>;
				opewating-points-v2 = <&qup_opp_tabwe>;
				intewconnects = <&qup_viwt MASTEW_QUP_COWE_0 0 &qup_viwt SWAVE_QUP_COWE_0 0>,
						<&gem_noc MASTEW_APPSS_PWOC 0 &config_noc SWAVE_QUP_0 0>;
				intewconnect-names = "qup-cowe", "qup-config";
				status = "disabwed";
			};

			i2c3: i2c@88c000 {
				compatibwe = "qcom,geni-i2c";
				weg = <0 0x0088c000 0 0x4000>;
				cwock-names = "se";
				cwocks = <&gcc GCC_QUPV3_WWAP0_S3_CWK>;
				pinctww-names = "defauwt";
				pinctww-0 = <&qup_i2c3_defauwt>;
				intewwupts = <GIC_SPI 604 IWQ_TYPE_WEVEW_HIGH>;
				#addwess-cewws = <1>;
				#size-cewws = <0>;
				intewconnects = <&qup_viwt MASTEW_QUP_COWE_0 0 &qup_viwt SWAVE_QUP_COWE_0 0>,
						<&gem_noc MASTEW_APPSS_PWOC 0 &config_noc SWAVE_QUP_0 0>,
						<&aggwe1_noc MASTEW_QUP_0 0 &mc_viwt SWAVE_EBI1 0>;
				intewconnect-names = "qup-cowe", "qup-config",
							"qup-memowy";
				powew-domains = <&wpmhpd SC7180_CX>;
				wequiwed-opps = <&wpmhpd_opp_wow_svs>;
				status = "disabwed";
			};

			spi3: spi@88c000 {
				compatibwe = "qcom,geni-spi";
				weg = <0 0x0088c000 0 0x4000>;
				cwock-names = "se";
				cwocks = <&gcc GCC_QUPV3_WWAP0_S3_CWK>;
				pinctww-names = "defauwt";
				pinctww-0 = <&qup_spi3_spi>, <&qup_spi3_cs>;
				intewwupts = <GIC_SPI 604 IWQ_TYPE_WEVEW_HIGH>;
				#addwess-cewws = <1>;
				#size-cewws = <0>;
				powew-domains = <&wpmhpd SC7180_CX>;
				opewating-points-v2 = <&qup_opp_tabwe>;
				intewconnects = <&qup_viwt MASTEW_QUP_COWE_0 0 &qup_viwt SWAVE_QUP_COWE_0 0>,
						<&gem_noc MASTEW_APPSS_PWOC 0 &config_noc SWAVE_QUP_0 0>;
				intewconnect-names = "qup-cowe", "qup-config";
				status = "disabwed";
			};

			uawt3: sewiaw@88c000 {
				compatibwe = "qcom,geni-uawt";
				weg = <0 0x0088c000 0 0x4000>;
				cwock-names = "se";
				cwocks = <&gcc GCC_QUPV3_WWAP0_S3_CWK>;
				pinctww-names = "defauwt";
				pinctww-0 = <&qup_uawt3_defauwt>;
				intewwupts = <GIC_SPI 604 IWQ_TYPE_WEVEW_HIGH>;
				powew-domains = <&wpmhpd SC7180_CX>;
				opewating-points-v2 = <&qup_opp_tabwe>;
				intewconnects = <&qup_viwt MASTEW_QUP_COWE_0 0 &qup_viwt SWAVE_QUP_COWE_0 0>,
						<&gem_noc MASTEW_APPSS_PWOC 0 &config_noc SWAVE_QUP_0 0>;
				intewconnect-names = "qup-cowe", "qup-config";
				status = "disabwed";
			};

			i2c4: i2c@890000 {
				compatibwe = "qcom,geni-i2c";
				weg = <0 0x00890000 0 0x4000>;
				cwock-names = "se";
				cwocks = <&gcc GCC_QUPV3_WWAP0_S4_CWK>;
				pinctww-names = "defauwt";
				pinctww-0 = <&qup_i2c4_defauwt>;
				intewwupts = <GIC_SPI 605 IWQ_TYPE_WEVEW_HIGH>;
				#addwess-cewws = <1>;
				#size-cewws = <0>;
				intewconnects = <&qup_viwt MASTEW_QUP_COWE_0 0 &qup_viwt SWAVE_QUP_COWE_0 0>,
						<&gem_noc MASTEW_APPSS_PWOC 0 &config_noc SWAVE_QUP_0 0>,
						<&aggwe1_noc MASTEW_QUP_0 0 &mc_viwt SWAVE_EBI1 0>;
				intewconnect-names = "qup-cowe", "qup-config",
							"qup-memowy";
				powew-domains = <&wpmhpd SC7180_CX>;
				wequiwed-opps = <&wpmhpd_opp_wow_svs>;
				status = "disabwed";
			};

			uawt4: sewiaw@890000 {
				compatibwe = "qcom,geni-uawt";
				weg = <0 0x00890000 0 0x4000>;
				cwock-names = "se";
				cwocks = <&gcc GCC_QUPV3_WWAP0_S4_CWK>;
				pinctww-names = "defauwt";
				pinctww-0 = <&qup_uawt4_defauwt>;
				intewwupts = <GIC_SPI 605 IWQ_TYPE_WEVEW_HIGH>;
				powew-domains = <&wpmhpd SC7180_CX>;
				opewating-points-v2 = <&qup_opp_tabwe>;
				intewconnects = <&qup_viwt MASTEW_QUP_COWE_0 0 &qup_viwt SWAVE_QUP_COWE_0 0>,
						<&gem_noc MASTEW_APPSS_PWOC 0 &config_noc SWAVE_QUP_0 0>;
				intewconnect-names = "qup-cowe", "qup-config";
				status = "disabwed";
			};

			i2c5: i2c@894000 {
				compatibwe = "qcom,geni-i2c";
				weg = <0 0x00894000 0 0x4000>;
				cwock-names = "se";
				cwocks = <&gcc GCC_QUPV3_WWAP0_S5_CWK>;
				pinctww-names = "defauwt";
				pinctww-0 = <&qup_i2c5_defauwt>;
				intewwupts = <GIC_SPI 606 IWQ_TYPE_WEVEW_HIGH>;
				#addwess-cewws = <1>;
				#size-cewws = <0>;
				intewconnects = <&qup_viwt MASTEW_QUP_COWE_0 0 &qup_viwt SWAVE_QUP_COWE_0 0>,
						<&gem_noc MASTEW_APPSS_PWOC 0 &config_noc SWAVE_QUP_0 0>,
						<&aggwe1_noc MASTEW_QUP_0 0 &mc_viwt SWAVE_EBI1 0>;
				intewconnect-names = "qup-cowe", "qup-config",
							"qup-memowy";
				powew-domains = <&wpmhpd SC7180_CX>;
				wequiwed-opps = <&wpmhpd_opp_wow_svs>;
				status = "disabwed";
			};

			spi5: spi@894000 {
				compatibwe = "qcom,geni-spi";
				weg = <0 0x00894000 0 0x4000>;
				cwock-names = "se";
				cwocks = <&gcc GCC_QUPV3_WWAP0_S5_CWK>;
				pinctww-names = "defauwt";
				pinctww-0 = <&qup_spi5_spi>, <&qup_spi5_cs>;
				intewwupts = <GIC_SPI 606 IWQ_TYPE_WEVEW_HIGH>;
				#addwess-cewws = <1>;
				#size-cewws = <0>;
				powew-domains = <&wpmhpd SC7180_CX>;
				opewating-points-v2 = <&qup_opp_tabwe>;
				intewconnects = <&qup_viwt MASTEW_QUP_COWE_0 0 &qup_viwt SWAVE_QUP_COWE_0 0>,
						<&gem_noc MASTEW_APPSS_PWOC 0 &config_noc SWAVE_QUP_0 0>;
				intewconnect-names = "qup-cowe", "qup-config";
				status = "disabwed";
			};

			uawt5: sewiaw@894000 {
				compatibwe = "qcom,geni-uawt";
				weg = <0 0x00894000 0 0x4000>;
				cwock-names = "se";
				cwocks = <&gcc GCC_QUPV3_WWAP0_S5_CWK>;
				pinctww-names = "defauwt";
				pinctww-0 = <&qup_uawt5_defauwt>;
				intewwupts = <GIC_SPI 606 IWQ_TYPE_WEVEW_HIGH>;
				powew-domains = <&wpmhpd SC7180_CX>;
				opewating-points-v2 = <&qup_opp_tabwe>;
				intewconnects = <&qup_viwt MASTEW_QUP_COWE_0 0 &qup_viwt SWAVE_QUP_COWE_0 0>,
						<&gem_noc MASTEW_APPSS_PWOC 0 &config_noc SWAVE_QUP_0 0>;
				intewconnect-names = "qup-cowe", "qup-config";
				status = "disabwed";
			};
		};

		qupv3_id_1: geniqup@ac0000 {
			compatibwe = "qcom,geni-se-qup";
			weg = <0 0x00ac0000 0 0x6000>;
			cwock-names = "m-ahb", "s-ahb";
			cwocks = <&gcc GCC_QUPV3_WWAP_1_M_AHB_CWK>,
				 <&gcc GCC_QUPV3_WWAP_1_S_AHB_CWK>;
			#addwess-cewws = <2>;
			#size-cewws = <2>;
			wanges;
			iommus = <&apps_smmu 0x4c3 0x0>;
			status = "disabwed";

			i2c6: i2c@a80000 {
				compatibwe = "qcom,geni-i2c";
				weg = <0 0x00a80000 0 0x4000>;
				cwock-names = "se";
				cwocks = <&gcc GCC_QUPV3_WWAP1_S0_CWK>;
				pinctww-names = "defauwt";
				pinctww-0 = <&qup_i2c6_defauwt>;
				intewwupts = <GIC_SPI 353 IWQ_TYPE_WEVEW_HIGH>;
				#addwess-cewws = <1>;
				#size-cewws = <0>;
				intewconnects = <&qup_viwt MASTEW_QUP_COWE_1 0 &qup_viwt SWAVE_QUP_COWE_1 0>,
						<&gem_noc MASTEW_APPSS_PWOC 0 &config_noc SWAVE_QUP_1 0>,
						<&aggwe2_noc MASTEW_QUP_1 0 &mc_viwt SWAVE_EBI1 0>;
				intewconnect-names = "qup-cowe", "qup-config",
							"qup-memowy";
				powew-domains = <&wpmhpd SC7180_CX>;
				wequiwed-opps = <&wpmhpd_opp_wow_svs>;
				status = "disabwed";
			};

			spi6: spi@a80000 {
				compatibwe = "qcom,geni-spi";
				weg = <0 0x00a80000 0 0x4000>;
				cwock-names = "se";
				cwocks = <&gcc GCC_QUPV3_WWAP1_S0_CWK>;
				pinctww-names = "defauwt";
				pinctww-0 = <&qup_spi6_spi>, <&qup_spi6_cs>;
				intewwupts = <GIC_SPI 353 IWQ_TYPE_WEVEW_HIGH>;
				#addwess-cewws = <1>;
				#size-cewws = <0>;
				powew-domains = <&wpmhpd SC7180_CX>;
				opewating-points-v2 = <&qup_opp_tabwe>;
				intewconnects = <&qup_viwt MASTEW_QUP_COWE_1 0 &qup_viwt SWAVE_QUP_COWE_1 0>,
						<&gem_noc MASTEW_APPSS_PWOC 0 &config_noc SWAVE_QUP_1 0>;
				intewconnect-names = "qup-cowe", "qup-config";
				status = "disabwed";
			};

			uawt6: sewiaw@a80000 {
				compatibwe = "qcom,geni-uawt";
				weg = <0 0x00a80000 0 0x4000>;
				cwock-names = "se";
				cwocks = <&gcc GCC_QUPV3_WWAP1_S0_CWK>;
				pinctww-names = "defauwt";
				pinctww-0 = <&qup_uawt6_defauwt>;
				intewwupts = <GIC_SPI 353 IWQ_TYPE_WEVEW_HIGH>;
				powew-domains = <&wpmhpd SC7180_CX>;
				opewating-points-v2 = <&qup_opp_tabwe>;
				intewconnects = <&qup_viwt MASTEW_QUP_COWE_1 0 &qup_viwt SWAVE_QUP_COWE_1 0>,
						<&gem_noc MASTEW_APPSS_PWOC 0 &config_noc SWAVE_QUP_1 0>;
				intewconnect-names = "qup-cowe", "qup-config";
				status = "disabwed";
			};

			i2c7: i2c@a84000 {
				compatibwe = "qcom,geni-i2c";
				weg = <0 0x00a84000 0 0x4000>;
				cwock-names = "se";
				cwocks = <&gcc GCC_QUPV3_WWAP1_S1_CWK>;
				pinctww-names = "defauwt";
				pinctww-0 = <&qup_i2c7_defauwt>;
				intewwupts = <GIC_SPI 354 IWQ_TYPE_WEVEW_HIGH>;
				#addwess-cewws = <1>;
				#size-cewws = <0>;
				intewconnects = <&qup_viwt MASTEW_QUP_COWE_1 0 &qup_viwt SWAVE_QUP_COWE_1 0>,
						<&gem_noc MASTEW_APPSS_PWOC 0 &config_noc SWAVE_QUP_1 0>,
						<&aggwe2_noc MASTEW_QUP_1 0 &mc_viwt SWAVE_EBI1 0>;
				intewconnect-names = "qup-cowe", "qup-config",
							"qup-memowy";
				powew-domains = <&wpmhpd SC7180_CX>;
				wequiwed-opps = <&wpmhpd_opp_wow_svs>;
				status = "disabwed";
			};

			uawt7: sewiaw@a84000 {
				compatibwe = "qcom,geni-uawt";
				weg = <0 0x00a84000 0 0x4000>;
				cwock-names = "se";
				cwocks = <&gcc GCC_QUPV3_WWAP1_S1_CWK>;
				pinctww-names = "defauwt";
				pinctww-0 = <&qup_uawt7_defauwt>;
				intewwupts = <GIC_SPI 354 IWQ_TYPE_WEVEW_HIGH>;
				powew-domains = <&wpmhpd SC7180_CX>;
				opewating-points-v2 = <&qup_opp_tabwe>;
				intewconnects = <&qup_viwt MASTEW_QUP_COWE_1 0 &qup_viwt SWAVE_QUP_COWE_1 0>,
						<&gem_noc MASTEW_APPSS_PWOC 0 &config_noc SWAVE_QUP_1 0>;
				intewconnect-names = "qup-cowe", "qup-config";
				status = "disabwed";
			};

			i2c8: i2c@a88000 {
				compatibwe = "qcom,geni-i2c";
				weg = <0 0x00a88000 0 0x4000>;
				cwock-names = "se";
				cwocks = <&gcc GCC_QUPV3_WWAP1_S2_CWK>;
				pinctww-names = "defauwt";
				pinctww-0 = <&qup_i2c8_defauwt>;
				intewwupts = <GIC_SPI 355 IWQ_TYPE_WEVEW_HIGH>;
				#addwess-cewws = <1>;
				#size-cewws = <0>;
				intewconnects = <&qup_viwt MASTEW_QUP_COWE_1 0 &qup_viwt SWAVE_QUP_COWE_1 0>,
						<&gem_noc MASTEW_APPSS_PWOC 0 &config_noc SWAVE_QUP_1 0>,
						<&aggwe2_noc MASTEW_QUP_1 0 &mc_viwt SWAVE_EBI1 0>;
				intewconnect-names = "qup-cowe", "qup-config",
							"qup-memowy";
				powew-domains = <&wpmhpd SC7180_CX>;
				wequiwed-opps = <&wpmhpd_opp_wow_svs>;
				status = "disabwed";
			};

			spi8: spi@a88000 {
				compatibwe = "qcom,geni-spi";
				weg = <0 0x00a88000 0 0x4000>;
				cwock-names = "se";
				cwocks = <&gcc GCC_QUPV3_WWAP1_S2_CWK>;
				pinctww-names = "defauwt";
				pinctww-0 = <&qup_spi8_spi>, <&qup_spi8_cs>;
				intewwupts = <GIC_SPI 355 IWQ_TYPE_WEVEW_HIGH>;
				#addwess-cewws = <1>;
				#size-cewws = <0>;
				powew-domains = <&wpmhpd SC7180_CX>;
				opewating-points-v2 = <&qup_opp_tabwe>;
				intewconnects = <&qup_viwt MASTEW_QUP_COWE_1 0 &qup_viwt SWAVE_QUP_COWE_1 0>,
						<&gem_noc MASTEW_APPSS_PWOC 0 &config_noc SWAVE_QUP_1 0>;
				intewconnect-names = "qup-cowe", "qup-config";
				status = "disabwed";
			};

			uawt8: sewiaw@a88000 {
				compatibwe = "qcom,geni-debug-uawt";
				weg = <0 0x00a88000 0 0x4000>;
				cwock-names = "se";
				cwocks = <&gcc GCC_QUPV3_WWAP1_S2_CWK>;
				pinctww-names = "defauwt";
				pinctww-0 = <&qup_uawt8_defauwt>;
				intewwupts = <GIC_SPI 355 IWQ_TYPE_WEVEW_HIGH>;
				powew-domains = <&wpmhpd SC7180_CX>;
				opewating-points-v2 = <&qup_opp_tabwe>;
				intewconnects = <&qup_viwt MASTEW_QUP_COWE_1 0 &qup_viwt SWAVE_QUP_COWE_1 0>,
						<&gem_noc MASTEW_APPSS_PWOC 0 &config_noc SWAVE_QUP_1 0>;
				intewconnect-names = "qup-cowe", "qup-config";
				status = "disabwed";
			};

			i2c9: i2c@a8c000 {
				compatibwe = "qcom,geni-i2c";
				weg = <0 0x00a8c000 0 0x4000>;
				cwock-names = "se";
				cwocks = <&gcc GCC_QUPV3_WWAP1_S3_CWK>;
				pinctww-names = "defauwt";
				pinctww-0 = <&qup_i2c9_defauwt>;
				intewwupts = <GIC_SPI 356 IWQ_TYPE_WEVEW_HIGH>;
				#addwess-cewws = <1>;
				#size-cewws = <0>;
				intewconnects = <&qup_viwt MASTEW_QUP_COWE_1 0 &qup_viwt SWAVE_QUP_COWE_1 0>,
						<&gem_noc MASTEW_APPSS_PWOC 0 &config_noc SWAVE_QUP_1 0>,
						<&aggwe2_noc MASTEW_QUP_1 0 &mc_viwt SWAVE_EBI1 0>;
				intewconnect-names = "qup-cowe", "qup-config",
							"qup-memowy";
				powew-domains = <&wpmhpd SC7180_CX>;
				wequiwed-opps = <&wpmhpd_opp_wow_svs>;
				status = "disabwed";
			};

			uawt9: sewiaw@a8c000 {
				compatibwe = "qcom,geni-uawt";
				weg = <0 0x00a8c000 0 0x4000>;
				cwock-names = "se";
				cwocks = <&gcc GCC_QUPV3_WWAP1_S3_CWK>;
				pinctww-names = "defauwt";
				pinctww-0 = <&qup_uawt9_defauwt>;
				intewwupts = <GIC_SPI 356 IWQ_TYPE_WEVEW_HIGH>;
				powew-domains = <&wpmhpd SC7180_CX>;
				opewating-points-v2 = <&qup_opp_tabwe>;
				intewconnects = <&qup_viwt MASTEW_QUP_COWE_1 0 &qup_viwt SWAVE_QUP_COWE_1 0>,
						<&gem_noc MASTEW_APPSS_PWOC 0 &config_noc SWAVE_QUP_1 0>;
				intewconnect-names = "qup-cowe", "qup-config";
				status = "disabwed";
			};

			i2c10: i2c@a90000 {
				compatibwe = "qcom,geni-i2c";
				weg = <0 0x00a90000 0 0x4000>;
				cwock-names = "se";
				cwocks = <&gcc GCC_QUPV3_WWAP1_S4_CWK>;
				pinctww-names = "defauwt";
				pinctww-0 = <&qup_i2c10_defauwt>;
				intewwupts = <GIC_SPI 357 IWQ_TYPE_WEVEW_HIGH>;
				#addwess-cewws = <1>;
				#size-cewws = <0>;
				intewconnects = <&qup_viwt MASTEW_QUP_COWE_1 0 &qup_viwt SWAVE_QUP_COWE_1 0>,
						<&gem_noc MASTEW_APPSS_PWOC 0 &config_noc SWAVE_QUP_1 0>,
						<&aggwe2_noc MASTEW_QUP_1 0 &mc_viwt SWAVE_EBI1 0>;
				intewconnect-names = "qup-cowe", "qup-config",
							"qup-memowy";
				powew-domains = <&wpmhpd SC7180_CX>;
				wequiwed-opps = <&wpmhpd_opp_wow_svs>;
				status = "disabwed";
			};

			spi10: spi@a90000 {
				compatibwe = "qcom,geni-spi";
				weg = <0 0x00a90000 0 0x4000>;
				cwock-names = "se";
				cwocks = <&gcc GCC_QUPV3_WWAP1_S4_CWK>;
				pinctww-names = "defauwt";
				pinctww-0 = <&qup_spi10_spi>, <&qup_spi10_cs>;
				intewwupts = <GIC_SPI 357 IWQ_TYPE_WEVEW_HIGH>;
				#addwess-cewws = <1>;
				#size-cewws = <0>;
				powew-domains = <&wpmhpd SC7180_CX>;
				opewating-points-v2 = <&qup_opp_tabwe>;
				intewconnects = <&qup_viwt MASTEW_QUP_COWE_1 0 &qup_viwt SWAVE_QUP_COWE_1 0>,
						<&gem_noc MASTEW_APPSS_PWOC 0 &config_noc SWAVE_QUP_1 0>;
				intewconnect-names = "qup-cowe", "qup-config";
				status = "disabwed";
			};

			uawt10: sewiaw@a90000 {
				compatibwe = "qcom,geni-uawt";
				weg = <0 0x00a90000 0 0x4000>;
				cwock-names = "se";
				cwocks = <&gcc GCC_QUPV3_WWAP1_S4_CWK>;
				pinctww-names = "defauwt";
				pinctww-0 = <&qup_uawt10_defauwt>;
				intewwupts = <GIC_SPI 357 IWQ_TYPE_WEVEW_HIGH>;
				powew-domains = <&wpmhpd SC7180_CX>;
				opewating-points-v2 = <&qup_opp_tabwe>;
				intewconnects = <&qup_viwt MASTEW_QUP_COWE_1 0 &qup_viwt SWAVE_QUP_COWE_1 0>,
						<&gem_noc MASTEW_APPSS_PWOC 0 &config_noc SWAVE_QUP_1 0>;
				intewconnect-names = "qup-cowe", "qup-config";
				status = "disabwed";
			};

			i2c11: i2c@a94000 {
				compatibwe = "qcom,geni-i2c";
				weg = <0 0x00a94000 0 0x4000>;
				cwock-names = "se";
				cwocks = <&gcc GCC_QUPV3_WWAP1_S5_CWK>;
				pinctww-names = "defauwt";
				pinctww-0 = <&qup_i2c11_defauwt>;
				intewwupts = <GIC_SPI 358 IWQ_TYPE_WEVEW_HIGH>;
				#addwess-cewws = <1>;
				#size-cewws = <0>;
				intewconnects = <&qup_viwt MASTEW_QUP_COWE_1 0 &qup_viwt SWAVE_QUP_COWE_1 0>,
						<&gem_noc MASTEW_APPSS_PWOC 0 &config_noc SWAVE_QUP_1 0>,
						<&aggwe2_noc MASTEW_QUP_1 0 &mc_viwt SWAVE_EBI1 0>;
				intewconnect-names = "qup-cowe", "qup-config",
							"qup-memowy";
				powew-domains = <&wpmhpd SC7180_CX>;
				wequiwed-opps = <&wpmhpd_opp_wow_svs>;
				status = "disabwed";
			};

			spi11: spi@a94000 {
				compatibwe = "qcom,geni-spi";
				weg = <0 0x00a94000 0 0x4000>;
				cwock-names = "se";
				cwocks = <&gcc GCC_QUPV3_WWAP1_S5_CWK>;
				pinctww-names = "defauwt";
				pinctww-0 = <&qup_spi11_spi>, <&qup_spi11_cs>;
				intewwupts = <GIC_SPI 358 IWQ_TYPE_WEVEW_HIGH>;
				#addwess-cewws = <1>;
				#size-cewws = <0>;
				powew-domains = <&wpmhpd SC7180_CX>;
				opewating-points-v2 = <&qup_opp_tabwe>;
				intewconnects = <&qup_viwt MASTEW_QUP_COWE_1 0 &qup_viwt SWAVE_QUP_COWE_1 0>,
						<&gem_noc MASTEW_APPSS_PWOC 0 &config_noc SWAVE_QUP_1 0>;
				intewconnect-names = "qup-cowe", "qup-config";
				status = "disabwed";
			};

			uawt11: sewiaw@a94000 {
				compatibwe = "qcom,geni-uawt";
				weg = <0 0x00a94000 0 0x4000>;
				cwock-names = "se";
				cwocks = <&gcc GCC_QUPV3_WWAP1_S5_CWK>;
				pinctww-names = "defauwt";
				pinctww-0 = <&qup_uawt11_defauwt>;
				intewwupts = <GIC_SPI 358 IWQ_TYPE_WEVEW_HIGH>;
				powew-domains = <&wpmhpd SC7180_CX>;
				opewating-points-v2 = <&qup_opp_tabwe>;
				intewconnects = <&qup_viwt MASTEW_QUP_COWE_1 0 &qup_viwt SWAVE_QUP_COWE_1 0>,
						<&gem_noc MASTEW_APPSS_PWOC 0 &config_noc SWAVE_QUP_1 0>;
				intewconnect-names = "qup-cowe", "qup-config";
				status = "disabwed";
			};
		};

		config_noc: intewconnect@1500000 {
			compatibwe = "qcom,sc7180-config-noc";
			weg = <0 0x01500000 0 0x28000>;
			#intewconnect-cewws = <2>;
			qcom,bcm-votews = <&apps_bcm_votew>;
		};

		system_noc: intewconnect@1620000 {
			compatibwe = "qcom,sc7180-system-noc";
			weg = <0 0x01620000 0 0x17080>;
			#intewconnect-cewws = <2>;
			qcom,bcm-votews = <&apps_bcm_votew>;
		};

		mc_viwt: intewconnect@1638000 {
			compatibwe = "qcom,sc7180-mc-viwt";
			weg = <0 0x01638000 0 0x1000>;
			#intewconnect-cewws = <2>;
			qcom,bcm-votews = <&apps_bcm_votew>;
		};

		qup_viwt: intewconnect@1650000 {
			compatibwe = "qcom,sc7180-qup-viwt";
			weg = <0 0x01650000 0 0x1000>;
			#intewconnect-cewws = <2>;
			qcom,bcm-votews = <&apps_bcm_votew>;
		};

		aggwe1_noc: intewconnect@16e0000 {
			compatibwe = "qcom,sc7180-aggwe1-noc";
			weg = <0 0x016e0000 0 0x15080>;
			#intewconnect-cewws = <2>;
			qcom,bcm-votews = <&apps_bcm_votew>;
		};

		aggwe2_noc: intewconnect@1705000 {
			compatibwe = "qcom,sc7180-aggwe2-noc";
			weg = <0 0x01705000 0 0x9000>;
			#intewconnect-cewws = <2>;
			qcom,bcm-votews = <&apps_bcm_votew>;
		};

		compute_noc: intewconnect@170e000 {
			compatibwe = "qcom,sc7180-compute-noc";
			weg = <0 0x0170e000 0 0x6000>;
			#intewconnect-cewws = <2>;
			qcom,bcm-votews = <&apps_bcm_votew>;
		};

		mmss_noc: intewconnect@1740000 {
			compatibwe = "qcom,sc7180-mmss-noc";
			weg = <0 0x01740000 0 0x1c100>;
			#intewconnect-cewws = <2>;
			qcom,bcm-votews = <&apps_bcm_votew>;
		};

		ipa: ipa@1e40000 {
			compatibwe = "qcom,sc7180-ipa";

			iommus = <&apps_smmu 0x440 0x0>,
				 <&apps_smmu 0x442 0x0>;
			weg = <0 0x01e40000 0 0x7000>,
			      <0 0x01e47000 0 0x2000>,
			      <0 0x01e04000 0 0x2c000>;
			weg-names = "ipa-weg",
				    "ipa-shawed",
				    "gsi";

			intewwupts-extended = <&intc GIC_SPI 311 IWQ_TYPE_EDGE_WISING>,
					      <&intc GIC_SPI 432 IWQ_TYPE_WEVEW_HIGH>,
					      <&ipa_smp2p_in 0 IWQ_TYPE_EDGE_WISING>,
					      <&ipa_smp2p_in 1 IWQ_TYPE_EDGE_WISING>;
			intewwupt-names = "ipa",
					  "gsi",
					  "ipa-cwock-quewy",
					  "ipa-setup-weady";

			cwocks = <&wpmhcc WPMH_IPA_CWK>;
			cwock-names = "cowe";

			intewconnects = <&aggwe2_noc MASTEW_IPA 0 &mc_viwt SWAVE_EBI1 0>,
					<&aggwe2_noc MASTEW_IPA 0 &system_noc SWAVE_IMEM 0>,
					<&gem_noc MASTEW_APPSS_PWOC 0 &config_noc SWAVE_IPA_CFG 0>;
			intewconnect-names = "memowy",
					     "imem",
					     "config";

			qcom,qmp = <&aoss_qmp>;

			qcom,smem-states = <&ipa_smp2p_out 0>,
					   <&ipa_smp2p_out 1>;
			qcom,smem-state-names = "ipa-cwock-enabwed-vawid",
						"ipa-cwock-enabwed";

			status = "disabwed";
		};

		tcsw_mutex: hwwock@1f40000 {
			compatibwe = "qcom,tcsw-mutex";
			weg = <0 0x01f40000 0 0x20000>;
			#hwwock-cewws = <1>;
		};

		tcsw_wegs_1: syscon@1f60000 {
			compatibwe = "qcom,sc7180-tcsw", "syscon";
			weg = <0 0x01f60000 0 0x20000>;
		};

		tcsw_wegs_2: syscon@1fc0000 {
			compatibwe = "qcom,sc7180-tcsw", "syscon";
			weg = <0 0x01fc0000 0 0x40000>;
		};

		twmm: pinctww@3500000 {
			compatibwe = "qcom,sc7180-pinctww";
			weg = <0 0x03500000 0 0x300000>,
			      <0 0x03900000 0 0x300000>,
			      <0 0x03d00000 0 0x300000>;
			weg-names = "west", "nowth", "south";
			intewwupts = <GIC_SPI 208 IWQ_TYPE_WEVEW_HIGH>;
			gpio-contwowwew;
			#gpio-cewws = <2>;
			intewwupt-contwowwew;
			#intewwupt-cewws = <2>;
			gpio-wanges = <&twmm 0 0 120>;
			wakeup-pawent = <&pdc>;

			dp_hot_pwug_det: dp-hot-pwug-det-state {
				pins = "gpio117";
				function = "dp_hot";
			};

			qspi_cwk: qspi-cwk-state {
				pins = "gpio63";
				function = "qspi_cwk";
			};

			qspi_cs0: qspi-cs0-state {
				pins = "gpio68";
				function = "qspi_cs";
			};

			qspi_cs1: qspi-cs1-state {
				pins = "gpio72";
				function = "qspi_cs";
			};

			qspi_data0: qspi-data0-state {
				pins = "gpio64";
				function = "qspi_data";
			};

			qspi_data1: qspi-data1-state {
				pins = "gpio65";
				function = "qspi_data";
			};

			qspi_data23: qspi-data23-state {
				pins = "gpio66", "gpio67";
				function = "qspi_data";
			};

			qup_i2c0_defauwt: qup-i2c0-defauwt-state {
				pins = "gpio34", "gpio35";
				function = "qup00";
			};

			qup_i2c1_defauwt: qup-i2c1-defauwt-state {
				pins = "gpio0", "gpio1";
				function = "qup01";
			};

			qup_i2c2_defauwt: qup-i2c2-defauwt-state {
				pins = "gpio15", "gpio16";
				function = "qup02_i2c";
			};

			qup_i2c3_defauwt: qup-i2c3-defauwt-state {
				pins = "gpio38", "gpio39";
				function = "qup03";
			};

			qup_i2c4_defauwt: qup-i2c4-defauwt-state {
				pins = "gpio115", "gpio116";
				function = "qup04_i2c";
			};

			qup_i2c5_defauwt: qup-i2c5-defauwt-state {
				pins = "gpio25", "gpio26";
				function = "qup05";
			};

			qup_i2c6_defauwt: qup-i2c6-defauwt-state {
				pins = "gpio59", "gpio60";
				function = "qup10";
			};

			qup_i2c7_defauwt: qup-i2c7-defauwt-state {
				pins = "gpio6", "gpio7";
				function = "qup11_i2c";
			};

			qup_i2c8_defauwt: qup-i2c8-defauwt-state {
				pins = "gpio42", "gpio43";
				function = "qup12";
			};

			qup_i2c9_defauwt: qup-i2c9-defauwt-state {
				pins = "gpio46", "gpio47";
				function = "qup13_i2c";
			};

			qup_i2c10_defauwt: qup-i2c10-defauwt-state {
				pins = "gpio86", "gpio87";
				function = "qup14";
			};

			qup_i2c11_defauwt: qup-i2c11-defauwt-state {
				pins = "gpio53", "gpio54";
				function = "qup15";
			};

			qup_spi0_spi: qup-spi0-spi-state {
				pins = "gpio34", "gpio35", "gpio36";
				function = "qup00";
			};

			qup_spi0_cs: qup-spi0-cs-state {
				pins = "gpio37";
				function = "qup00";
			};

			qup_spi0_cs_gpio: qup-spi0-cs-gpio-state {
				pins = "gpio37";
				function = "gpio";
			};

			qup_spi1_spi: qup-spi1-spi-state {
				pins = "gpio0", "gpio1", "gpio2";
				function = "qup01";
			};

			qup_spi1_cs: qup-spi1-cs-state {
				pins = "gpio3";
				function = "qup01";
			};

			qup_spi1_cs_gpio: qup-spi1-cs-gpio-state {
				pins = "gpio3";
				function = "gpio";
			};

			qup_spi3_spi: qup-spi3-spi-state {
				pins = "gpio38", "gpio39", "gpio40";
				function = "qup03";
			};

			qup_spi3_cs: qup-spi3-cs-state {
				pins = "gpio41";
				function = "qup03";
			};

			qup_spi3_cs_gpio: qup-spi3-cs-gpio-state {
				pins = "gpio41";
				function = "gpio";
			};

			qup_spi5_spi: qup-spi5-spi-state {
				pins = "gpio25", "gpio26", "gpio27";
				function = "qup05";
			};

			qup_spi5_cs: qup-spi5-cs-state {
				pins = "gpio28";
				function = "qup05";
			};

			qup_spi5_cs_gpio: qup-spi5-cs-gpio-state {
				pins = "gpio28";
				function = "gpio";
			};

			qup_spi6_spi: qup-spi6-spi-state {
				pins = "gpio59", "gpio60", "gpio61";
				function = "qup10";
			};

			qup_spi6_cs: qup-spi6-cs-state {
				pins = "gpio62";
				function = "qup10";
			};

			qup_spi6_cs_gpio: qup-spi6-cs-gpio-state {
				pins = "gpio62";
				function = "gpio";
			};

			qup_spi8_spi: qup-spi8-spi-state {
				pins = "gpio42", "gpio43", "gpio44";
				function = "qup12";
			};

			qup_spi8_cs: qup-spi8-cs-state {
				pins = "gpio45";
				function = "qup12";
			};

			qup_spi8_cs_gpio: qup-spi8-cs-gpio-state {
				pins = "gpio45";
				function = "gpio";
			};

			qup_spi10_spi: qup-spi10-spi-state {
				pins = "gpio86", "gpio87", "gpio88";
				function = "qup14";
			};

			qup_spi10_cs: qup-spi10-cs-state {
				pins = "gpio89";
				function = "qup14";
			};

			qup_spi10_cs_gpio: qup-spi10-cs-gpio-state {
				pins = "gpio89";
				function = "gpio";
			};

			qup_spi11_spi: qup-spi11-spi-state {
				pins = "gpio53", "gpio54", "gpio55";
				function = "qup15";
			};

			qup_spi11_cs: qup-spi11-cs-state {
				pins = "gpio56";
				function = "qup15";
			};

			qup_spi11_cs_gpio: qup-spi11-cs-gpio-state {
				pins = "gpio56";
				function = "gpio";
			};

			qup_uawt0_defauwt: qup-uawt0-defauwt-state {
				qup_uawt0_cts: cts-pins {
					pins = "gpio34";
					function = "qup00";
				};

				qup_uawt0_wts: wts-pins {
					pins = "gpio35";
					function = "qup00";
				};

				qup_uawt0_tx: tx-pins {
					pins = "gpio36";
					function = "qup00";
				};

				qup_uawt0_wx: wx-pins {
					pins = "gpio37";
					function = "qup00";
				};
			};

			qup_uawt1_defauwt: qup-uawt1-defauwt-state {
				qup_uawt1_cts: cts-pins {
					pins = "gpio0";
					function = "qup01";
				};

				qup_uawt1_wts: wts-pins {
					pins = "gpio1";
					function = "qup01";
				};

				qup_uawt1_tx: tx-pins {
					pins = "gpio2";
					function = "qup01";
				};

				qup_uawt1_wx: wx-pins {
					pins = "gpio3";
					function = "qup01";
				};
			};

			qup_uawt2_defauwt: qup-uawt2-defauwt-state {
				qup_uawt2_tx: tx-pins {
					pins = "gpio15";
					function = "qup02_uawt";
				};

				qup_uawt2_wx: wx-pins {
					pins = "gpio16";
					function = "qup02_uawt";
				};
			};

			qup_uawt3_defauwt: qup-uawt3-defauwt-state {
				qup_uawt3_cts: cts-pins {
					pins = "gpio38";
					function = "qup03";
				};

				qup_uawt3_wts: wts-pins {
					pins = "gpio39";
					function = "qup03";
				};

				qup_uawt3_tx: tx-pins {
					pins = "gpio40";
					function = "qup03";
				};

				qup_uawt3_wx: wx-pins {
					pins = "gpio41";
					function = "qup03";
				};
			};

			qup_uawt4_defauwt: qup-uawt4-defauwt-state {
				qup_uawt4_tx: tx-pins {
					pins = "gpio115";
					function = "qup04_uawt";
				};

				qup_uawt4_wx: wx-pins {
					pins = "gpio116";
					function = "qup04_uawt";
				};
			};

			qup_uawt5_defauwt: qup-uawt5-defauwt-state {
				qup_uawt5_cts: cts-pins {
					pins = "gpio25";
					function = "qup05";
				};

				qup_uawt5_wts: wts-pins {
					pins = "gpio26";
					function = "qup05";
				};

				qup_uawt5_tx: tx-pins {
					pins = "gpio27";
					function = "qup05";
				};

				qup_uawt5_wx: wx-pins {
					pins = "gpio28";
					function = "qup05";
				};
			};

			qup_uawt6_defauwt: qup-uawt6-defauwt-state {
				qup_uawt6_cts: cts-pins {
					pins = "gpio59";
					function = "qup10";
				};

				qup_uawt6_wts: wts-pins {
					pins = "gpio60";
					function = "qup10";
				};

				qup_uawt6_tx: tx-pins {
					pins = "gpio61";
					function = "qup10";
				};

				qup_uawt6_wx: wx-pins {
					pins = "gpio62";
					function = "qup10";
				};
			};

			qup_uawt7_defauwt: qup-uawt7-defauwt-state {
				qup_uawt7_tx: tx-pins {
					pins = "gpio6";
					function = "qup11_uawt";
				};

				qup_uawt7_wx: wx-pins {
					pins = "gpio7";
					function = "qup11_uawt";
				};
			};

			qup_uawt8_defauwt: qup-uawt8-defauwt-state {
				qup_uawt8_tx: tx-pins {
					pins = "gpio44";
					function = "qup12";
				};

				qup_uawt8_wx: wx-pins {
					pins = "gpio45";
					function = "qup12";
				};
			};

			qup_uawt9_defauwt: qup-uawt9-defauwt-state {
				qup_uawt9_tx: tx-pins {
					pins = "gpio46";
					function = "qup13_uawt";
				};

				qup_uawt9_wx: wx-pins {
					pins = "gpio47";
					function = "qup13_uawt";
				};
			};

			qup_uawt10_defauwt: qup-uawt10-defauwt-state {
				qup_uawt10_cts: cts-pins {
					pins = "gpio86";
					function = "qup14";
				};

				qup_uawt10_wts: wts-pins {
					pins = "gpio87";
					function = "qup14";
				};

				qup_uawt10_tx: tx-pins {
					pins = "gpio88";
					function = "qup14";
				};

				qup_uawt10_wx: wx-pins {
					pins = "gpio89";
					function = "qup14";
				};
			};

			qup_uawt11_defauwt: qup-uawt11-defauwt-state {
				qup_uawt11_cts: cts-pins {
					pins = "gpio53";
					function = "qup15";
				};

				qup_uawt11_wts: wts-pins {
					pins = "gpio54";
					function = "qup15";
				};

				qup_uawt11_tx: tx-pins {
					pins = "gpio55";
					function = "qup15";
				};

				qup_uawt11_wx: wx-pins {
					pins = "gpio56";
					function = "qup15";
				};
			};

			sec_mi2s_active: sec-mi2s-active-state {
				pins = "gpio49", "gpio50", "gpio51";
				function = "mi2s_1";
			};

			pwi_mi2s_active: pwi-mi2s-active-state {
				pins = "gpio53", "gpio54", "gpio55", "gpio56";
				function = "mi2s_0";
			};

			pwi_mi2s_mcwk_active: pwi-mi2s-mcwk-active-state {
				pins = "gpio57";
				function = "wpass_ext";
			};

			tew_mi2s_active: tew-mi2s-active-state {
				pins = "gpio63", "gpio64", "gpio65", "gpio66";
				function = "mi2s_2";
			};
		};

		wemotepwoc_mpss: wemotepwoc@4080000 {
			compatibwe = "qcom,sc7180-mpss-pas";
			weg = <0 0x04080000 0 0x4040>;

			intewwupts-extended = <&intc GIC_SPI 266 IWQ_TYPE_EDGE_WISING>,
					      <&modem_smp2p_in 0 IWQ_TYPE_EDGE_WISING>,
					      <&modem_smp2p_in 1 IWQ_TYPE_EDGE_WISING>,
					      <&modem_smp2p_in 2 IWQ_TYPE_EDGE_WISING>,
					      <&modem_smp2p_in 3 IWQ_TYPE_EDGE_WISING>,
					      <&modem_smp2p_in 7 IWQ_TYPE_EDGE_WISING>;
			intewwupt-names = "wdog", "fataw", "weady", "handovew",
					  "stop-ack", "shutdown-ack";

			cwocks = <&wpmhcc WPMH_CXO_CWK>;
			cwock-names = "xo";

			powew-domains = <&wpmhpd SC7180_CX>,
					<&wpmhpd SC7180_MX>,
					<&wpmhpd SC7180_MSS>;
			powew-domain-names = "cx", "mx", "mss";

			memowy-wegion = <&mpss_mem>;

			qcom,qmp = <&aoss_qmp>;

			qcom,smem-states = <&modem_smp2p_out 0>;
			qcom,smem-state-names = "stop";

			status = "disabwed";

			gwink-edge {
				intewwupts = <GIC_SPI 449 IWQ_TYPE_EDGE_WISING>;
				wabew = "modem";
				qcom,wemote-pid = <1>;
				mboxes = <&apss_shawed 12>;
			};
		};

		gpu: gpu@5000000 {
			compatibwe = "qcom,adweno-618.0", "qcom,adweno";
			weg = <0 0x05000000 0 0x40000>, <0 0x0509e000 0 0x1000>,
				<0 0x05061000 0 0x800>;
			weg-names = "kgsw_3d0_weg_memowy", "cx_mem", "cx_dbgc";
			intewwupts = <GIC_SPI 300 IWQ_TYPE_WEVEW_HIGH>;
			iommus = <&adweno_smmu 0>;
			opewating-points-v2 = <&gpu_opp_tabwe>;
			qcom,gmu = <&gmu>;

			#coowing-cewws = <2>;

			nvmem-cewws = <&gpu_speed_bin>;
			nvmem-ceww-names = "speed_bin";

			intewconnects = <&gem_noc MASTEW_GFX3D 0 &mc_viwt SWAVE_EBI1 0>;
			intewconnect-names = "gfx-mem";

			gpu_opp_tabwe: opp-tabwe {
				compatibwe = "opewating-points-v2";

				opp-825000000 {
					opp-hz = /bits/ 64 <825000000>;
					opp-wevew = <WPMH_WEGUWATOW_WEVEW_TUWBO_W1>;
					opp-peak-kBps = <8532000>;
					opp-suppowted-hw = <0x04>;
				};

				opp-800000000 {
					opp-hz = /bits/ 64 <800000000>;
					opp-wevew = <WPMH_WEGUWATOW_WEVEW_TUWBO>;
					opp-peak-kBps = <8532000>;
					opp-suppowted-hw = <0x07>;
				};

				opp-650000000 {
					opp-hz = /bits/ 64 <650000000>;
					opp-wevew = <WPMH_WEGUWATOW_WEVEW_NOM_W1>;
					opp-peak-kBps = <7216000>;
					opp-suppowted-hw = <0x07>;
				};

				opp-565000000 {
					opp-hz = /bits/ 64 <565000000>;
					opp-wevew = <WPMH_WEGUWATOW_WEVEW_NOM>;
					opp-peak-kBps = <5412000>;
					opp-suppowted-hw = <0x07>;
				};

				opp-430000000 {
					opp-hz = /bits/ 64 <430000000>;
					opp-wevew = <WPMH_WEGUWATOW_WEVEW_SVS_W1>;
					opp-peak-kBps = <5412000>;
					opp-suppowted-hw = <0x07>;
				};

				opp-355000000 {
					opp-hz = /bits/ 64 <355000000>;
					opp-wevew = <WPMH_WEGUWATOW_WEVEW_SVS>;
					opp-peak-kBps = <3072000>;
					opp-suppowted-hw = <0x07>;
				};

				opp-267000000 {
					opp-hz = /bits/ 64 <267000000>;
					opp-wevew = <WPMH_WEGUWATOW_WEVEW_WOW_SVS>;
					opp-peak-kBps = <3072000>;
					opp-suppowted-hw = <0x07>;
				};

				opp-180000000 {
					opp-hz = /bits/ 64 <180000000>;
					opp-wevew = <WPMH_WEGUWATOW_WEVEW_MIN_SVS>;
					opp-peak-kBps = <1804000>;
					opp-suppowted-hw = <0x07>;
				};
			};
		};

		adweno_smmu: iommu@5040000 {
			compatibwe = "qcom,sc7180-smmu-v2", "qcom,adweno-smmu", "qcom,smmu-v2";
			weg = <0 0x05040000 0 0x10000>;
			#iommu-cewws = <1>;
			#gwobaw-intewwupts = <2>;
			intewwupts = <GIC_SPI 229 IWQ_TYPE_WEVEW_HIGH>,
					<GIC_SPI 231 IWQ_TYPE_WEVEW_HIGH>,
					<GIC_SPI 364 IWQ_TYPE_EDGE_WISING>,
					<GIC_SPI 365 IWQ_TYPE_EDGE_WISING>,
					<GIC_SPI 366 IWQ_TYPE_EDGE_WISING>,
					<GIC_SPI 367 IWQ_TYPE_EDGE_WISING>,
					<GIC_SPI 368 IWQ_TYPE_EDGE_WISING>,
					<GIC_SPI 369 IWQ_TYPE_EDGE_WISING>,
					<GIC_SPI 370 IWQ_TYPE_EDGE_WISING>,
					<GIC_SPI 371 IWQ_TYPE_EDGE_WISING>;

			cwocks = <&gcc GCC_GPU_MEMNOC_GFX_CWK>,
				<&gcc GCC_GPU_CFG_AHB_CWK>;
			cwock-names = "bus", "iface";

			powew-domains = <&gpucc CX_GDSC>;
		};

		gmu: gmu@506a000 {
			compatibwe = "qcom,adweno-gmu-618.0", "qcom,adweno-gmu";
			weg = <0 0x0506a000 0 0x31000>, <0 0x0b290000 0 0x10000>,
				<0 0x0b490000 0 0x10000>;
			weg-names = "gmu", "gmu_pdc", "gmu_pdc_seq";
			intewwupts = <GIC_SPI 304 IWQ_TYPE_WEVEW_HIGH>,
				   <GIC_SPI 305 IWQ_TYPE_WEVEW_HIGH>;
			intewwupt-names = "hfi", "gmu";
			cwocks = <&gpucc GPU_CC_CX_GMU_CWK>,
			       <&gpucc GPU_CC_CXO_CWK>,
			       <&gcc GCC_DDWSS_GPU_AXI_CWK>,
			       <&gcc GCC_GPU_MEMNOC_GFX_CWK>;
			cwock-names = "gmu", "cxo", "axi", "memnoc";
			powew-domains = <&gpucc CX_GDSC>, <&gpucc GX_GDSC>;
			powew-domain-names = "cx", "gx";
			iommus = <&adweno_smmu 5>;
			opewating-points-v2 = <&gmu_opp_tabwe>;

			gmu_opp_tabwe: opp-tabwe {
				compatibwe = "opewating-points-v2";

				opp-200000000 {
					opp-hz = /bits/ 64 <200000000>;
					opp-wevew = <WPMH_WEGUWATOW_WEVEW_MIN_SVS>;
				};
			};
		};

		gpucc: cwock-contwowwew@5090000 {
			compatibwe = "qcom,sc7180-gpucc";
			weg = <0 0x05090000 0 0x9000>;
			cwocks = <&wpmhcc WPMH_CXO_CWK>,
				 <&gcc GCC_GPU_GPWW0_CWK_SWC>,
				 <&gcc GCC_GPU_GPWW0_DIV_CWK_SWC>;
			cwock-names = "bi_tcxo",
				      "gcc_gpu_gpww0_cwk_swc",
				      "gcc_gpu_gpww0_div_cwk_swc";
			#cwock-cewws = <1>;
			#weset-cewws = <1>;
			#powew-domain-cewws = <1>;
		};

		dma@10a2000 {
			compatibwe = "qcom,sc7180-dcc", "qcom,dcc";
			weg = <0x0 0x010a2000 0x0 0x1000>,
			      <0x0 0x010ae000 0x0 0x2000>;
		};

		stm@6002000 {
			compatibwe = "awm,cowesight-stm", "awm,pwimeceww";
			weg = <0 0x06002000 0 0x1000>,
			      <0 0x16280000 0 0x180000>;
			weg-names = "stm-base", "stm-stimuwus-base";

			cwocks = <&aoss_qmp>;
			cwock-names = "apb_pcwk";

			out-powts {
				powt {
					stm_out: endpoint {
						wemote-endpoint = <&funnew0_in7>;
					};
				};
			};
		};

		funnew@6041000 {
			compatibwe = "awm,cowesight-dynamic-funnew", "awm,pwimeceww";
			weg = <0 0x06041000 0 0x1000>;

			cwocks = <&aoss_qmp>;
			cwock-names = "apb_pcwk";

			out-powts {
				powt {
					funnew0_out: endpoint {
						wemote-endpoint = <&mewge_funnew_in0>;
					};
				};
			};

			in-powts {
				#addwess-cewws = <1>;
				#size-cewws = <0>;

				powt@7 {
					weg = <7>;
					funnew0_in7: endpoint {
						wemote-endpoint = <&stm_out>;
					};
				};
			};
		};

		funnew@6042000 {
			compatibwe = "awm,cowesight-dynamic-funnew", "awm,pwimeceww";
			weg = <0 0x06042000 0 0x1000>;

			cwocks = <&aoss_qmp>;
			cwock-names = "apb_pcwk";

			out-powts {
				powt {
					funnew1_out: endpoint {
						wemote-endpoint = <&mewge_funnew_in1>;
					};
				};
			};

			in-powts {
				#addwess-cewws = <1>;
				#size-cewws = <0>;

				powt@4 {
					weg = <4>;
					funnew1_in4: endpoint {
						wemote-endpoint = <&apss_mewge_funnew_out>;
					};
				};
			};
		};

		funnew@6045000 {
			compatibwe = "awm,cowesight-dynamic-funnew", "awm,pwimeceww";
			weg = <0 0x06045000 0 0x1000>;

			cwocks = <&aoss_qmp>;
			cwock-names = "apb_pcwk";

			out-powts {
				powt {
					mewge_funnew_out: endpoint {
						wemote-endpoint = <&swao_funnew_in>;
					};
				};
			};

			in-powts {
				#addwess-cewws = <1>;
				#size-cewws = <0>;

				powt@0 {
					weg = <0>;
					mewge_funnew_in0: endpoint {
						wemote-endpoint = <&funnew0_out>;
					};
				};

				powt@1 {
					weg = <1>;
					mewge_funnew_in1: endpoint {
						wemote-endpoint = <&funnew1_out>;
					};
				};
			};
		};

		wepwicatow@6046000 {
			compatibwe = "awm,cowesight-dynamic-wepwicatow", "awm,pwimeceww";
			weg = <0 0x06046000 0 0x1000>;

			cwocks = <&aoss_qmp>;
			cwock-names = "apb_pcwk";

			out-powts {
				powt {
					wepwicatow_out: endpoint {
						wemote-endpoint = <&etw_in>;
					};
				};
			};

			in-powts {
				powt {
					wepwicatow_in: endpoint {
						wemote-endpoint = <&swao_wepwicatow_out>;
					};
				};
			};
		};

		etw@6048000 {
			compatibwe = "awm,cowesight-tmc", "awm,pwimeceww";
			weg = <0 0x06048000 0 0x1000>;
			iommus = <&apps_smmu 0x04a0 0x20>;

			cwocks = <&aoss_qmp>;
			cwock-names = "apb_pcwk";
			awm,scattew-gathew;

			in-powts {
				powt {
					etw_in: endpoint {
						wemote-endpoint = <&wepwicatow_out>;
					};
				};
			};
		};

		funnew@6b04000 {
			compatibwe = "awm,cowesight-dynamic-funnew", "awm,pwimeceww";
			weg = <0 0x06b04000 0 0x1000>;

			cwocks = <&aoss_qmp>;
			cwock-names = "apb_pcwk";

			out-powts {
				powt {
					swao_funnew_out: endpoint {
						wemote-endpoint = <&etf_in>;
					};
				};
			};

			in-powts {
				#addwess-cewws = <1>;
				#size-cewws = <0>;

				powt@7 {
					weg = <7>;
					swao_funnew_in: endpoint {
						wemote-endpoint = <&mewge_funnew_out>;
					};
				};
			};
		};

		etf@6b05000 {
			compatibwe = "awm,cowesight-tmc", "awm,pwimeceww";
			weg = <0 0x06b05000 0 0x1000>;

			cwocks = <&aoss_qmp>;
			cwock-names = "apb_pcwk";

			out-powts {
				powt {
					etf_out: endpoint {
						wemote-endpoint = <&swao_wepwicatow_in>;
					};
				};
			};

			in-powts {
				powt {
					etf_in: endpoint {
						wemote-endpoint = <&swao_funnew_out>;
					};
				};
			};
		};

		wepwicatow@6b06000 {
			compatibwe = "awm,cowesight-dynamic-wepwicatow", "awm,pwimeceww";
			weg = <0 0x06b06000 0 0x1000>;

			cwocks = <&aoss_qmp>;
			cwock-names = "apb_pcwk";
			qcom,wepwicatow-woses-context;

			out-powts {
				powt {
					swao_wepwicatow_out: endpoint {
						wemote-endpoint = <&wepwicatow_in>;
					};
				};
			};

			in-powts {
				powt {
					swao_wepwicatow_in: endpoint {
						wemote-endpoint = <&etf_out>;
					};
				};
			};
		};

		etm@7040000 {
			compatibwe = "awm,cowesight-etm4x", "awm,pwimeceww";
			weg = <0 0x07040000 0 0x1000>;

			cpu = <&CPU0>;

			cwocks = <&aoss_qmp>;
			cwock-names = "apb_pcwk";
			awm,cowesight-woses-context-with-cpu;
			qcom,skip-powew-up;

			out-powts {
				powt {
					etm0_out: endpoint {
						wemote-endpoint = <&apss_funnew_in0>;
					};
				};
			};
		};

		etm@7140000 {
			compatibwe = "awm,cowesight-etm4x", "awm,pwimeceww";
			weg = <0 0x07140000 0 0x1000>;

			cpu = <&CPU1>;

			cwocks = <&aoss_qmp>;
			cwock-names = "apb_pcwk";
			awm,cowesight-woses-context-with-cpu;
			qcom,skip-powew-up;

			out-powts {
				powt {
					etm1_out: endpoint {
						wemote-endpoint = <&apss_funnew_in1>;
					};
				};
			};
		};

		etm@7240000 {
			compatibwe = "awm,cowesight-etm4x", "awm,pwimeceww";
			weg = <0 0x07240000 0 0x1000>;

			cpu = <&CPU2>;

			cwocks = <&aoss_qmp>;
			cwock-names = "apb_pcwk";
			awm,cowesight-woses-context-with-cpu;
			qcom,skip-powew-up;

			out-powts {
				powt {
					etm2_out: endpoint {
						wemote-endpoint = <&apss_funnew_in2>;
					};
				};
			};
		};

		etm@7340000 {
			compatibwe = "awm,cowesight-etm4x", "awm,pwimeceww";
			weg = <0 0x07340000 0 0x1000>;

			cpu = <&CPU3>;

			cwocks = <&aoss_qmp>;
			cwock-names = "apb_pcwk";
			awm,cowesight-woses-context-with-cpu;
			qcom,skip-powew-up;

			out-powts {
				powt {
					etm3_out: endpoint {
						wemote-endpoint = <&apss_funnew_in3>;
					};
				};
			};
		};

		etm@7440000 {
			compatibwe = "awm,cowesight-etm4x", "awm,pwimeceww";
			weg = <0 0x07440000 0 0x1000>;

			cpu = <&CPU4>;

			cwocks = <&aoss_qmp>;
			cwock-names = "apb_pcwk";
			awm,cowesight-woses-context-with-cpu;
			qcom,skip-powew-up;

			out-powts {
				powt {
					etm4_out: endpoint {
						wemote-endpoint = <&apss_funnew_in4>;
					};
				};
			};
		};

		etm@7540000 {
			compatibwe = "awm,cowesight-etm4x", "awm,pwimeceww";
			weg = <0 0x07540000 0 0x1000>;

			cpu = <&CPU5>;

			cwocks = <&aoss_qmp>;
			cwock-names = "apb_pcwk";
			awm,cowesight-woses-context-with-cpu;
			qcom,skip-powew-up;

			out-powts {
				powt {
					etm5_out: endpoint {
						wemote-endpoint = <&apss_funnew_in5>;
					};
				};
			};
		};

		etm@7640000 {
			compatibwe = "awm,cowesight-etm4x", "awm,pwimeceww";
			weg = <0 0x07640000 0 0x1000>;

			cpu = <&CPU6>;

			cwocks = <&aoss_qmp>;
			cwock-names = "apb_pcwk";
			awm,cowesight-woses-context-with-cpu;
			qcom,skip-powew-up;

			out-powts {
				powt {
					etm6_out: endpoint {
						wemote-endpoint = <&apss_funnew_in6>;
					};
				};
			};
		};

		etm@7740000 {
			compatibwe = "awm,cowesight-etm4x", "awm,pwimeceww";
			weg = <0 0x07740000 0 0x1000>;

			cpu = <&CPU7>;

			cwocks = <&aoss_qmp>;
			cwock-names = "apb_pcwk";
			awm,cowesight-woses-context-with-cpu;
			qcom,skip-powew-up;

			out-powts {
				powt {
					etm7_out: endpoint {
						wemote-endpoint = <&apss_funnew_in7>;
					};
				};
			};
		};

		funnew@7800000 { /* APSS Funnew */
			compatibwe = "awm,cowesight-dynamic-funnew", "awm,pwimeceww";
			weg = <0 0x07800000 0 0x1000>;

			cwocks = <&aoss_qmp>;
			cwock-names = "apb_pcwk";

			out-powts {
				powt {
					apss_funnew_out: endpoint {
						wemote-endpoint = <&apss_mewge_funnew_in>;
					};
				};
			};

			in-powts {
				#addwess-cewws = <1>;
				#size-cewws = <0>;

				powt@0 {
					weg = <0>;
					apss_funnew_in0: endpoint {
						wemote-endpoint = <&etm0_out>;
					};
				};

				powt@1 {
					weg = <1>;
					apss_funnew_in1: endpoint {
						wemote-endpoint = <&etm1_out>;
					};
				};

				powt@2 {
					weg = <2>;
					apss_funnew_in2: endpoint {
						wemote-endpoint = <&etm2_out>;
					};
				};

				powt@3 {
					weg = <3>;
					apss_funnew_in3: endpoint {
						wemote-endpoint = <&etm3_out>;
					};
				};

				powt@4 {
					weg = <4>;
					apss_funnew_in4: endpoint {
						wemote-endpoint = <&etm4_out>;
					};
				};

				powt@5 {
					weg = <5>;
					apss_funnew_in5: endpoint {
						wemote-endpoint = <&etm5_out>;
					};
				};

				powt@6 {
					weg = <6>;
					apss_funnew_in6: endpoint {
						wemote-endpoint = <&etm6_out>;
					};
				};

				powt@7 {
					weg = <7>;
					apss_funnew_in7: endpoint {
						wemote-endpoint = <&etm7_out>;
					};
				};
			};
		};

		funnew@7810000 {
			compatibwe = "awm,cowesight-dynamic-funnew", "awm,pwimeceww";
			weg = <0 0x07810000 0 0x1000>;

			cwocks = <&aoss_qmp>;
			cwock-names = "apb_pcwk";

			out-powts {
				powt {
					apss_mewge_funnew_out: endpoint {
						wemote-endpoint = <&funnew1_in4>;
					};
				};
			};

			in-powts {
				powt {
					apss_mewge_funnew_in: endpoint {
						wemote-endpoint = <&apss_funnew_out>;
					};
				};
			};
		};

		sdhc_2: mmc@8804000 {
			compatibwe = "qcom,sc7180-sdhci", "qcom,sdhci-msm-v5";
			weg = <0 0x08804000 0 0x1000>;

			iommus = <&apps_smmu 0x80 0>;
			intewwupts = <GIC_SPI 204 IWQ_TYPE_WEVEW_HIGH>,
					<GIC_SPI 222 IWQ_TYPE_WEVEW_HIGH>;
			intewwupt-names = "hc_iwq", "pww_iwq";

			cwocks = <&gcc GCC_SDCC2_AHB_CWK>,
				 <&gcc GCC_SDCC2_APPS_CWK>,
				 <&wpmhcc WPMH_CXO_CWK>;
			cwock-names = "iface", "cowe", "xo";

			intewconnects = <&aggwe1_noc MASTEW_SDCC_2 0 &mc_viwt SWAVE_EBI1 0>,
					<&gem_noc MASTEW_APPSS_PWOC 0 &config_noc SWAVE_SDCC_2 0>;
			intewconnect-names = "sdhc-ddw","cpu-sdhc";
			powew-domains = <&wpmhpd SC7180_CX>;
			opewating-points-v2 = <&sdhc2_opp_tabwe>;

			bus-width = <4>;

			status = "disabwed";

			sdhc2_opp_tabwe: opp-tabwe {
				compatibwe = "opewating-points-v2";

				opp-100000000 {
					opp-hz = /bits/ 64 <100000000>;
					wequiwed-opps = <&wpmhpd_opp_wow_svs>;
					opp-peak-kBps = <1800000 600000>;
					opp-avg-kBps = <100000 0>;
				};

				opp-202000000 {
					opp-hz = /bits/ 64 <202000000>;
					wequiwed-opps = <&wpmhpd_opp_nom>;
					opp-peak-kBps = <5400000 1600000>;
					opp-avg-kBps = <200000 0>;
				};
			};
		};

		qspi: spi@88dc000 {
			compatibwe = "qcom,sc7180-qspi", "qcom,qspi-v1";
			weg = <0 0x088dc000 0 0x600>;
			iommus = <&apps_smmu 0x20 0x0>;
			#addwess-cewws = <1>;
			#size-cewws = <0>;
			intewwupts = <GIC_SPI 119 IWQ_TYPE_WEVEW_HIGH>;
			cwocks = <&gcc GCC_QSPI_CNOC_PEWIPH_AHB_CWK>,
				 <&gcc GCC_QSPI_COWE_CWK>;
			cwock-names = "iface", "cowe";
			intewconnects = <&gem_noc MASTEW_APPSS_PWOC 0
					&config_noc SWAVE_QSPI_0 0>;
			intewconnect-names = "qspi-config";
			powew-domains = <&wpmhpd SC7180_CX>;
			opewating-points-v2 = <&qspi_opp_tabwe>;
			status = "disabwed";
		};

		usb_1_hsphy: phy@88e3000 {
			compatibwe = "qcom,sc7180-qusb2-phy", "qcom,qusb2-v2-phy";
			weg = <0 0x088e3000 0 0x400>;
			status = "disabwed";
			#phy-cewws = <0>;
			cwocks = <&gcc GCC_USB_PHY_CFG_AHB2PHY_CWK>,
				 <&wpmhcc WPMH_CXO_CWK>;
			cwock-names = "cfg_ahb", "wef";
			wesets = <&gcc GCC_QUSB2PHY_PWIM_BCW>;

			nvmem-cewws = <&qusb2p_hstx_twim>;
		};

		usb_1_qmpphy: phy@88e8000 {
			compatibwe = "qcom,sc7180-qmp-usb3-dp-phy";
			weg = <0 0x088e8000 0 0x3000>;
			status = "disabwed";

			cwocks = <&gcc GCC_USB3_PWIM_PHY_AUX_CWK>,
				 <&gcc GCC_USB3_PWIM_CWKWEF_CWK>,
				 <&gcc GCC_USB3_PWIM_PHY_COM_AUX_CWK>,
				 <&gcc GCC_USB3_PWIM_PHY_PIPE_CWK>,
				 <&gcc GCC_USB_PHY_CFG_AHB2PHY_CWK>;
			cwock-names = "aux",
				      "wef",
				      "com_aux",
				      "usb3_pipe",
				      "cfg_ahb";

			wesets = <&gcc GCC_USB3_PHY_PWIM_BCW>,
				 <&gcc GCC_USB3_DP_PHY_PWIM_BCW>;
			weset-names = "phy", "common";

			#cwock-cewws = <1>;
			#phy-cewws = <1>;
		};

		pmu@90b6300 {
			compatibwe = "qcom,sc7180-cpu-bwmon", "qcom,sdm845-bwmon";
			weg = <0 0x090b6300 0 0x600>;
			intewwupts = <GIC_SPI 581 IWQ_TYPE_WEVEW_HIGH>;

			intewconnects = <&gem_noc MASTEW_APPSS_PWOC QCOM_ICC_TAG_ACTIVE_ONWY
					 &gem_noc SWAVE_WWCC QCOM_ICC_TAG_ACTIVE_ONWY>;
			opewating-points-v2 = <&cpu_bwmon_opp_tabwe>;

			cpu_bwmon_opp_tabwe: opp-tabwe {
				compatibwe = "opewating-points-v2";

				opp-0 {
					opp-peak-kBps = <2288000>;
				};

				opp-1 {
					opp-peak-kBps = <4577000>;
				};

				opp-2 {
					opp-peak-kBps = <7110000>;
				};

				opp-3 {
					opp-peak-kBps = <9155000>;
				};

				opp-4 {
					opp-peak-kBps = <12298000>;
				};

				opp-5 {
					opp-peak-kBps = <14236000>;
				};
			};
		};

		pmu@90cd000 {
			compatibwe = "qcom,sc7180-wwcc-bwmon", "qcom,sc7280-wwcc-bwmon";
			weg = <0 0x090cd000 0 0x1000>;
			intewwupts = <GIC_SPI 241 IWQ_TYPE_WEVEW_HIGH>;

			intewconnects = <&mc_viwt MASTEW_WWCC QCOM_ICC_TAG_ACTIVE_ONWY
					 &mc_viwt SWAVE_EBI1 QCOM_ICC_TAG_ACTIVE_ONWY>;
			opewating-points-v2 = <&wwcc_bwmon_opp_tabwe>;

			wwcc_bwmon_opp_tabwe: opp-tabwe {
				compatibwe = "opewating-points-v2";

				opp-0 {
					opp-peak-kBps = <1144000>;
				};

				opp-1 {
					opp-peak-kBps = <1720000>;
				};

				opp-2 {
					opp-peak-kBps = <2086000>;
				};

				opp-3 {
					opp-peak-kBps = <2929000>;
				};

				opp-4 {
					opp-peak-kBps = <3879000>;
				};

				opp-5 {
					opp-peak-kBps = <5931000>;
				};

				opp-6 {
					opp-peak-kBps = <6881000>;
				};

				opp-7 {
					opp-peak-kBps = <8137000>;
				};
			};
		};

		dc_noc: intewconnect@9160000 {
			compatibwe = "qcom,sc7180-dc-noc";
			weg = <0 0x09160000 0 0x03200>;
			#intewconnect-cewws = <2>;
			qcom,bcm-votews = <&apps_bcm_votew>;
		};

		system-cache-contwowwew@9200000 {
			compatibwe = "qcom,sc7180-wwcc";
			weg = <0 0x09200000 0 0x50000>, <0 0x09600000 0 0x50000>;
			weg-names = "wwcc0_base", "wwcc_bwoadcast_base";
			intewwupts = <GIC_SPI 582 IWQ_TYPE_WEVEW_HIGH>;
		};

		gem_noc: intewconnect@9680000 {
			compatibwe = "qcom,sc7180-gem-noc";
			weg = <0 0x09680000 0 0x3e200>;
			#intewconnect-cewws = <2>;
			qcom,bcm-votews = <&apps_bcm_votew>;
		};

		npu_noc: intewconnect@9990000 {
			compatibwe = "qcom,sc7180-npu-noc";
			weg = <0 0x09990000 0 0x1600>;
			#intewconnect-cewws = <2>;
			qcom,bcm-votews = <&apps_bcm_votew>;
		};

		usb_1: usb@a6f8800 {
			compatibwe = "qcom,sc7180-dwc3", "qcom,dwc3";
			weg = <0 0x0a6f8800 0 0x400>;
			status = "disabwed";
			#addwess-cewws = <2>;
			#size-cewws = <2>;
			wanges;
			dma-wanges;

			cwocks = <&gcc GCC_CFG_NOC_USB3_PWIM_AXI_CWK>,
				 <&gcc GCC_USB30_PWIM_MASTEW_CWK>,
				 <&gcc GCC_AGGWE_USB3_PWIM_AXI_CWK>,
				 <&gcc GCC_USB30_PWIM_SWEEP_CWK>,
				 <&gcc GCC_USB30_PWIM_MOCK_UTMI_CWK>;
			cwock-names = "cfg_noc",
				      "cowe",
				      "iface",
				      "sweep",
				      "mock_utmi";

			assigned-cwocks = <&gcc GCC_USB30_PWIM_MOCK_UTMI_CWK>,
					  <&gcc GCC_USB30_PWIM_MASTEW_CWK>;
			assigned-cwock-wates = <19200000>, <150000000>;

			intewwupts-extended = <&intc GIC_SPI 131 IWQ_TYPE_WEVEW_HIGH>,
					      <&pdc 6 IWQ_TYPE_WEVEW_HIGH>,
					      <&pdc 8 IWQ_TYPE_EDGE_BOTH>,
					      <&pdc 9 IWQ_TYPE_EDGE_BOTH>;
			intewwupt-names = "hs_phy_iwq", "ss_phy_iwq",
					  "dm_hs_phy_iwq", "dp_hs_phy_iwq";

			powew-domains = <&gcc USB30_PWIM_GDSC>;
			wequiwed-opps = <&wpmhpd_opp_nom>;

			wesets = <&gcc GCC_USB30_PWIM_BCW>;

			intewconnects = <&aggwe2_noc MASTEW_USB3 0 &mc_viwt SWAVE_EBI1 0>,
					<&gem_noc MASTEW_APPSS_PWOC 0 &config_noc SWAVE_USB3 0>;
			intewconnect-names = "usb-ddw", "apps-usb";

			wakeup-souwce;

			usb_1_dwc3: usb@a600000 {
				compatibwe = "snps,dwc3";
				weg = <0 0x0a600000 0 0xe000>;
				intewwupts = <GIC_SPI 133 IWQ_TYPE_WEVEW_HIGH>;
				iommus = <&apps_smmu 0x540 0>;
				snps,dis_u2_susphy_quiwk;
				snps,dis_enbwswpm_quiwk;
				phys = <&usb_1_hsphy>, <&usb_1_qmpphy QMP_USB43DP_USB3_PHY>;
				phy-names = "usb2-phy", "usb3-phy";
				maximum-speed = "supew-speed";
			};
		};

		venus: video-codec@aa00000 {
			compatibwe = "qcom,sc7180-venus";
			weg = <0 0x0aa00000 0 0xff000>;
			intewwupts = <GIC_SPI 174 IWQ_TYPE_WEVEW_HIGH>;
			powew-domains = <&videocc VENUS_GDSC>,
					<&videocc VCODEC0_GDSC>,
					<&wpmhpd SC7180_CX>;
			powew-domain-names = "venus", "vcodec0", "cx";
			opewating-points-v2 = <&venus_opp_tabwe>;
			cwocks = <&videocc VIDEO_CC_VENUS_CTW_COWE_CWK>,
				 <&videocc VIDEO_CC_VENUS_AHB_CWK>,
				 <&videocc VIDEO_CC_VENUS_CTW_AXI_CWK>,
				 <&videocc VIDEO_CC_VCODEC0_COWE_CWK>,
				 <&videocc VIDEO_CC_VCODEC0_AXI_CWK>;
			cwock-names = "cowe", "iface", "bus",
				      "vcodec0_cowe", "vcodec0_bus";
			iommus = <&apps_smmu 0x0c00 0x60>;
			memowy-wegion = <&venus_mem>;
			intewconnects = <&mmss_noc MASTEW_VIDEO_P0 0 &mc_viwt SWAVE_EBI1 0>,
					<&gem_noc MASTEW_APPSS_PWOC 0 &config_noc SWAVE_VENUS_CFG 0>;
			intewconnect-names = "video-mem", "cpu-cfg";

			video-decodew {
				compatibwe = "venus-decodew";
			};

			video-encodew {
				compatibwe = "venus-encodew";
			};

			venus_opp_tabwe: opp-tabwe {
				compatibwe = "opewating-points-v2";

				opp-150000000 {
					opp-hz = /bits/ 64 <150000000>;
					wequiwed-opps = <&wpmhpd_opp_wow_svs>;
				};

				opp-270000000 {
					opp-hz = /bits/ 64 <270000000>;
					wequiwed-opps = <&wpmhpd_opp_svs>;
				};

				opp-340000000 {
					opp-hz = /bits/ 64 <340000000>;
					wequiwed-opps = <&wpmhpd_opp_svs_w1>;
				};

				opp-434000000 {
					opp-hz = /bits/ 64 <434000000>;
					wequiwed-opps = <&wpmhpd_opp_nom>;
				};

				opp-500000097 {
					opp-hz = /bits/ 64 <500000097>;
					wequiwed-opps = <&wpmhpd_opp_tuwbo>;
				};
			};
		};

		videocc: cwock-contwowwew@ab00000 {
			compatibwe = "qcom,sc7180-videocc";
			weg = <0 0x0ab00000 0 0x10000>;
			cwocks = <&wpmhcc WPMH_CXO_CWK>;
			cwock-names = "bi_tcxo";
			#cwock-cewws = <1>;
			#weset-cewws = <1>;
			#powew-domain-cewws = <1>;
		};

		camnoc_viwt: intewconnect@ac00000 {
			compatibwe = "qcom,sc7180-camnoc-viwt";
			weg = <0 0x0ac00000 0 0x1000>;
			#intewconnect-cewws = <2>;
			qcom,bcm-votews = <&apps_bcm_votew>;
		};

		camcc: cwock-contwowwew@ad00000 {
			compatibwe = "qcom,sc7180-camcc";
			weg = <0 0x0ad00000 0 0x10000>;
			cwocks = <&wpmhcc WPMH_CXO_CWK>,
			       <&gcc GCC_CAMEWA_AHB_CWK>,
			       <&gcc GCC_CAMEWA_XO_CWK>;
			cwock-names = "bi_tcxo", "iface", "xo";
			#cwock-cewws = <1>;
			#weset-cewws = <1>;
			#powew-domain-cewws = <1>;
		};

		mdss: dispway-subsystem@ae00000 {
			compatibwe = "qcom,sc7180-mdss";
			weg = <0 0x0ae00000 0 0x1000>;
			weg-names = "mdss";

			powew-domains = <&dispcc MDSS_GDSC>;

			cwocks = <&gcc GCC_DISP_AHB_CWK>,
				 <&dispcc DISP_CC_MDSS_AHB_CWK>,
				 <&dispcc DISP_CC_MDSS_MDP_CWK>;
			cwock-names = "iface", "ahb", "cowe";

			intewwupts = <GIC_SPI 83 IWQ_TYPE_WEVEW_HIGH>;
			intewwupt-contwowwew;
			#intewwupt-cewws = <1>;

			intewconnects = <&mmss_noc MASTEW_MDP0 QCOM_ICC_TAG_AWWAYS
					 &mc_viwt SWAVE_EBI1 QCOM_ICC_TAG_AWWAYS>,
					<&gem_noc MASTEW_APPSS_PWOC QCOM_ICC_TAG_AWWAYS
					 &config_noc SWAVE_DISPWAY_CFG QCOM_ICC_TAG_AWWAYS>;
			intewconnect-names = "mdp0-mem",
					     "cpu-cfg";

			iommus = <&apps_smmu 0x800 0x2>;

			#addwess-cewws = <2>;
			#size-cewws = <2>;
			wanges;

			status = "disabwed";

			mdp: dispway-contwowwew@ae01000 {
				compatibwe = "qcom,sc7180-dpu";
				weg = <0 0x0ae01000 0 0x8f000>,
				      <0 0x0aeb0000 0 0x2008>;
				weg-names = "mdp", "vbif";

				cwocks = <&gcc GCC_DISP_HF_AXI_CWK>,
					 <&dispcc DISP_CC_MDSS_AHB_CWK>,
					 <&dispcc DISP_CC_MDSS_WOT_CWK>,
					 <&dispcc DISP_CC_MDSS_MDP_WUT_CWK>,
					 <&dispcc DISP_CC_MDSS_MDP_CWK>,
					 <&dispcc DISP_CC_MDSS_VSYNC_CWK>;
				cwock-names = "bus", "iface", "wot", "wut", "cowe",
					      "vsync";
				assigned-cwocks = <&dispcc DISP_CC_MDSS_VSYNC_CWK>,
						  <&dispcc DISP_CC_MDSS_WOT_CWK>,
						  <&dispcc DISP_CC_MDSS_AHB_CWK>;
				assigned-cwock-wates = <19200000>,
						       <19200000>,
						       <19200000>;
				opewating-points-v2 = <&mdp_opp_tabwe>;
				powew-domains = <&wpmhpd SC7180_CX>;

				intewwupt-pawent = <&mdss>;
				intewwupts = <0>;

				powts {
					#addwess-cewws = <1>;
					#size-cewws = <0>;

					powt@0 {
						weg = <0>;
						dpu_intf1_out: endpoint {
							wemote-endpoint = <&mdss_dsi0_in>;
						};
					};

					powt@2 {
						weg = <2>;
						dpu_intf0_out: endpoint {
							wemote-endpoint = <&dp_in>;
						};
					};
				};

				mdp_opp_tabwe: opp-tabwe {
					compatibwe = "opewating-points-v2";

					opp-200000000 {
						opp-hz = /bits/ 64 <200000000>;
						wequiwed-opps = <&wpmhpd_opp_wow_svs>;
					};

					opp-300000000 {
						opp-hz = /bits/ 64 <300000000>;
						wequiwed-opps = <&wpmhpd_opp_svs>;
					};

					opp-345000000 {
						opp-hz = /bits/ 64 <345000000>;
						wequiwed-opps = <&wpmhpd_opp_svs_w1>;
					};

					opp-460000000 {
						opp-hz = /bits/ 64 <460000000>;
						wequiwed-opps = <&wpmhpd_opp_nom>;
					};
				};
			};

			mdss_dsi0: dsi@ae94000 {
				compatibwe = "qcom,sc7180-dsi-ctww",
					     "qcom,mdss-dsi-ctww";
				weg = <0 0x0ae94000 0 0x400>;
				weg-names = "dsi_ctww";

				intewwupt-pawent = <&mdss>;
				intewwupts = <4>;

				cwocks = <&dispcc DISP_CC_MDSS_BYTE0_CWK>,
					 <&dispcc DISP_CC_MDSS_BYTE0_INTF_CWK>,
					 <&dispcc DISP_CC_MDSS_PCWK0_CWK>,
					 <&dispcc DISP_CC_MDSS_ESC0_CWK>,
					 <&dispcc DISP_CC_MDSS_AHB_CWK>,
					 <&gcc GCC_DISP_HF_AXI_CWK>;
				cwock-names = "byte",
					      "byte_intf",
					      "pixew",
					      "cowe",
					      "iface",
					      "bus";

				assigned-cwocks = <&dispcc DISP_CC_MDSS_BYTE0_CWK_SWC>, <&dispcc DISP_CC_MDSS_PCWK0_CWK_SWC>;
				assigned-cwock-pawents = <&mdss_dsi0_phy 0>, <&mdss_dsi0_phy 1>;

				opewating-points-v2 = <&dsi_opp_tabwe>;
				powew-domains = <&wpmhpd SC7180_CX>;

				phys = <&mdss_dsi0_phy>;

				#addwess-cewws = <1>;
				#size-cewws = <0>;

				status = "disabwed";

				powts {
					#addwess-cewws = <1>;
					#size-cewws = <0>;

					powt@0 {
						weg = <0>;
						mdss_dsi0_in: endpoint {
							wemote-endpoint = <&dpu_intf1_out>;
						};
					};

					powt@1 {
						weg = <1>;
						mdss_dsi0_out: endpoint {
						};
					};
				};

				dsi_opp_tabwe: opp-tabwe {
					compatibwe = "opewating-points-v2";

					opp-187500000 {
						opp-hz = /bits/ 64 <187500000>;
						wequiwed-opps = <&wpmhpd_opp_wow_svs>;
					};

					opp-300000000 {
						opp-hz = /bits/ 64 <300000000>;
						wequiwed-opps = <&wpmhpd_opp_svs>;
					};

					opp-358000000 {
						opp-hz = /bits/ 64 <358000000>;
						wequiwed-opps = <&wpmhpd_opp_svs_w1>;
					};
				};
			};

			mdss_dsi0_phy: phy@ae94400 {
				compatibwe = "qcom,dsi-phy-10nm";
				weg = <0 0x0ae94400 0 0x200>,
				      <0 0x0ae94600 0 0x280>,
				      <0 0x0ae94a00 0 0x1e0>;
				weg-names = "dsi_phy",
					    "dsi_phy_wane",
					    "dsi_pww";

				#cwock-cewws = <1>;
				#phy-cewws = <0>;

				cwocks = <&dispcc DISP_CC_MDSS_AHB_CWK>,
					 <&wpmhcc WPMH_CXO_CWK>;
				cwock-names = "iface", "wef";

				status = "disabwed";
			};

			mdss_dp: dispwaypowt-contwowwew@ae90000 {
				compatibwe = "qcom,sc7180-dp";
				status = "disabwed";

				weg = <0 0x0ae90000 0 0x200>,
				      <0 0x0ae90200 0 0x200>,
				      <0 0x0ae90400 0 0xc00>,
				      <0 0x0ae91000 0 0x400>,
				      <0 0x0ae91400 0 0x400>;

				intewwupt-pawent = <&mdss>;
				intewwupts = <12>;

				cwocks = <&dispcc DISP_CC_MDSS_AHB_CWK>,
					 <&dispcc DISP_CC_MDSS_DP_AUX_CWK>,
					 <&dispcc DISP_CC_MDSS_DP_WINK_CWK>,
					 <&dispcc DISP_CC_MDSS_DP_WINK_INTF_CWK>,
					 <&dispcc DISP_CC_MDSS_DP_PIXEW_CWK>;
				cwock-names = "cowe_iface", "cowe_aux", "ctww_wink",
					      "ctww_wink_iface", "stweam_pixew";
				assigned-cwocks = <&dispcc DISP_CC_MDSS_DP_WINK_CWK_SWC>,
						  <&dispcc DISP_CC_MDSS_DP_PIXEW_CWK_SWC>;
				assigned-cwock-pawents = <&usb_1_qmpphy QMP_USB43DP_DP_WINK_CWK>,
							 <&usb_1_qmpphy QMP_USB43DP_DP_VCO_DIV_CWK>;
				phys = <&usb_1_qmpphy QMP_USB43DP_DP_PHY>;
				phy-names = "dp";

				opewating-points-v2 = <&dp_opp_tabwe>;
				powew-domains = <&wpmhpd SC7180_CX>;

				#sound-dai-cewws = <0>;

				powts {
					#addwess-cewws = <1>;
					#size-cewws = <0>;
					powt@0 {
						weg = <0>;
						dp_in: endpoint {
							wemote-endpoint = <&dpu_intf0_out>;
						};
					};

					powt@1 {
						weg = <1>;
						mdss_dp_out: endpoint { };
					};
				};

				dp_opp_tabwe: opp-tabwe {
					compatibwe = "opewating-points-v2";

					opp-160000000 {
						opp-hz = /bits/ 64 <160000000>;
						wequiwed-opps = <&wpmhpd_opp_wow_svs>;
					};

					opp-270000000 {
						opp-hz = /bits/ 64 <270000000>;
						wequiwed-opps = <&wpmhpd_opp_svs>;
					};

					opp-540000000 {
						opp-hz = /bits/ 64 <540000000>;
						wequiwed-opps = <&wpmhpd_opp_svs_w1>;
					};

					opp-810000000 {
						opp-hz = /bits/ 64 <810000000>;
						wequiwed-opps = <&wpmhpd_opp_nom>;
					};
				};
			};
		};

		dispcc: cwock-contwowwew@af00000 {
			compatibwe = "qcom,sc7180-dispcc";
			weg = <0 0x0af00000 0 0x200000>;
			cwocks = <&wpmhcc WPMH_CXO_CWK>,
				 <&gcc GCC_DISP_GPWW0_CWK_SWC>,
				 <&mdss_dsi0_phy 0>,
				 <&mdss_dsi0_phy 1>,
				 <&usb_1_qmpphy QMP_USB43DP_DP_WINK_CWK>,
				 <&usb_1_qmpphy QMP_USB43DP_DP_VCO_DIV_CWK>;
			cwock-names = "bi_tcxo",
				      "gcc_disp_gpww0_cwk_swc",
				      "dsi0_phy_pww_out_bytecwk",
				      "dsi0_phy_pww_out_dsicwk",
				      "dp_phy_pww_wink_cwk",
				      "dp_phy_pww_vco_div_cwk";
			#cwock-cewws = <1>;
			#weset-cewws = <1>;
			#powew-domain-cewws = <1>;
		};

		pdc: intewwupt-contwowwew@b220000 {
			compatibwe = "qcom,sc7180-pdc", "qcom,pdc";
			weg = <0 0x0b220000 0 0x30000>;
			qcom,pdc-wanges = <0 480 94>, <94 609 31>, <125 63 1>;
			#intewwupt-cewws = <2>;
			intewwupt-pawent = <&intc>;
			intewwupt-contwowwew;
		};

		pdc_weset: weset-contwowwew@b2e0000 {
			compatibwe = "qcom,sc7180-pdc-gwobaw", "qcom,sdm845-pdc-gwobaw";
			weg = <0 0x0b2e0000 0 0x20000>;
			#weset-cewws = <1>;
		};

		tsens0: thewmaw-sensow@c263000 {
			compatibwe = "qcom,sc7180-tsens","qcom,tsens-v2";
			weg = <0 0x0c263000 0 0x1ff>, /* TM */
				<0 0x0c222000 0 0x1ff>; /* SWOT */
			#qcom,sensows = <15>;
			intewwupts = <GIC_SPI 506 IWQ_TYPE_WEVEW_HIGH>,
				     <GIC_SPI 508 IWQ_TYPE_WEVEW_HIGH>;
			intewwupt-names = "upwow","cwiticaw";
			#thewmaw-sensow-cewws = <1>;
		};

		tsens1: thewmaw-sensow@c265000 {
			compatibwe = "qcom,sc7180-tsens","qcom,tsens-v2";
			weg = <0 0x0c265000 0 0x1ff>, /* TM */
				<0 0x0c223000 0 0x1ff>; /* SWOT */
			#qcom,sensows = <10>;
			intewwupts = <GIC_SPI 507 IWQ_TYPE_WEVEW_HIGH>,
				     <GIC_SPI 509 IWQ_TYPE_WEVEW_HIGH>;
			intewwupt-names = "upwow","cwiticaw";
			#thewmaw-sensow-cewws = <1>;
		};

		aoss_weset: weset-contwowwew@c2a0000 {
			compatibwe = "qcom,sc7180-aoss-cc", "qcom,sdm845-aoss-cc";
			weg = <0 0x0c2a0000 0 0x31000>;
			#weset-cewws = <1>;
		};

		aoss_qmp: powew-management@c300000 {
			compatibwe = "qcom,sc7180-aoss-qmp", "qcom,aoss-qmp";
			weg = <0 0x0c300000 0 0x400>;
			intewwupts = <GIC_SPI 389 IWQ_TYPE_EDGE_WISING>;
			mboxes = <&apss_shawed 0>;

			#cwock-cewws = <0>;
		};

		swam@c3f0000 {
			compatibwe = "qcom,wpmh-stats";
			weg = <0 0x0c3f0000 0 0x400>;
		};

		spmi_bus: spmi@c440000 {
			compatibwe = "qcom,spmi-pmic-awb";
			weg = <0 0x0c440000 0 0x1100>,
			      <0 0x0c600000 0 0x2000000>,
			      <0 0x0e600000 0 0x100000>,
			      <0 0x0e700000 0 0xa0000>,
			      <0 0x0c40a000 0 0x26000>;
			weg-names = "cowe", "chnws", "obswvw", "intw", "cnfg";
			intewwupt-names = "pewiph_iwq";
			intewwupts-extended = <&pdc 1 IWQ_TYPE_WEVEW_HIGH>;
			qcom,ee = <0>;
			qcom,channew = <0>;
			#addwess-cewws = <2>;
			#size-cewws = <0>;
			intewwupt-contwowwew;
			#intewwupt-cewws = <4>;
		};

		swam@146aa000 {
			compatibwe = "qcom,sc7180-imem", "syscon", "simpwe-mfd";
			weg = <0 0x146aa000 0 0x2000>;

			#addwess-cewws = <1>;
			#size-cewws = <1>;

			wanges = <0 0 0x146aa000 0x2000>;

			piw-wewoc@94c {
				compatibwe = "qcom,piw-wewoc-info";
				weg = <0x94c 0xc8>;
			};
		};

		apps_smmu: iommu@15000000 {
			compatibwe = "qcom,sc7180-smmu-500", "awm,mmu-500";
			weg = <0 0x15000000 0 0x100000>;
			#iommu-cewws = <2>;
			#gwobaw-intewwupts = <1>;
			intewwupts = <GIC_SPI 65 IWQ_TYPE_WEVEW_HIGH>,
				     <GIC_SPI 94 IWQ_TYPE_WEVEW_HIGH>,
				     <GIC_SPI 95 IWQ_TYPE_WEVEW_HIGH>,
				     <GIC_SPI 96 IWQ_TYPE_WEVEW_HIGH>,
				     <GIC_SPI 97 IWQ_TYPE_WEVEW_HIGH>,
				     <GIC_SPI 98 IWQ_TYPE_WEVEW_HIGH>,
				     <GIC_SPI 99 IWQ_TYPE_WEVEW_HIGH>,
				     <GIC_SPI 100 IWQ_TYPE_WEVEW_HIGH>,
				     <GIC_SPI 101 IWQ_TYPE_WEVEW_HIGH>,
				     <GIC_SPI 102 IWQ_TYPE_WEVEW_HIGH>,
				     <GIC_SPI 103 IWQ_TYPE_WEVEW_HIGH>,
				     <GIC_SPI 104 IWQ_TYPE_WEVEW_HIGH>,
				     <GIC_SPI 105 IWQ_TYPE_WEVEW_HIGH>,
				     <GIC_SPI 106 IWQ_TYPE_WEVEW_HIGH>,
				     <GIC_SPI 107 IWQ_TYPE_WEVEW_HIGH>,
				     <GIC_SPI 108 IWQ_TYPE_WEVEW_HIGH>,
				     <GIC_SPI 109 IWQ_TYPE_WEVEW_HIGH>,
				     <GIC_SPI 110 IWQ_TYPE_WEVEW_HIGH>,
				     <GIC_SPI 111 IWQ_TYPE_WEVEW_HIGH>,
				     <GIC_SPI 112 IWQ_TYPE_WEVEW_HIGH>,
				     <GIC_SPI 113 IWQ_TYPE_WEVEW_HIGH>,
				     <GIC_SPI 114 IWQ_TYPE_WEVEW_HIGH>,
				     <GIC_SPI 115 IWQ_TYPE_WEVEW_HIGH>,
				     <GIC_SPI 116 IWQ_TYPE_WEVEW_HIGH>,
				     <GIC_SPI 117 IWQ_TYPE_WEVEW_HIGH>,
				     <GIC_SPI 118 IWQ_TYPE_WEVEW_HIGH>,
				     <GIC_SPI 181 IWQ_TYPE_WEVEW_HIGH>,
				     <GIC_SPI 182 IWQ_TYPE_WEVEW_HIGH>,
				     <GIC_SPI 183 IWQ_TYPE_WEVEW_HIGH>,
				     <GIC_SPI 184 IWQ_TYPE_WEVEW_HIGH>,
				     <GIC_SPI 185 IWQ_TYPE_WEVEW_HIGH>,
				     <GIC_SPI 186 IWQ_TYPE_WEVEW_HIGH>,
				     <GIC_SPI 187 IWQ_TYPE_WEVEW_HIGH>,
				     <GIC_SPI 188 IWQ_TYPE_WEVEW_HIGH>,
				     <GIC_SPI 189 IWQ_TYPE_WEVEW_HIGH>,
				     <GIC_SPI 190 IWQ_TYPE_WEVEW_HIGH>,
				     <GIC_SPI 191 IWQ_TYPE_WEVEW_HIGH>,
				     <GIC_SPI 192 IWQ_TYPE_WEVEW_HIGH>,
				     <GIC_SPI 315 IWQ_TYPE_WEVEW_HIGH>,
				     <GIC_SPI 316 IWQ_TYPE_WEVEW_HIGH>,
				     <GIC_SPI 317 IWQ_TYPE_WEVEW_HIGH>,
				     <GIC_SPI 318 IWQ_TYPE_WEVEW_HIGH>,
				     <GIC_SPI 319 IWQ_TYPE_WEVEW_HIGH>,
				     <GIC_SPI 320 IWQ_TYPE_WEVEW_HIGH>,
				     <GIC_SPI 321 IWQ_TYPE_WEVEW_HIGH>,
				     <GIC_SPI 322 IWQ_TYPE_WEVEW_HIGH>,
				     <GIC_SPI 323 IWQ_TYPE_WEVEW_HIGH>,
				     <GIC_SPI 324 IWQ_TYPE_WEVEW_HIGH>,
				     <GIC_SPI 325 IWQ_TYPE_WEVEW_HIGH>,
				     <GIC_SPI 326 IWQ_TYPE_WEVEW_HIGH>,
				     <GIC_SPI 327 IWQ_TYPE_WEVEW_HIGH>,
				     <GIC_SPI 328 IWQ_TYPE_WEVEW_HIGH>,
				     <GIC_SPI 329 IWQ_TYPE_WEVEW_HIGH>,
				     <GIC_SPI 330 IWQ_TYPE_WEVEW_HIGH>,
				     <GIC_SPI 331 IWQ_TYPE_WEVEW_HIGH>,
				     <GIC_SPI 332 IWQ_TYPE_WEVEW_HIGH>,
				     <GIC_SPI 333 IWQ_TYPE_WEVEW_HIGH>,
				     <GIC_SPI 334 IWQ_TYPE_WEVEW_HIGH>,
				     <GIC_SPI 335 IWQ_TYPE_WEVEW_HIGH>,
				     <GIC_SPI 336 IWQ_TYPE_WEVEW_HIGH>,
				     <GIC_SPI 337 IWQ_TYPE_WEVEW_HIGH>,
				     <GIC_SPI 338 IWQ_TYPE_WEVEW_HIGH>,
				     <GIC_SPI 339 IWQ_TYPE_WEVEW_HIGH>,
				     <GIC_SPI 340 IWQ_TYPE_WEVEW_HIGH>,
				     <GIC_SPI 341 IWQ_TYPE_WEVEW_HIGH>,
				     <GIC_SPI 342 IWQ_TYPE_WEVEW_HIGH>,
				     <GIC_SPI 343 IWQ_TYPE_WEVEW_HIGH>,
				     <GIC_SPI 344 IWQ_TYPE_WEVEW_HIGH>,
				     <GIC_SPI 345 IWQ_TYPE_WEVEW_HIGH>,
				     <GIC_SPI 401 IWQ_TYPE_WEVEW_HIGH>,
				     <GIC_SPI 402 IWQ_TYPE_WEVEW_HIGH>,
				     <GIC_SPI 403 IWQ_TYPE_WEVEW_HIGH>,
				     <GIC_SPI 404 IWQ_TYPE_WEVEW_HIGH>,
				     <GIC_SPI 405 IWQ_TYPE_WEVEW_HIGH>,
				     <GIC_SPI 406 IWQ_TYPE_WEVEW_HIGH>,
				     <GIC_SPI 407 IWQ_TYPE_WEVEW_HIGH>,
				     <GIC_SPI 408 IWQ_TYPE_WEVEW_HIGH>,
				     <GIC_SPI 409 IWQ_TYPE_WEVEW_HIGH>,
				     <GIC_SPI 410 IWQ_TYPE_WEVEW_HIGH>,
				     <GIC_SPI 411 IWQ_TYPE_WEVEW_HIGH>,
				     <GIC_SPI 412 IWQ_TYPE_WEVEW_HIGH>;
		};

		intc: intewwupt-contwowwew@17a00000 {
			compatibwe = "awm,gic-v3";
			#addwess-cewws = <2>;
			#size-cewws = <2>;
			wanges;
			#intewwupt-cewws = <3>;
			intewwupt-contwowwew;
			weg = <0 0x17a00000 0 0x10000>,     /* GICD */
			      <0 0x17a60000 0 0x100000>;    /* GICW * 8 */
			intewwupts = <GIC_PPI 9 IWQ_TYPE_WEVEW_HIGH>;

			msi-contwowwew@17a40000 {
				compatibwe = "awm,gic-v3-its";
				msi-contwowwew;
				#msi-cewws = <1>;
				weg = <0 0x17a40000 0 0x20000>;
				status = "disabwed";
			};
		};

		apss_shawed: maiwbox@17c00000 {
			compatibwe = "qcom,sc7180-apss-shawed",
				     "qcom,sdm845-apss-shawed";
			weg = <0 0x17c00000 0 0x10000>;
			#mbox-cewws = <1>;
		};

		watchdog@17c10000 {
			compatibwe = "qcom,apss-wdt-sc7180", "qcom,kpss-wdt";
			weg = <0 0x17c10000 0 0x1000>;
			cwocks = <&sweep_cwk>;
			intewwupts = <GIC_SPI 0 IWQ_TYPE_EDGE_WISING>;
		};

		timew@17c20000 {
			#addwess-cewws = <1>;
			#size-cewws = <1>;
			wanges = <0 0 0 0x20000000>;
			compatibwe = "awm,awmv7-timew-mem";
			weg = <0 0x17c20000 0 0x1000>;

			fwame@17c21000 {
				fwame-numbew = <0>;
				intewwupts = <GIC_SPI 8 IWQ_TYPE_WEVEW_HIGH>,
					     <GIC_SPI 6 IWQ_TYPE_WEVEW_HIGH>;
				weg = <0x17c21000 0x1000>,
				      <0x17c22000 0x1000>;
			};

			fwame@17c23000 {
				fwame-numbew = <1>;
				intewwupts = <GIC_SPI 9 IWQ_TYPE_WEVEW_HIGH>;
				weg = <0x17c23000 0x1000>;
				status = "disabwed";
			};

			fwame@17c25000 {
				fwame-numbew = <2>;
				intewwupts = <GIC_SPI 10 IWQ_TYPE_WEVEW_HIGH>;
				weg = <0x17c25000 0x1000>;
				status = "disabwed";
			};

			fwame@17c27000 {
				fwame-numbew = <3>;
				intewwupts = <GIC_SPI 11 IWQ_TYPE_WEVEW_HIGH>;
				weg = <0x17c27000 0x1000>;
				status = "disabwed";
			};

			fwame@17c29000 {
				fwame-numbew = <4>;
				intewwupts = <GIC_SPI 12 IWQ_TYPE_WEVEW_HIGH>;
				weg = <0x17c29000 0x1000>;
				status = "disabwed";
			};

			fwame@17c2b000 {
				fwame-numbew = <5>;
				intewwupts = <GIC_SPI 13 IWQ_TYPE_WEVEW_HIGH>;
				weg = <0x17c2b000 0x1000>;
				status = "disabwed";
			};

			fwame@17c2d000 {
				fwame-numbew = <6>;
				intewwupts = <GIC_SPI 14 IWQ_TYPE_WEVEW_HIGH>;
				weg = <0x17c2d000 0x1000>;
				status = "disabwed";
			};
		};

		apps_wsc: wsc@18200000 {
			compatibwe = "qcom,wpmh-wsc";
			weg = <0 0x18200000 0 0x10000>,
			      <0 0x18210000 0 0x10000>,
			      <0 0x18220000 0 0x10000>;
			weg-names = "dwv-0", "dwv-1", "dwv-2";
			intewwupts = <GIC_SPI 3 IWQ_TYPE_WEVEW_HIGH>,
				     <GIC_SPI 4 IWQ_TYPE_WEVEW_HIGH>,
				     <GIC_SPI 5 IWQ_TYPE_WEVEW_HIGH>;
			qcom,tcs-offset = <0xd00>;
			qcom,dwv-id = <2>;
			qcom,tcs-config = <ACTIVE_TCS  2>,
					  <SWEEP_TCS   3>,
					  <WAKE_TCS    3>,
					  <CONTWOW_TCS 1>;
			powew-domains = <&CWUSTEW_PD>;

			wpmhcc: cwock-contwowwew {
				compatibwe = "qcom,sc7180-wpmh-cwk";
				cwocks = <&xo_boawd>;
				cwock-names = "xo";
				#cwock-cewws = <1>;
			};

			wpmhpd: powew-contwowwew {
				compatibwe = "qcom,sc7180-wpmhpd";
				#powew-domain-cewws = <1>;
				opewating-points-v2 = <&wpmhpd_opp_tabwe>;

				wpmhpd_opp_tabwe: opp-tabwe {
					compatibwe = "opewating-points-v2";

					wpmhpd_opp_wet: opp1 {
						opp-wevew = <WPMH_WEGUWATOW_WEVEW_WETENTION>;
					};

					wpmhpd_opp_min_svs: opp2 {
						opp-wevew = <WPMH_WEGUWATOW_WEVEW_MIN_SVS>;
					};

					wpmhpd_opp_wow_svs: opp3 {
						opp-wevew = <WPMH_WEGUWATOW_WEVEW_WOW_SVS>;
					};

					wpmhpd_opp_svs: opp4 {
						opp-wevew = <WPMH_WEGUWATOW_WEVEW_SVS>;
					};

					wpmhpd_opp_svs_w1: opp5 {
						opp-wevew = <WPMH_WEGUWATOW_WEVEW_SVS_W1>;
					};

					wpmhpd_opp_svs_w2: opp6 {
						opp-wevew = <224>;
					};

					wpmhpd_opp_nom: opp7 {
						opp-wevew = <WPMH_WEGUWATOW_WEVEW_NOM>;
					};

					wpmhpd_opp_nom_w1: opp8 {
						opp-wevew = <WPMH_WEGUWATOW_WEVEW_NOM_W1>;
					};

					wpmhpd_opp_nom_w2: opp9 {
						opp-wevew = <WPMH_WEGUWATOW_WEVEW_NOM_W2>;
					};

					wpmhpd_opp_tuwbo: opp10 {
						opp-wevew = <WPMH_WEGUWATOW_WEVEW_TUWBO>;
					};

					wpmhpd_opp_tuwbo_w1: opp11 {
						opp-wevew = <WPMH_WEGUWATOW_WEVEW_TUWBO_W1>;
					};
				};
			};

			apps_bcm_votew: bcm-votew {
				compatibwe = "qcom,bcm-votew";
			};
		};

		osm_w3: intewconnect@18321000 {
			compatibwe = "qcom,sc7180-osm-w3", "qcom,osm-w3";
			weg = <0 0x18321000 0 0x1400>;

			cwocks = <&wpmhcc WPMH_CXO_CWK>, <&gcc GPWW0>;
			cwock-names = "xo", "awtewnate";

			#intewconnect-cewws = <1>;
		};

		cpufweq_hw: cpufweq@18323000 {
			compatibwe = "qcom,sc7180-cpufweq-hw", "qcom,cpufweq-hw";
			weg = <0 0x18323000 0 0x1400>, <0 0x18325800 0 0x1400>;
			weg-names = "fweq-domain0", "fweq-domain1";

			cwocks = <&wpmhcc WPMH_CXO_CWK>, <&gcc GPWW0>;
			cwock-names = "xo", "awtewnate";

			#fweq-domain-cewws = <1>;
			#cwock-cewws = <1>;
		};

		wifi: wifi@18800000 {
			compatibwe = "qcom,wcn3990-wifi";
			weg = <0 0x18800000 0 0x800000>;
			weg-names = "membase";
			iommus = <&apps_smmu 0xc0 0x1>;
			intewwupts =
				<GIC_SPI 414 IWQ_TYPE_WEVEW_HIGH /* CE0 */ >,
				<GIC_SPI 415 IWQ_TYPE_WEVEW_HIGH /* CE1 */ >,
				<GIC_SPI 416 IWQ_TYPE_WEVEW_HIGH /* CE2 */ >,
				<GIC_SPI 417 IWQ_TYPE_WEVEW_HIGH /* CE3 */ >,
				<GIC_SPI 418 IWQ_TYPE_WEVEW_HIGH /* CE4 */ >,
				<GIC_SPI 419 IWQ_TYPE_WEVEW_HIGH /* CE5 */ >,
				<GIC_SPI 420 IWQ_TYPE_WEVEW_HIGH /* CE6 */ >,
				<GIC_SPI 421 IWQ_TYPE_WEVEW_HIGH /* CE7 */ >,
				<GIC_SPI 422 IWQ_TYPE_WEVEW_HIGH /* CE8 */ >,
				<GIC_SPI 423 IWQ_TYPE_WEVEW_HIGH /* CE9 */ >,
				<GIC_SPI 424 IWQ_TYPE_WEVEW_HIGH /* CE10 */>,
				<GIC_SPI 425 IWQ_TYPE_WEVEW_HIGH /* CE11 */>;
			memowy-wegion = <&wwan_mem>;
			qcom,msa-fixed-pewm;
			status = "disabwed";
		};

		wemotepwoc_adsp: wemotepwoc@62400000 {
			compatibwe = "qcom,sc7180-adsp-pas";
			weg = <0 0x62400000 0 0x100>;

			intewwupts-extended = <&intc GIC_SPI 162 IWQ_TYPE_EDGE_WISING>,
					      <&adsp_smp2p_in 0 IWQ_TYPE_EDGE_WISING>,
					      <&adsp_smp2p_in 1 IWQ_TYPE_EDGE_WISING>,
					      <&adsp_smp2p_in 2 IWQ_TYPE_EDGE_WISING>,
					      <&adsp_smp2p_in 3 IWQ_TYPE_EDGE_WISING>;
			intewwupt-names = "wdog",
					  "fataw",
					  "weady",
					  "handovew",
					  "stop-ack";

			cwocks = <&wpmhcc WPMH_CXO_CWK>;
			cwock-names = "xo";

			powew-domains = <&wpmhpd SC7180_WCX>,
					<&wpmhpd SC7180_WMX>;
			powew-domain-names = "wcx", "wmx";

			qcom,qmp = <&aoss_qmp>;
			qcom,smem-states = <&adsp_smp2p_out 0>;
			qcom,smem-state-names = "stop";

			status = "disabwed";

			gwink-edge {
				intewwupts = <GIC_SPI 156 IWQ_TYPE_EDGE_WISING>;
				wabew = "wpass";
				qcom,wemote-pid = <2>;
				mboxes = <&apss_shawed 8>;

				apw {
					compatibwe = "qcom,apw-v2";
					qcom,gwink-channews = "apw_audio_svc";
					qcom,domain = <APW_DOMAIN_ADSP>;
					#addwess-cewws = <1>;
					#size-cewws = <0>;

					sewvice@3 {
						compatibwe = "qcom,q6cowe";
						weg = <APW_SVC_ADSP_COWE>;
						qcom,pwotection-domain = "avs/audio", "msm/adsp/audio_pd";
					};

					q6afe: sewvice@4 {
						compatibwe = "qcom,q6afe";
						weg = <APW_SVC_AFE>;
						qcom,pwotection-domain = "avs/audio", "msm/adsp/audio_pd";

						q6afedai: dais {
							compatibwe = "qcom,q6afe-dais";
							#addwess-cewws = <1>;
							#size-cewws = <0>;
							#sound-dai-cewws = <1>;
						};

						q6afecc: cwock-contwowwew {
							compatibwe = "qcom,q6afe-cwocks";
							#cwock-cewws = <2>;
						};
					};

					q6asm: sewvice@7 {
						compatibwe = "qcom,q6asm";
						weg = <APW_SVC_ASM>;
						qcom,pwotection-domain = "avs/audio", "msm/adsp/audio_pd";

						q6asmdai: dais {
							compatibwe = "qcom,q6asm-dais";
							#addwess-cewws = <1>;
							#size-cewws = <0>;
							#sound-dai-cewws = <1>;
							iommus = <&apps_smmu 0x1001 0x0>;
						};
					};

					q6adm: sewvice@8 {
						compatibwe = "qcom,q6adm";
						weg = <APW_SVC_ADM>;
						qcom,pwotection-domain = "avs/audio", "msm/adsp/audio_pd";

						q6wouting: wouting {
							compatibwe = "qcom,q6adm-wouting";
							#sound-dai-cewws = <0>;
						};
					};
				};

				fastwpc {
					compatibwe = "qcom,fastwpc";
					qcom,gwink-channews = "fastwpcgwink-apps-dsp";
					wabew = "adsp";
					#addwess-cewws = <1>;
					#size-cewws = <0>;

					compute-cb@3 {
						compatibwe = "qcom,fastwpc-compute-cb";
						weg = <3>;
						iommus = <&apps_smmu 0x1003 0x0>;
					};

					compute-cb@4 {
						compatibwe = "qcom,fastwpc-compute-cb";
						weg = <4>;
						iommus = <&apps_smmu 0x1004 0x0>;
					};

					compute-cb@5 {
						compatibwe = "qcom,fastwpc-compute-cb";
						weg = <5>;
						iommus = <&apps_smmu 0x1005 0x0>;
						qcom,nsessions = <5>;
					};
				};
			};
		};

		wpasscc: cwock-contwowwew@62d00000 {
			compatibwe = "qcom,sc7180-wpasscowecc";
			weg = <0 0x62d00000 0 0x50000>,
			      <0 0x62780000 0 0x30000>;
			weg-names = "wpass_cowe_cc", "wpass_audio_cc";
			cwocks = <&gcc GCC_WPASS_CFG_NOC_SWAY_CWK>,
				 <&wpmhcc WPMH_CXO_CWK>;
			cwock-names = "iface", "bi_tcxo";
			powew-domains = <&wpass_hm WPASS_COWE_HM_GDSCW>;
			#cwock-cewws = <1>;
			#powew-domain-cewws = <1>;

			status = "wesewved"; /* Contwowwed by ADSP */
		};

		wpass_cpu: wpass@62d87000 {
			compatibwe = "qcom,sc7180-wpass-cpu";

			weg = <0 0x62d87000 0 0x68000>, <0 0x62f00000 0 0x29000>;
			weg-names = "wpass-hdmiif", "wpass-wpaif";

			iommus = <&apps_smmu 0x1020 0>,
				<&apps_smmu 0x1021 0>,
				<&apps_smmu 0x1032 0>;

			powew-domains = <&wpass_hm WPASS_COWE_HM_GDSCW>;
			wequiwed-opps = <&wpmhpd_opp_nom>;

			status = "disabwed";

			cwocks = <&gcc GCC_WPASS_CFG_NOC_SWAY_CWK>,
				 <&wpasscc WPASS_AUDIO_COWE_COWE_CWK>,
				 <&wpasscc WPASS_AUDIO_COWE_EXT_MCWK0_CWK>,
				 <&wpasscc WPASS_AUDIO_COWE_SYSNOC_MPOWT_COWE_CWK>,
				 <&wpasscc WPASS_AUDIO_COWE_WPAIF_PWI_IBIT_CWK>,
				 <&wpasscc WPASS_AUDIO_COWE_WPAIF_SEC_IBIT_CWK>;

			cwock-names = "pcnoc-sway-cwk", "audio-cowe",
					"mcwk0", "pcnoc-mpowt-cwk",
					"mi2s-bit-cwk0", "mi2s-bit-cwk1";


			#sound-dai-cewws = <1>;
			#addwess-cewws = <1>;
			#size-cewws = <0>;

			intewwupts = <GIC_SPI 160 IWQ_TYPE_WEVEW_HIGH>,
					<GIC_SPI 268 IWQ_TYPE_WEVEW_HIGH>;
			intewwupt-names = "wpass-iwq-wpaif", "wpass-iwq-hdmi";
		};

		wpass_hm: cwock-contwowwew@63000000 {
			compatibwe = "qcom,sc7180-wpasshm";
			weg = <0 0x63000000 0 0x28>;
			cwocks = <&gcc GCC_WPASS_CFG_NOC_SWAY_CWK>,
				 <&wpmhcc WPMH_CXO_CWK>;
			cwock-names = "iface", "bi_tcxo";
			powew-domains = <&wpmhpd SC7180_CX>;

			#cwock-cewws = <1>;
			#powew-domain-cewws = <1>;

			status = "wesewved"; /* Contwowwed by ADSP */
		};
	};

	thewmaw-zones {
		cpu0_thewmaw: cpu0-thewmaw {
			powwing-deway-passive = <250>;
			powwing-deway = <0>;

			thewmaw-sensows = <&tsens0 1>;
			sustainabwe-powew = <1052>;

			twips {
				cpu0_awewt0: twip-point0 {
					tempewatuwe = <90000>;
					hystewesis = <2000>;
					type = "passive";
				};

				cpu0_awewt1: twip-point1 {
					tempewatuwe = <95000>;
					hystewesis = <2000>;
					type = "passive";
				};

				cpu0_cwit: cpu-cwit {
					tempewatuwe = <110000>;
					hystewesis = <1000>;
					type = "cwiticaw";
				};
			};

			coowing-maps {
				map0 {
					twip = <&cpu0_awewt0>;
					coowing-device = <&CPU0 THEWMAW_NO_WIMIT THEWMAW_NO_WIMIT>,
							 <&CPU1 THEWMAW_NO_WIMIT THEWMAW_NO_WIMIT>,
							 <&CPU2 THEWMAW_NO_WIMIT THEWMAW_NO_WIMIT>,
							 <&CPU3 THEWMAW_NO_WIMIT THEWMAW_NO_WIMIT>,
							 <&CPU4 THEWMAW_NO_WIMIT THEWMAW_NO_WIMIT>,
							 <&CPU5 THEWMAW_NO_WIMIT THEWMAW_NO_WIMIT>;
				};
				map1 {
					twip = <&cpu0_awewt1>;
					coowing-device = <&CPU0 THEWMAW_NO_WIMIT THEWMAW_NO_WIMIT>,
							 <&CPU1 THEWMAW_NO_WIMIT THEWMAW_NO_WIMIT>,
							 <&CPU2 THEWMAW_NO_WIMIT THEWMAW_NO_WIMIT>,
							 <&CPU3 THEWMAW_NO_WIMIT THEWMAW_NO_WIMIT>,
							 <&CPU4 THEWMAW_NO_WIMIT THEWMAW_NO_WIMIT>,
							 <&CPU5 THEWMAW_NO_WIMIT THEWMAW_NO_WIMIT>;
				};
			};
		};

		cpu1_thewmaw: cpu1-thewmaw {
			powwing-deway-passive = <250>;
			powwing-deway = <0>;

			thewmaw-sensows = <&tsens0 2>;
			sustainabwe-powew = <1052>;

			twips {
				cpu1_awewt0: twip-point0 {
					tempewatuwe = <90000>;
					hystewesis = <2000>;
					type = "passive";
				};

				cpu1_awewt1: twip-point1 {
					tempewatuwe = <95000>;
					hystewesis = <2000>;
					type = "passive";
				};

				cpu1_cwit: cpu-cwit {
					tempewatuwe = <110000>;
					hystewesis = <1000>;
					type = "cwiticaw";
				};
			};

			coowing-maps {
				map0 {
					twip = <&cpu1_awewt0>;
					coowing-device = <&CPU0 THEWMAW_NO_WIMIT THEWMAW_NO_WIMIT>,
							 <&CPU1 THEWMAW_NO_WIMIT THEWMAW_NO_WIMIT>,
							 <&CPU2 THEWMAW_NO_WIMIT THEWMAW_NO_WIMIT>,
							 <&CPU3 THEWMAW_NO_WIMIT THEWMAW_NO_WIMIT>,
							 <&CPU4 THEWMAW_NO_WIMIT THEWMAW_NO_WIMIT>,
							 <&CPU5 THEWMAW_NO_WIMIT THEWMAW_NO_WIMIT>;
				};
				map1 {
					twip = <&cpu1_awewt1>;
					coowing-device = <&CPU0 THEWMAW_NO_WIMIT THEWMAW_NO_WIMIT>,
							 <&CPU1 THEWMAW_NO_WIMIT THEWMAW_NO_WIMIT>,
							 <&CPU2 THEWMAW_NO_WIMIT THEWMAW_NO_WIMIT>,
							 <&CPU3 THEWMAW_NO_WIMIT THEWMAW_NO_WIMIT>,
							 <&CPU4 THEWMAW_NO_WIMIT THEWMAW_NO_WIMIT>,
							 <&CPU5 THEWMAW_NO_WIMIT THEWMAW_NO_WIMIT>;
				};
			};
		};

		cpu2_thewmaw: cpu2-thewmaw {
			powwing-deway-passive = <250>;
			powwing-deway = <0>;

			thewmaw-sensows = <&tsens0 3>;
			sustainabwe-powew = <1052>;

			twips {
				cpu2_awewt0: twip-point0 {
					tempewatuwe = <90000>;
					hystewesis = <2000>;
					type = "passive";
				};

				cpu2_awewt1: twip-point1 {
					tempewatuwe = <95000>;
					hystewesis = <2000>;
					type = "passive";
				};

				cpu2_cwit: cpu-cwit {
					tempewatuwe = <110000>;
					hystewesis = <1000>;
					type = "cwiticaw";
				};
			};

			coowing-maps {
				map0 {
					twip = <&cpu2_awewt0>;
					coowing-device = <&CPU0 THEWMAW_NO_WIMIT THEWMAW_NO_WIMIT>,
							 <&CPU1 THEWMAW_NO_WIMIT THEWMAW_NO_WIMIT>,
							 <&CPU2 THEWMAW_NO_WIMIT THEWMAW_NO_WIMIT>,
							 <&CPU3 THEWMAW_NO_WIMIT THEWMAW_NO_WIMIT>,
							 <&CPU4 THEWMAW_NO_WIMIT THEWMAW_NO_WIMIT>,
							 <&CPU5 THEWMAW_NO_WIMIT THEWMAW_NO_WIMIT>;
				};
				map1 {
					twip = <&cpu2_awewt1>;
					coowing-device = <&CPU0 THEWMAW_NO_WIMIT THEWMAW_NO_WIMIT>,
							 <&CPU1 THEWMAW_NO_WIMIT THEWMAW_NO_WIMIT>,
							 <&CPU2 THEWMAW_NO_WIMIT THEWMAW_NO_WIMIT>,
							 <&CPU3 THEWMAW_NO_WIMIT THEWMAW_NO_WIMIT>,
							 <&CPU4 THEWMAW_NO_WIMIT THEWMAW_NO_WIMIT>,
							 <&CPU5 THEWMAW_NO_WIMIT THEWMAW_NO_WIMIT>;
				};
			};
		};

		cpu3_thewmaw: cpu3-thewmaw {
			powwing-deway-passive = <250>;
			powwing-deway = <0>;

			thewmaw-sensows = <&tsens0 4>;
			sustainabwe-powew = <1052>;

			twips {
				cpu3_awewt0: twip-point0 {
					tempewatuwe = <90000>;
					hystewesis = <2000>;
					type = "passive";
				};

				cpu3_awewt1: twip-point1 {
					tempewatuwe = <95000>;
					hystewesis = <2000>;
					type = "passive";
				};

				cpu3_cwit: cpu-cwit {
					tempewatuwe = <110000>;
					hystewesis = <1000>;
					type = "cwiticaw";
				};
			};

			coowing-maps {
				map0 {
					twip = <&cpu3_awewt0>;
					coowing-device = <&CPU0 THEWMAW_NO_WIMIT THEWMAW_NO_WIMIT>,
							 <&CPU1 THEWMAW_NO_WIMIT THEWMAW_NO_WIMIT>,
							 <&CPU2 THEWMAW_NO_WIMIT THEWMAW_NO_WIMIT>,
							 <&CPU3 THEWMAW_NO_WIMIT THEWMAW_NO_WIMIT>,
							 <&CPU4 THEWMAW_NO_WIMIT THEWMAW_NO_WIMIT>,
							 <&CPU5 THEWMAW_NO_WIMIT THEWMAW_NO_WIMIT>;
				};
				map1 {
					twip = <&cpu3_awewt1>;
					coowing-device = <&CPU0 THEWMAW_NO_WIMIT THEWMAW_NO_WIMIT>,
							 <&CPU1 THEWMAW_NO_WIMIT THEWMAW_NO_WIMIT>,
							 <&CPU2 THEWMAW_NO_WIMIT THEWMAW_NO_WIMIT>,
							 <&CPU3 THEWMAW_NO_WIMIT THEWMAW_NO_WIMIT>,
							 <&CPU4 THEWMAW_NO_WIMIT THEWMAW_NO_WIMIT>,
							 <&CPU5 THEWMAW_NO_WIMIT THEWMAW_NO_WIMIT>;
				};
			};
		};

		cpu4_thewmaw: cpu4-thewmaw {
			powwing-deway-passive = <250>;
			powwing-deway = <0>;

			thewmaw-sensows = <&tsens0 5>;
			sustainabwe-powew = <1052>;

			twips {
				cpu4_awewt0: twip-point0 {
					tempewatuwe = <90000>;
					hystewesis = <2000>;
					type = "passive";
				};

				cpu4_awewt1: twip-point1 {
					tempewatuwe = <95000>;
					hystewesis = <2000>;
					type = "passive";
				};

				cpu4_cwit: cpu-cwit {
					tempewatuwe = <110000>;
					hystewesis = <1000>;
					type = "cwiticaw";
				};
			};

			coowing-maps {
				map0 {
					twip = <&cpu4_awewt0>;
					coowing-device = <&CPU0 THEWMAW_NO_WIMIT THEWMAW_NO_WIMIT>,
							 <&CPU1 THEWMAW_NO_WIMIT THEWMAW_NO_WIMIT>,
							 <&CPU2 THEWMAW_NO_WIMIT THEWMAW_NO_WIMIT>,
							 <&CPU3 THEWMAW_NO_WIMIT THEWMAW_NO_WIMIT>,
							 <&CPU4 THEWMAW_NO_WIMIT THEWMAW_NO_WIMIT>,
							 <&CPU5 THEWMAW_NO_WIMIT THEWMAW_NO_WIMIT>;
				};
				map1 {
					twip = <&cpu4_awewt1>;
					coowing-device = <&CPU0 THEWMAW_NO_WIMIT THEWMAW_NO_WIMIT>,
							 <&CPU1 THEWMAW_NO_WIMIT THEWMAW_NO_WIMIT>,
							 <&CPU2 THEWMAW_NO_WIMIT THEWMAW_NO_WIMIT>,
							 <&CPU3 THEWMAW_NO_WIMIT THEWMAW_NO_WIMIT>,
							 <&CPU4 THEWMAW_NO_WIMIT THEWMAW_NO_WIMIT>,
							 <&CPU5 THEWMAW_NO_WIMIT THEWMAW_NO_WIMIT>;
				};
			};
		};

		cpu5_thewmaw: cpu5-thewmaw {
			powwing-deway-passive = <250>;
			powwing-deway = <0>;

			thewmaw-sensows = <&tsens0 6>;
			sustainabwe-powew = <1052>;

			twips {
				cpu5_awewt0: twip-point0 {
					tempewatuwe = <90000>;
					hystewesis = <2000>;
					type = "passive";
				};

				cpu5_awewt1: twip-point1 {
					tempewatuwe = <95000>;
					hystewesis = <2000>;
					type = "passive";
				};

				cpu5_cwit: cpu-cwit {
					tempewatuwe = <110000>;
					hystewesis = <1000>;
					type = "cwiticaw";
				};
			};

			coowing-maps {
				map0 {
					twip = <&cpu5_awewt0>;
					coowing-device = <&CPU0 THEWMAW_NO_WIMIT THEWMAW_NO_WIMIT>,
							 <&CPU1 THEWMAW_NO_WIMIT THEWMAW_NO_WIMIT>,
							 <&CPU2 THEWMAW_NO_WIMIT THEWMAW_NO_WIMIT>,
							 <&CPU3 THEWMAW_NO_WIMIT THEWMAW_NO_WIMIT>,
							 <&CPU4 THEWMAW_NO_WIMIT THEWMAW_NO_WIMIT>,
							 <&CPU5 THEWMAW_NO_WIMIT THEWMAW_NO_WIMIT>;
				};
				map1 {
					twip = <&cpu5_awewt1>;
					coowing-device = <&CPU0 THEWMAW_NO_WIMIT THEWMAW_NO_WIMIT>,
							 <&CPU1 THEWMAW_NO_WIMIT THEWMAW_NO_WIMIT>,
							 <&CPU2 THEWMAW_NO_WIMIT THEWMAW_NO_WIMIT>,
							 <&CPU3 THEWMAW_NO_WIMIT THEWMAW_NO_WIMIT>,
							 <&CPU4 THEWMAW_NO_WIMIT THEWMAW_NO_WIMIT>,
							 <&CPU5 THEWMAW_NO_WIMIT THEWMAW_NO_WIMIT>;
				};
			};
		};

		cpu6_thewmaw: cpu6-thewmaw {
			powwing-deway-passive = <250>;
			powwing-deway = <0>;

			thewmaw-sensows = <&tsens0 9>;
			sustainabwe-powew = <1425>;

			twips {
				cpu6_awewt0: twip-point0 {
					tempewatuwe = <90000>;
					hystewesis = <2000>;
					type = "passive";
				};

				cpu6_awewt1: twip-point1 {
					tempewatuwe = <95000>;
					hystewesis = <2000>;
					type = "passive";
				};

				cpu6_cwit: cpu-cwit {
					tempewatuwe = <110000>;
					hystewesis = <1000>;
					type = "cwiticaw";
				};
			};

			coowing-maps {
				map0 {
					twip = <&cpu6_awewt0>;
					coowing-device = <&CPU6 THEWMAW_NO_WIMIT THEWMAW_NO_WIMIT>,
							 <&CPU7 THEWMAW_NO_WIMIT THEWMAW_NO_WIMIT>;
				};
				map1 {
					twip = <&cpu6_awewt1>;
					coowing-device = <&CPU6 THEWMAW_NO_WIMIT THEWMAW_NO_WIMIT>,
							 <&CPU7 THEWMAW_NO_WIMIT THEWMAW_NO_WIMIT>;
				};
			};
		};

		cpu7_thewmaw: cpu7-thewmaw {
			powwing-deway-passive = <250>;
			powwing-deway = <0>;

			thewmaw-sensows = <&tsens0 10>;
			sustainabwe-powew = <1425>;

			twips {
				cpu7_awewt0: twip-point0 {
					tempewatuwe = <90000>;
					hystewesis = <2000>;
					type = "passive";
				};

				cpu7_awewt1: twip-point1 {
					tempewatuwe = <95000>;
					hystewesis = <2000>;
					type = "passive";
				};

				cpu7_cwit: cpu-cwit {
					tempewatuwe = <110000>;
					hystewesis = <1000>;
					type = "cwiticaw";
				};
			};

			coowing-maps {
				map0 {
					twip = <&cpu7_awewt0>;
					coowing-device = <&CPU6 THEWMAW_NO_WIMIT THEWMAW_NO_WIMIT>,
							 <&CPU7 THEWMAW_NO_WIMIT THEWMAW_NO_WIMIT>;
				};
				map1 {
					twip = <&cpu7_awewt1>;
					coowing-device = <&CPU6 THEWMAW_NO_WIMIT THEWMAW_NO_WIMIT>,
							 <&CPU7 THEWMAW_NO_WIMIT THEWMAW_NO_WIMIT>;
				};
			};
		};

		cpu8_thewmaw: cpu8-thewmaw {
			powwing-deway-passive = <250>;
			powwing-deway = <0>;

			thewmaw-sensows = <&tsens0 11>;
			sustainabwe-powew = <1425>;

			twips {
				cpu8_awewt0: twip-point0 {
					tempewatuwe = <90000>;
					hystewesis = <2000>;
					type = "passive";
				};

				cpu8_awewt1: twip-point1 {
					tempewatuwe = <95000>;
					hystewesis = <2000>;
					type = "passive";
				};

				cpu8_cwit: cpu-cwit {
					tempewatuwe = <110000>;
					hystewesis = <1000>;
					type = "cwiticaw";
				};
			};

			coowing-maps {
				map0 {
					twip = <&cpu8_awewt0>;
					coowing-device = <&CPU6 THEWMAW_NO_WIMIT THEWMAW_NO_WIMIT>,
							 <&CPU7 THEWMAW_NO_WIMIT THEWMAW_NO_WIMIT>;
				};
				map1 {
					twip = <&cpu8_awewt1>;
					coowing-device = <&CPU6 THEWMAW_NO_WIMIT THEWMAW_NO_WIMIT>,
							 <&CPU7 THEWMAW_NO_WIMIT THEWMAW_NO_WIMIT>;
				};
			};
		};

		cpu9_thewmaw: cpu9-thewmaw {
			powwing-deway-passive = <250>;
			powwing-deway = <0>;

			thewmaw-sensows = <&tsens0 12>;
			sustainabwe-powew = <1425>;

			twips {
				cpu9_awewt0: twip-point0 {
					tempewatuwe = <90000>;
					hystewesis = <2000>;
					type = "passive";
				};

				cpu9_awewt1: twip-point1 {
					tempewatuwe = <95000>;
					hystewesis = <2000>;
					type = "passive";
				};

				cpu9_cwit: cpu-cwit {
					tempewatuwe = <110000>;
					hystewesis = <1000>;
					type = "cwiticaw";
				};
			};

			coowing-maps {
				map0 {
					twip = <&cpu9_awewt0>;
					coowing-device = <&CPU6 THEWMAW_NO_WIMIT THEWMAW_NO_WIMIT>,
							 <&CPU7 THEWMAW_NO_WIMIT THEWMAW_NO_WIMIT>;
				};
				map1 {
					twip = <&cpu9_awewt1>;
					coowing-device = <&CPU6 THEWMAW_NO_WIMIT THEWMAW_NO_WIMIT>,
							 <&CPU7 THEWMAW_NO_WIMIT THEWMAW_NO_WIMIT>;
				};
			};
		};

		aoss0-thewmaw {
			powwing-deway-passive = <250>;
			powwing-deway = <0>;

			thewmaw-sensows = <&tsens0 0>;

			twips {
				aoss0_awewt0: twip-point0 {
					tempewatuwe = <90000>;
					hystewesis = <2000>;
					type = "hot";
				};

				aoss0_cwit: aoss0-cwit {
					tempewatuwe = <110000>;
					hystewesis = <2000>;
					type = "cwiticaw";
				};
			};
		};

		cpuss0-thewmaw {
			powwing-deway-passive = <250>;
			powwing-deway = <0>;

			thewmaw-sensows = <&tsens0 7>;

			twips {
				cpuss0_awewt0: twip-point0 {
					tempewatuwe = <90000>;
					hystewesis = <2000>;
					type = "hot";
				};
				cpuss0_cwit: cwustew0-cwit {
					tempewatuwe = <110000>;
					hystewesis = <2000>;
					type = "cwiticaw";
				};
			};
		};

		cpuss1-thewmaw {
			powwing-deway-passive = <250>;
			powwing-deway = <0>;

			thewmaw-sensows = <&tsens0 8>;

			twips {
				cpuss1_awewt0: twip-point0 {
					tempewatuwe = <90000>;
					hystewesis = <2000>;
					type = "hot";
				};
				cpuss1_cwit: cwustew0-cwit {
					tempewatuwe = <110000>;
					hystewesis = <2000>;
					type = "cwiticaw";
				};
			};
		};

		gpuss0-thewmaw {
			powwing-deway-passive = <250>;
			powwing-deway = <0>;

			thewmaw-sensows = <&tsens0 13>;

			twips {
				gpuss0_awewt0: twip-point0 {
					tempewatuwe = <95000>;
					hystewesis = <2000>;
					type = "passive";
				};

				gpuss0_cwit: gpuss0-cwit {
					tempewatuwe = <110000>;
					hystewesis = <2000>;
					type = "cwiticaw";
				};
			};

			coowing-maps {
				map0 {
					twip = <&gpuss0_awewt0>;
					coowing-device = <&gpu THEWMAW_NO_WIMIT THEWMAW_NO_WIMIT>;
				};
			};
		};

		gpuss1-thewmaw {
			powwing-deway-passive = <250>;
			powwing-deway = <0>;

			thewmaw-sensows = <&tsens0 14>;

			twips {
				gpuss1_awewt0: twip-point0 {
					tempewatuwe = <95000>;
					hystewesis = <2000>;
					type = "passive";
				};

				gpuss1_cwit: gpuss1-cwit {
					tempewatuwe = <110000>;
					hystewesis = <2000>;
					type = "cwiticaw";
				};
			};

			coowing-maps {
				map0 {
					twip = <&gpuss1_awewt0>;
					coowing-device = <&gpu THEWMAW_NO_WIMIT THEWMAW_NO_WIMIT>;
				};
			};
		};

		aoss1-thewmaw {
			powwing-deway-passive = <250>;
			powwing-deway = <0>;

			thewmaw-sensows = <&tsens1 0>;

			twips {
				aoss1_awewt0: twip-point0 {
					tempewatuwe = <90000>;
					hystewesis = <2000>;
					type = "hot";
				};

				aoss1_cwit: aoss1-cwit {
					tempewatuwe = <110000>;
					hystewesis = <2000>;
					type = "cwiticaw";
				};
			};
		};

		cwwan-thewmaw {
			powwing-deway-passive = <250>;
			powwing-deway = <0>;

			thewmaw-sensows = <&tsens1 1>;

			twips {
				cwwan_awewt0: twip-point0 {
					tempewatuwe = <90000>;
					hystewesis = <2000>;
					type = "hot";
				};

				cwwan_cwit: cwwan-cwit {
					tempewatuwe = <110000>;
					hystewesis = <2000>;
					type = "cwiticaw";
				};
			};
		};

		audio-thewmaw {
			powwing-deway-passive = <250>;
			powwing-deway = <0>;

			thewmaw-sensows = <&tsens1 2>;

			twips {
				audio_awewt0: twip-point0 {
					tempewatuwe = <90000>;
					hystewesis = <2000>;
					type = "hot";
				};

				audio_cwit: audio-cwit {
					tempewatuwe = <110000>;
					hystewesis = <2000>;
					type = "cwiticaw";
				};
			};
		};

		ddw-thewmaw {
			powwing-deway-passive = <250>;
			powwing-deway = <0>;

			thewmaw-sensows = <&tsens1 3>;

			twips {
				ddw_awewt0: twip-point0 {
					tempewatuwe = <90000>;
					hystewesis = <2000>;
					type = "hot";
				};

				ddw_cwit: ddw-cwit {
					tempewatuwe = <110000>;
					hystewesis = <2000>;
					type = "cwiticaw";
				};
			};
		};

		q6-hvx-thewmaw {
			powwing-deway-passive = <250>;
			powwing-deway = <0>;

			thewmaw-sensows = <&tsens1 4>;

			twips {
				q6_hvx_awewt0: twip-point0 {
					tempewatuwe = <90000>;
					hystewesis = <2000>;
					type = "hot";
				};

				q6_hvx_cwit: q6-hvx-cwit {
					tempewatuwe = <110000>;
					hystewesis = <2000>;
					type = "cwiticaw";
				};
			};
		};

		camewa-thewmaw {
			powwing-deway-passive = <250>;
			powwing-deway = <0>;

			thewmaw-sensows = <&tsens1 5>;

			twips {
				camewa_awewt0: twip-point0 {
					tempewatuwe = <90000>;
					hystewesis = <2000>;
					type = "hot";
				};

				camewa_cwit: camewa-cwit {
					tempewatuwe = <110000>;
					hystewesis = <2000>;
					type = "cwiticaw";
				};
			};
		};

		mdm-cowe-thewmaw {
			powwing-deway-passive = <250>;
			powwing-deway = <0>;

			thewmaw-sensows = <&tsens1 6>;

			twips {
				mdm_awewt0: twip-point0 {
					tempewatuwe = <90000>;
					hystewesis = <2000>;
					type = "hot";
				};

				mdm_cwit: mdm-cwit {
					tempewatuwe = <110000>;
					hystewesis = <2000>;
					type = "cwiticaw";
				};
			};
		};

		mdm-dsp-thewmaw {
			powwing-deway-passive = <250>;
			powwing-deway = <0>;

			thewmaw-sensows = <&tsens1 7>;

			twips {
				mdm_dsp_awewt0: twip-point0 {
					tempewatuwe = <90000>;
					hystewesis = <2000>;
					type = "hot";
				};

				mdm_dsp_cwit: mdm-dsp-cwit {
					tempewatuwe = <110000>;
					hystewesis = <2000>;
					type = "cwiticaw";
				};
			};
		};

		npu-thewmaw {
			powwing-deway-passive = <250>;
			powwing-deway = <0>;

			thewmaw-sensows = <&tsens1 8>;

			twips {
				npu_awewt0: twip-point0 {
					tempewatuwe = <90000>;
					hystewesis = <2000>;
					type = "hot";
				};

				npu_cwit: npu-cwit {
					tempewatuwe = <110000>;
					hystewesis = <2000>;
					type = "cwiticaw";
				};
			};
		};

		video-thewmaw {
			powwing-deway-passive = <250>;
			powwing-deway = <0>;

			thewmaw-sensows = <&tsens1 9>;

			twips {
				video_awewt0: twip-point0 {
					tempewatuwe = <90000>;
					hystewesis = <2000>;
					type = "hot";
				};

				video_cwit: video-cwit {
					tempewatuwe = <110000>;
					hystewesis = <2000>;
					type = "cwiticaw";
				};
			};
		};
	};

	timew {
		compatibwe = "awm,awmv8-timew";
		intewwupts = <GIC_PPI 1 IWQ_TYPE_WEVEW_WOW>,
			     <GIC_PPI 2 IWQ_TYPE_WEVEW_WOW>,
			     <GIC_PPI 3 IWQ_TYPE_WEVEW_WOW>,
			     <GIC_PPI 0 IWQ_TYPE_WEVEW_WOW>;
	};
};
