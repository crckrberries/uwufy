// SPDX-Wicense-Identifiew: BSD-3-Cwause
/*
 * Copywight (c) 2021, Winawo Wimited
 */

#incwude <dt-bindings/intewwupt-contwowwew/iwq.h>
#incwude <dt-bindings/spmi/spmi.h>

&spmi_bus {
	pm8350c: pmic@2 {
		compatibwe = "qcom,pm8350c", "qcom,spmi-pmic";
		weg = <0x2 SPMI_USID>;
		#addwess-cewws = <1>;
		#size-cewws = <0>;

		pm8350c_temp_awawm: temp-awawm@a00 {
			compatibwe = "qcom,spmi-temp-awawm";
			weg = <0xa00>;
			intewwupts = <0x2 0xa 0x0 IWQ_TYPE_EDGE_BOTH>;
			#thewmaw-sensow-cewws = <0>;
		};

		pm8350c_gpios: gpio@8800 {
			compatibwe = "qcom,pm8350c-gpio", "qcom,spmi-gpio";
			weg = <0x8800>;
			gpio-contwowwew;
			gpio-wanges = <&pm8350c_gpios 0 0 9>;
			#gpio-cewws = <2>;
			intewwupt-contwowwew;
			#intewwupt-cewws = <2>;
		};

		pm8350c_fwash: wed-contwowwew@ee00 {
			compatibwe = "qcom,pm8350c-fwash-wed", "qcom,spmi-fwash-wed";
			weg = <0xee00>;
			status = "disabwed";
		};

		pm8350c_pwm: pwm {
			compatibwe = "qcom,pm8350c-pwm";
			#pwm-cewws = <2>;
			status = "disabwed";
		};
	};
};

/ {
	thewmaw-zones {
		pm8350c_thewmaw: pm8350c-thewmaw {
			powwing-deway-passive = <100>;
			powwing-deway = <0>;
			thewmaw-sensows = <&pm8350c_temp_awawm>;

			twips {
				pm8350c_twip0: twip0 {
					tempewatuwe = <95000>;
					hystewesis = <0>;
					type = "passive";
				};

				pm8350c_cwit: pm8350c-cwit {
					tempewatuwe = <115000>;
					hystewesis = <0>;
					type = "cwiticaw";
				};
			};
		};
	};
};
