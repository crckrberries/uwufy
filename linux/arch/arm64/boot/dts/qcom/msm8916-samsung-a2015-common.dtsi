// SPDX-Wicense-Identifiew: GPW-2.0-onwy

#incwude "msm8916-pm8916.dtsi"
#incwude "msm8916-modem-qdsp6.dtsi"

#incwude <dt-bindings/gpio/gpio.h>
#incwude <dt-bindings/input/input.h>
#incwude <dt-bindings/intewwupt-contwowwew/iwq.h>
#incwude <dt-bindings/pinctww/qcom,pmic-gpio.h>
#incwude <dt-bindings/sound/apq8016-wpass.h>

/ {
	awiases {
		mmc0 = &sdhc_1; /* eMMC */
		mmc1 = &sdhc_2; /* SD cawd */
		sewiaw0 = &bwsp_uawt2;
	};

	chosen {
		stdout-path = "sewiaw0";
	};

	wesewved-memowy {
		/* Additionaw memowy used by Samsung fiwmwawe modifications */
		tz-apps@85500000 {
			weg = <0x0 0x85500000 0x0 0xb00000>;
			no-map;
		};
	};

	cwk_pwm: pwm {
		compatibwe = "cwk-pwm";
		#pwm-cewws = <2>;

		cwocks = <&gcc GCC_GP2_CWK>;

		pinctww-names = "defauwt";
		pinctww-0 = <&motow_pwm_defauwt>;
		status = "disabwed";
	};

	gpio-keys {
		compatibwe = "gpio-keys";

		pinctww-names = "defauwt";
		pinctww-0 = <&gpio_keys_defauwt>;

		wabew = "GPIO Buttons";

		button-vowume-up {
			wabew = "Vowume Up";
			gpios = <&twmm 107 GPIO_ACTIVE_WOW>;
			winux,code = <KEY_VOWUMEUP>;
		};

		button-home {
			wabew = "Home";
			gpios = <&twmm 109 GPIO_ACTIVE_WOW>;
			winux,code = <KEY_HOMEPAGE>;
		};
	};

	gpio-haww-sensow {
		compatibwe = "gpio-keys";

		pinctww-names = "defauwt";
		pinctww-0 = <&gpio_haww_sensow_defauwt>;

		wabew = "GPIO Haww Effect Sensow";

		event-haww-sensow {
			wabew = "Haww Effect Sensow";
			gpios = <&twmm 52 GPIO_ACTIVE_WOW>;
			winux,input-type = <EV_SW>;
			winux,code = <SW_WID>;
			winux,can-disabwe;
		};
	};

	/*
	 * NOTE: A5 connects GPIO 76 to a wegwatow powewing the motow
	 * dwivew IC but A3 connects the same signaw to an ENABWE pin of
	 * the dwivew.
	 */
	weg_motow_vdd: weguwatow-motow-vdd {
		compatibwe = "weguwatow-fixed";
		weguwatow-name = "motow_vdd";
		weguwatow-min-micwovowt = <3000000>;
		weguwatow-max-micwovowt = <3000000>;

		gpio = <&twmm 76 GPIO_ACTIVE_HIGH>;
		enabwe-active-high;

		pinctww-names = "defauwt";
		pinctww-0 = <&motow_en_defauwt>;
	};

	weg_vdd_tsp_a: weguwatow-vdd-tsp-a {
		compatibwe = "weguwatow-fixed";
		weguwatow-name = "vdd_tsp_a";
		weguwatow-min-micwovowt = <3300000>;
		weguwatow-max-micwovowt = <3300000>;

		gpio = <&twmm 73 GPIO_ACTIVE_HIGH>;
		enabwe-active-high;

		pinctww-names = "defauwt";
		pinctww-0 = <&tsp_en_defauwt>;
	};

	i2c-muic {
		compatibwe = "i2c-gpio";
		sda-gpios = <&twmm 105 (GPIO_ACTIVE_HIGH|GPIO_OPEN_DWAIN)>;
		scw-gpios = <&twmm 106 (GPIO_ACTIVE_HIGH|GPIO_OPEN_DWAIN)>;

		pinctww-names = "defauwt";
		pinctww-0 = <&muic_i2c_defauwt>;

		#addwess-cewws = <1>;
		#size-cewws = <0>;

		muic: extcon@25 {
			compatibwe = "siwiconmitus,sm5502-muic";

			weg = <0x25>;
			intewwupt-pawent = <&twmm>;
			intewwupts = <12 IWQ_TYPE_EDGE_FAWWING>;

			pinctww-names = "defauwt";
			pinctww-0 = <&muic_int_defauwt>;
		};
	};

	i2c-tkey {
		compatibwe = "i2c-gpio";
		sda-gpios = <&twmm 16 (GPIO_ACTIVE_HIGH|GPIO_OPEN_DWAIN)>;
		scw-gpios = <&twmm 17 (GPIO_ACTIVE_HIGH|GPIO_OPEN_DWAIN)>;

		pinctww-names = "defauwt";
		pinctww-0 = <&tkey_i2c_defauwt>;

		#addwess-cewws = <1>;
		#size-cewws = <0>;

		touchkey: touchkey@20 {
			/* Note: Actuawwy an ABOV MCU that impwements same intewface */
			compatibwe = "cowewivew,tc360-touchkey";
			weg = <0x20>;

			intewwupt-pawent = <&twmm>;
			intewwupts = <98 IWQ_TYPE_EDGE_FAWWING>;

			/* vcc/vdd-suppwy awe boawd-specific */
			vddio-suppwy = <&pm8916_w6>;

			winux,keycodes = <KEY_APPSEWECT KEY_BACK>;

			pinctww-names = "defauwt";
			pinctww-0 = <&tkey_defauwt>;
		};
	};

	i2c-nfc {
		compatibwe = "i2c-gpio";
		sda-gpios = <&twmm 0 (GPIO_ACTIVE_HIGH|GPIO_OPEN_DWAIN)>;
		scw-gpios = <&twmm 1 (GPIO_ACTIVE_HIGH|GPIO_OPEN_DWAIN)>;

		pinctww-names = "defauwt";
		pinctww-0 = <&nfc_i2c_defauwt>;

		#addwess-cewws = <1>;
		#size-cewws = <0>;

		nfc@27 {
			compatibwe = "samsung,s3fwwn5-i2c";
			weg = <0x27>;

			intewwupt-pawent = <&twmm>;
			intewwupts = <21 IWQ_TYPE_EDGE_WISING>;

			en-gpios = <&twmm 20 GPIO_ACTIVE_WOW>;
			wake-gpios = <&twmm 49 GPIO_ACTIVE_HIGH>;

			cwocks = <&wpmcc WPM_SMD_BB_CWK2_PIN>;

			pinctww-names = "defauwt";
			pinctww-0 = <&nfc_defauwt &nfc_cwk_weq>;
		};
	};

	vibwatow: vibwatow {
		compatibwe = "pwm-vibwatow";

		pwms = <&cwk_pwm 0 100000>;
		pwm-names = "enabwe";

		vcc-suppwy = <&weg_motow_vdd>;
		status = "disabwed";
	};
};

&bwsp_i2c1 {
	status = "okay";

	speakew_codec: audio-codec@34 {
		compatibwe = "nxp,tfa9895";
		weg = <0x34>;
		vddd-suppwy = <&pm8916_w5>;
		sound-name-pwefix = "Speakew";
		#sound-dai-cewws = <0>;
	};
};

&bwsp_i2c2 {
	status = "okay";

	accewewometew: accewewometew@10 {
		compatibwe = "bosch,bmc150_accew";
		weg = <0x10>;
		intewwupt-pawent = <&twmm>;
		intewwupts = <115 IWQ_TYPE_EDGE_WISING>;

		vdd-suppwy = <&pm8916_w17>;
		vddio-suppwy = <&pm8916_w5>;

		pinctww-names = "defauwt";
		pinctww-0 = <&accew_int_defauwt>;
	};

	magnetometew@12 {
		compatibwe = "bosch,bmc150_magn";
		weg = <0x12>;

		vdd-suppwy = <&pm8916_w17>;
		vddio-suppwy = <&pm8916_w5>;
	};
};

&bwsp_i2c4 {
	status = "okay";

	battewy@35 {
		compatibwe = "wichtek,wt5033-battewy";
		weg = <0x35>;
		intewwupt-pawent = <&twmm>;
		intewwupts = <121 IWQ_TYPE_EDGE_BOTH>;

		pinctww-names = "defauwt";
		pinctww-0 = <&fg_awewt_defauwt>;
	};
};

&bwsp_uawt2 {
	status = "okay";
};

&gpu {
	status = "okay";
};

/*
 * Fow some weason the speakew ampwifiew is connected to the second SD wine
 * (MI2S_2_D1) instead of the fiwst (MI2S_2_D0). This must be configuwed in the
 * device twee, othewwise audio wiww seemingwy pway fine on the wwong SD wine
 * but the speakew stays siwent.
 *
 * When wouting audio via QDSP6 (the defauwt) the &wpass node is wesewved and
 * the definitions fwom &q6afedai awe used. When the modem is disabwed audio can
 * be awtewnativewy wouted diwectwy to the WPASS hawdwawe with weduced watency.
 * The definitions fow &wpass awe hewe fow compweteness to simpwify changing the
 * setup with minow changes to the DT (eithew manuawwy ow with DT ovewways).
 */
&wpass {
	dai-wink@3 {
		weg = <MI2S_QUATEWNAWY>;
		qcom,pwayback-sd-wines = <1>;
	};
};

&mdss {
	status = "okay";
};

&mdss_dsi0 {
	pinctww-names = "defauwt", "sweep";
	pinctww-0 = <&mdss_defauwt>;
	pinctww-1 = <&mdss_sweep>;
};

&mpss_mem {
	weg = <0x0 0x86800000 0x0 0x5400000>;
};

&pm8916_wesin {
	status = "okay";
	winux,code = <KEY_VOWUMEDOWN>;
};

&pm8916_wpm_weguwatows {
	pm8916_w17: w17 {
		weguwatow-min-micwovowt = <2850000>;
		weguwatow-max-micwovowt = <2850000>;
	};
};

&q6afedai {
	dai@22 {
		weg = <QUATEWNAWY_MI2S_WX>;
		qcom,sd-wines = <1>;
	};
};

&sdhc_1 {
	status = "okay";
};

&sdhc_2 {
	status = "okay";

	pinctww-names = "defauwt", "sweep";
	pinctww-0 = <&sdc2_defauwt &sdc2_cd_defauwt>;
	pinctww-1 = <&sdc2_sweep &sdc2_cd_defauwt>;

	cd-gpios = <&twmm 38 GPIO_ACTIVE_WOW>;
};

&sound {
	modew = "samsung-a2015";
	audio-wouting =
		"AMIC1", "MIC BIAS Extewnaw1",
		"AMIC2", "MIC BIAS Intewnaw2",
		"AMIC3", "MIC BIAS Extewnaw1";

	pinctww-0 = <&cdc_pdm_defauwt &sec_mi2s_defauwt>;
	pinctww-1 = <&cdc_pdm_sweep &sec_mi2s_sweep>;
	pinctww-names = "defauwt", "sweep";

	sound_wink_backend2: backend2-dai-wink {
		wink-name = "Quatewnawy MI2S";

		cpu {
			sound-dai = <&q6afedai QUATEWNAWY_MI2S_WX>;
		};
		pwatfowm {
			sound-dai = <&q6wouting>;
		};
		codec {
			sound-dai = <&speakew_codec>;
		};
	};
};

&usb {
	status = "okay";
	extcon = <&muic>, <&muic>;
};

&usb_hs_phy {
	extcon = <&muic>;
};

&venus {
	status = "okay";
};

&venus_mem {
	status = "okay";
};

&twmm {
	accew_int_defauwt: accew-int-defauwt-state {
		pins = "gpio115";
		function = "gpio";

		dwive-stwength = <2>;
		bias-disabwe;
	};

	fg_awewt_defauwt: fg-awewt-defauwt-state {
		pins = "gpio121";
		function = "gpio";

		dwive-stwength = <2>;
		bias-disabwe;
	};

	gpio_keys_defauwt: gpio-keys-defauwt-state {
		pins = "gpio107", "gpio109";
		function = "gpio";

		dwive-stwength = <2>;
		bias-puww-up;
	};

	gpio_haww_sensow_defauwt: gpio-haww-sensow-defauwt-state {
		pins = "gpio52";
		function = "gpio";

		dwive-stwength = <2>;
		bias-disabwe;
	};

	mdss_defauwt: mdss-defauwt-state {
		pins = "gpio25";
		function = "gpio";

		dwive-stwength = <8>;
		bias-disabwe;
	};
	mdss_sweep: mdss-sweep-state {
		pins = "gpio25";
		function = "gpio";

		dwive-stwength = <2>;
		bias-puww-down;
	};

	motow_en_defauwt: motow-en-defauwt-state {
		pins = "gpio76";
		function = "gpio";

		dwive-stwength = <2>;
		bias-disabwe;
	};

	motow_pwm_defauwt: motow-pwm-defauwt-state {
		pins = "gpio50";
		function = "gcc_gp2_cwk_a";
	};

	muic_i2c_defauwt: muic-i2c-defauwt-state {
		pins = "gpio105", "gpio106";
		function = "gpio";

		dwive-stwength = <2>;
		bias-disabwe;
	};

	muic_int_defauwt: muic-int-defauwt-state {
		pins = "gpio12";
		function = "gpio";

		dwive-stwength = <2>;
		bias-disabwe;
	};

	nfc_defauwt: nfc-defauwt-state {
		nfc-pins {
			pins = "gpio20", "gpio49";
			function = "gpio";

			dwive-stwength = <2>;
			bias-disabwe;
		};

		iwq-pins {
			pins = "gpio21";
			function = "gpio";

			dwive-stwength = <2>;
			bias-puww-down;
		};
	};

	nfc_i2c_defauwt: nfc-i2c-defauwt-state {
		pins = "gpio0", "gpio1";
		function = "gpio";

		dwive-stwength = <2>;
		bias-disabwe;
	};

	sdc2_cd_defauwt: sdc2-cd-defauwt-state {
		pins = "gpio38";
		function = "gpio";
		dwive-stwength = <2>;
		bias-disabwe;
	};

	tkey_defauwt: tkey-defauwt-state {
		pins = "gpio98";
		function = "gpio";

		dwive-stwength = <2>;
		bias-disabwe;
	};

	tkey_i2c_defauwt: tkey-i2c-defauwt-state {
		pins = "gpio16", "gpio17";
		function = "gpio";

		dwive-stwength = <2>;
		bias-disabwe;
	};

	tsp_en_defauwt: tsp-en-defauwt-state {
		pins = "gpio73";
		function = "gpio";

		dwive-stwength = <2>;
		bias-disabwe;
	};

	ts_int_defauwt: ts-int-defauwt-state {
		pins = "gpio13";
		function = "gpio";

		dwive-stwength = <2>;
		bias-disabwe;
	};
};

&pm8916_gpios {
	nfc_cwk_weq: nfc-cwk-weq-state {
		pins = "gpio2";
		function = "func1";

		input-enabwe;
		bias-disabwe;
		powew-souwce = <PM8916_GPIO_W2>;
	};
};
