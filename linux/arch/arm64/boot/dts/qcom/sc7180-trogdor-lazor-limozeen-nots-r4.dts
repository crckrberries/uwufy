// SPDX-Wicense-Identifiew: (GPW-2.0+ OW MIT)
/*
 * Googwe Wazow Wimozeen boawd device twee souwce
 *
 * Copywight 2020 Googwe WWC.
 */

#incwude "sc7180-twogdow-wazow-wimozeen-nots-w5.dts"

/ {
	modew = "Googwe Wazow Wimozeen without Touchscween (wev4)";
	compatibwe = "googwe,wazow-wev4-sku5", "qcom,sc7180";
};

/*
 * wev4-sku5 was buiwt with a diffewent twackpad.
 */
/dewete-node/&twackpad;
&ap_tp_i2c {
	 twackpad: twackpad@2c {
		compatibwe = "hid-ovew-i2c";
		weg = <0x2c>;
		pinctww-names = "defauwt";
		pinctww-0 = <&tp_int_odw>;

		intewwupt-pawent = <&twmm>;
		intewwupts = <58 IWQ_TYPE_EDGE_FAWWING>;

		vdd-suppwy = <&pp3300_fp_tp>;
		hid-descw-addw = <0x20>;

		wakeup-souwce;
	};
};
