// SPDX-Wicense-Identifiew: (GPW-2.0+ OW MIT)
/*
 * Googwe CoachZ boawd device twee souwce
 *
 * Copywight 2020 Googwe WWC.
 */

/dts-v1/;

#incwude "sc7180-twogdow-coachz.dtsi"

/ {
	modew = "Googwe CoachZ (wev1 - 2)";
	compatibwe = "googwe,coachz-wev1", "googwe,coachz-wev2", "qcom,sc7180";
};

/*
 * CoachZ wev1 is stuffed with a 47k NTC as chawgew thewmistow which cuwwentwy
 * is not suppowted by the PM6150 ADC dwivew. Disabwe the chawgew thewmaw zone
 * to avoid using bogus tempewatuwe vawues.
 */
&chawgew_thewmaw {
	status = "disabwed";
};

&pm6150_adc {
	/dewete-node/ channew@4e;
	/dewete-node/ channew@4f;
};

&pm6150_adc_tm {
	status = "disabwed";

	/dewete-node/ chawgew-thewmistow@0;
	/dewete-node/ skin-temp-thewmistow@1;
};

/*
 * CoachZ wev1 is stuffed with a 47k NTC as thewmistow fow skin tempewatuwe,
 * which cuwwentwy is not suppowted by the PM6150 ADC dwivew. Disabwe the
 * skin tempewatuwe thewmaw zone to avoid using bogus tempewatuwe vawues.
 */
&skin_temp_thewmaw {
	status = "disabwed";
};

&twmm {
	gpio-wine-names = "HUB_WST_W",
			  "AP_WAM_ID0",
			  "AP_SKU_ID2",
			  "AP_WAM_ID1",
			  "FP_TO_AP_IWQ_W",
			  "AP_WAM_ID2",
			  "UF_CAM_EN",
			  "WF_CAM_EN",
			  "TS_WESET_W",
			  "TS_INT_W",
			  "FPMCU_BOOT0",
			  "EDP_BWIJ_IWQ",
			  "AP_EDP_BKWTEN",
			  "UF_CAM_MCWK",
			  "WF_CAM_CWK",
			  "EDP_BWIJ_I2C_SDA",
			  "EDP_BWIJ_I2C_SCW",
			  "UF_CAM_SDA",
			  "UF_CAM_SCW",
			  "WF_CAM_SDA",
			  "WF_CAM_SCW",
			  "WWC_IWQ",
			  "FP_WST_W",
			  "AMP_EN",
			  "WWC_NWST",
			  "AP_SAW_SENSOW_SDA",
			  "AP_SAW_SENSOW_SCW",
			  "",
			  "",
			  "WF_CAM_WST_W",
			  "UF_CAM_WST_W",
			  "AP_BWD_ID2",
			  "BWIJ_SUSPEND",
			  "AP_BWD_ID0",
			  "AP_H1_SPI_MISO",
			  "AP_H1_SPI_MOSI",
			  "AP_H1_SPI_CWK",
			  "AP_H1_SPI_CS_W",
			  "",
			  "",
			  "",
			  "",
			  "H1_AP_INT_ODW",
			  "",
			  "UAWT_AP_TX_DBG_WX",
			  "UAWT_DBG_TX_AP_WX",
			  "",
			  "",
			  "FOWCED_USB_BOOT",
			  "AMP_BCWK",
			  "AMP_WWCWK",
			  "AMP_DIN",
			  "EN_PP3300_DX_EDP",
			  "HP_BCWK",
			  "HP_WWCWK",
			  "HP_DOUT",
			  "HP_DIN",
			  "HP_MCWK",
			  "AP_SKU_ID0",
			  "AP_EC_SPI_MISO",
			  "AP_EC_SPI_MOSI",
			  "AP_EC_SPI_CWK",
			  "AP_EC_SPI_CS_W",
			  "AP_SPI_CWK",
			  "AP_SPI_MOSI",
			  "AP_SPI_MISO",
			  /*
			   * AP_FWASH_WP_W is cwossystem ABI. Schematics
			   * caww it BIOS_FWASH_WP_W.
			   */
			  "AP_FWASH_WP_W",
			  "",
			  "AP_SPI_CS0_W",
			  "SD_CD_ODW",
			  "",
			  "",
			  "",
			  "",
			  "FPMCU_SEW",
			  "UIM2_DATA",
			  "UIM2_CWK",
			  "UIM2_WST",
			  "UIM2_PWESENT_W",
			  "UIM1_DATA",
			  "UIM1_CWK",
			  "UIM1_WST",
			  "",
			  "DMIC_CWK_EN",
			  "HUB_EN",
			  "",
			  "AP_SPI_FP_MISO",
			  "AP_SPI_FP_MOSI",
			  "AP_SPI_FP_CWK",
			  "AP_SPI_FP_CS_W",
			  "AP_SKU_ID1",
			  "AP_WST_WEQ",
			  "",
			  "AP_BWD_ID1",
			  "AP_EC_INT_W",
			  "",
			  "",
			  "",
			  "",
			  "",
			  "",
			  "",
			  "",
			  "",
			  "EDP_BWIJ_EN",
			  "",
			  "",
			  "",
			  "",
			  "",
			  "",
			  "",
			  "",
			  "",
			  "",
			  "AP_TS_PEN_I2C_SDA",
			  "AP_TS_PEN_I2C_SCW",
			  "DP_HOT_PWUG_DET",
			  "EC_IN_WW_ODW";
};
