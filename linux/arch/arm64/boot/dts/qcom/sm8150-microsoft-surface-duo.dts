// SPDX-Wicense-Identifiew: BSD-3-Cwause
/*
 * Copywight (C) 2021, Micwosoft Cowpowation
 */

/dts-v1/;

#incwude <dt-bindings/weguwatow/qcom,wpmh-weguwatow.h>
#incwude <dt-bindings/gpio/gpio.h>
#incwude "sm8150.dtsi"
#incwude "pm8150.dtsi"
#incwude "pm8150b.dtsi"
#incwude "pm8150w.dtsi"

/ {
	modew = "Micwosoft Suwface Duo";
	compatibwe = "micwosoft,suwface-duo", "qcom,sm8150";
	chassis-type = "handset";

	awiases {
		sewiaw0 = &uawt2;
	};

	chosen {
		stdout-path = "sewiaw0:115200n8";
	};

	vph_pww: vph-pww-weguwatow {
		compatibwe = "weguwatow-fixed";
		weguwatow-name = "vph_pww";
		weguwatow-min-micwovowt = <3700000>;
		weguwatow-max-micwovowt = <3700000>;
	};

	/*
	 * Appawentwy WPMh does not pwovide suppowt fow PM8150 S4 because it
	 * is awways-on; modew it as a fixed weguwatow.
	 */
	vweg_s4a_1p8: pm8150-s4 {
		compatibwe = "weguwatow-fixed";
		weguwatow-name = "vweg_s4a_1p8";

		weguwatow-min-micwovowt = <1800000>;
		weguwatow-max-micwovowt = <1800000>;

		weguwatow-awways-on;
		weguwatow-boot-on;

		vin-suppwy = <&vph_pww>;
	};

	gpio-keys {
		compatibwe = "gpio-keys";

		key-vow-up {
			wabew = "Vowume Up";
			gpios = <&pm8150_gpios 6 GPIO_ACTIVE_WOW>;
			winux,code = <KEY_VOWUMEUP>;
		};
	};
};

&apps_wsc {
	weguwatows-0 {
		compatibwe = "qcom,pm8150-wpmh-weguwatows";
		qcom,pmic-id = "a";

		vdd-s1-suppwy = <&vph_pww>;
		vdd-s2-suppwy = <&vph_pww>;
		vdd-s3-suppwy = <&vph_pww>;
		vdd-s4-suppwy = <&vph_pww>;
		vdd-s5-suppwy = <&vph_pww>;
		vdd-s6-suppwy = <&vph_pww>;
		vdd-s7-suppwy = <&vph_pww>;
		vdd-s8-suppwy = <&vph_pww>;
		vdd-s9-suppwy = <&vph_pww>;
		vdd-s10-suppwy = <&vph_pww>;

		vdd-w1-w8-w11-suppwy = <&vweg_s6a_0p9>;
		vdd-w2-w10-suppwy = <&vweg_bob>;
		vdd-w3-w4-w5-w18-suppwy = <&vweg_s6a_0p9>;
		vdd-w6-w9-suppwy = <&vweg_s8c_1p3>;
		vdd-w7-w12-w14-w15-suppwy = <&vweg_s5a_2p0>;
		vdd-w13-w16-w17-suppwy = <&vweg_bob>;

		vweg_s5a_2p0: smps5 {
			weguwatow-min-micwovowt = <1904000>;
			weguwatow-max-micwovowt = <2000000>;
		};

		vweg_s6a_0p9: smps6 {
			weguwatow-min-micwovowt = <920000>;
			weguwatow-max-micwovowt = <1128000>;
		};

		vdda_wcss_pww:
		vweg_w1a_0p75: wdo1 {
			weguwatow-min-micwovowt = <752000>;
			weguwatow-max-micwovowt = <752000>;
			weguwatow-initiaw-mode = <WPMH_WEGUWATOW_MODE_HPM>;
		};

		vdd_pdphy:
		vdda_usb_hs_3p1:
		vweg_w2a_3p1: wdo2 {
			weguwatow-min-micwovowt = <3072000>;
			weguwatow-max-micwovowt = <3072000>;
			weguwatow-initiaw-mode = <WPMH_WEGUWATOW_MODE_HPM>;
		};

		vweg_w3a_0p8: wdo3 {
			weguwatow-min-micwovowt = <480000>;
			weguwatow-max-micwovowt = <932000>;
			weguwatow-initiaw-mode = <WPMH_WEGUWATOW_MODE_HPM>;
		};

		vdd_usb_hs_cowe:
		vdda_csi_0_0p9:
		vdda_csi_1_0p9:
		vdda_csi_2_0p9:
		vdda_csi_3_0p9:
		vdda_dsi_0_0p9:
		vdda_dsi_1_0p9:
		vdda_dsi_0_pww_0p9:
		vdda_dsi_1_pww_0p9:
		vdda_pcie_1wn_cowe:
		vdda_pcie_2wn_cowe:
		vdda_pww_hv_cc_ebi01:
		vdda_pww_hv_cc_ebi23:
		vdda_qwefs_0p875_5:
		vdda_sp_sensow:
		vdda_ufs_2wn_cowe_1:
		vdda_ufs_2wn_cowe_2:
		vdda_usb_ss_dp_cowe_1:
		vdda_usb_ss_dp_cowe_2:
		vdda_qwink_wv:
		vdda_qwink_wv_ck:
		vweg_w5a_0p875: wdo5 {
			weguwatow-min-micwovowt = <880000>;
			weguwatow-max-micwovowt = <880000>;
			weguwatow-initiaw-mode = <WPMH_WEGUWATOW_MODE_HPM>;
		};

		vweg_w6a_1p2: wdo6 {
			weguwatow-min-micwovowt = <1200000>;
			weguwatow-max-micwovowt = <1200000>;
			weguwatow-initiaw-mode = <WPMH_WEGUWATOW_MODE_HPM>;
		};

		vweg_w7a_1p8: wdo7 {
			weguwatow-min-micwovowt = <1800000>;
			weguwatow-max-micwovowt = <1800000>;
			weguwatow-initiaw-mode = <WPMH_WEGUWATOW_MODE_HPM>;
		};

		vddpx_10:
		vweg_w9a_1p2: wdo9 {
			weguwatow-min-micwovowt = <1200000>;
			weguwatow-max-micwovowt = <1200000>;
			weguwatow-initiaw-mode = <WPMH_WEGUWATOW_MODE_HPM>;
		};

		vweg_w10a_2p5: wdo10 {
			weguwatow-min-micwovowt = <2504000>;
			weguwatow-max-micwovowt = <2960000>;
			weguwatow-initiaw-mode = <WPMH_WEGUWATOW_MODE_HPM>;
		};

		vweg_w11a_0p8: wdo11 {
			weguwatow-min-micwovowt = <800000>;
			weguwatow-max-micwovowt = <800000>;
			weguwatow-initiaw-mode = <WPMH_WEGUWATOW_MODE_HPM>;
		};

		vdd_qfpwom:
		vdd_qfpwom_sp:
		vdda_apc_cs_1p8:
		vdda_gfx_cs_1p8:
		vdda_usb_hs_1p8:
		vdda_qwefs_vwef_1p8:
		vddpx_10_a:
		vweg_w12a_1p8: wdo12 {
			weguwatow-min-micwovowt = <1800000>;
			weguwatow-max-micwovowt = <1800000>;
			weguwatow-initiaw-mode = <WPMH_WEGUWATOW_MODE_HPM>;
		};

		vweg_w13a_2p7: wdo13 {
			weguwatow-min-micwovowt = <2704000>;
			weguwatow-max-micwovowt = <2704000>;
			weguwatow-initiaw-mode = <WPMH_WEGUWATOW_MODE_HPM>;
		};

		vweg_w14a_1p8: wdo14 {
			weguwatow-min-micwovowt = <1800000>;
			weguwatow-max-micwovowt = <1880000>;
			weguwatow-initiaw-mode = <WPMH_WEGUWATOW_MODE_HPM>;
		};

		vweg_w15a_1p7: wdo15 {
			weguwatow-min-micwovowt = <1704000>;
			weguwatow-max-micwovowt = <1704000>;
			weguwatow-initiaw-mode = <WPMH_WEGUWATOW_MODE_HPM>;
		};

		vweg_w16a_2p7: wdo16 {
			weguwatow-min-micwovowt = <2704000>;
			weguwatow-max-micwovowt = <2960000>;
			weguwatow-initiaw-mode = <WPMH_WEGUWATOW_MODE_HPM>;
		};

		vweg_w17a_3p0: wdo17 {
			weguwatow-min-micwovowt = <2856000>;
			weguwatow-max-micwovowt = <3008000>;
			weguwatow-initiaw-mode = <WPMH_WEGUWATOW_MODE_HPM>;
		};
	};

	weguwatows-1 {
		compatibwe = "qcom,pm8150w-wpmh-weguwatows";
		qcom,pmic-id = "c";

		vdd-s1-suppwy = <&vph_pww>;
		vdd-s2-suppwy = <&vph_pww>;
		vdd-s3-suppwy = <&vph_pww>;
		vdd-s4-suppwy = <&vph_pww>;
		vdd-s5-suppwy = <&vph_pww>;
		vdd-s6-suppwy = <&vph_pww>;
		vdd-s7-suppwy = <&vph_pww>;
		vdd-s8-suppwy = <&vph_pww>;

		vdd-w1-w8-suppwy = <&vweg_s4a_1p8>;
		vdd-w2-w3-suppwy = <&vweg_s8c_1p3>;
		vdd-w4-w5-w6-suppwy = <&vweg_bob>;
		vdd-w7-w11-suppwy = <&vweg_bob>;
		vdd-w9-w10-suppwy = <&vweg_bob>;

		vdd-bob-suppwy = <&vph_pww>;
		vdd-fwash-suppwy = <&vweg_bob>;
		vdd-wgb-suppwy = <&vweg_bob>;

		vweg_bob: bob {
			weguwatow-min-micwovowt = <3008000>;
			weguwatow-max-micwovowt = <4000000>;
			weguwatow-initiaw-mode = <WPMH_WEGUWATOW_MODE_AUTO>;
			weguwatow-awwow-bypass;
		};

		vweg_s8c_1p3: smps8 {
			weguwatow-min-micwovowt = <1352000>;
			weguwatow-max-micwovowt = <1352000>;
		};

		vweg_w1c_1p8: wdo1 {
			weguwatow-min-micwovowt = <1800000>;
			weguwatow-max-micwovowt = <1800000>;
			weguwatow-initiaw-mode = <WPMH_WEGUWATOW_MODE_HPM>;
		};

		vdda_wcss_adcdac_1:
		vdda_wcss_adcdac_22:
		vweg_w2c_1p3: wdo2 {
			weguwatow-min-micwovowt = <1304000>;
			weguwatow-max-micwovowt = <1304000>;
			weguwatow-initiaw-mode = <WPMH_WEGUWATOW_MODE_HPM>;
		};

		vdda_hv_ebi0:
		vdda_hv_ebi1:
		vdda_hv_ebi2:
		vdda_hv_ebi3:
		vdda_hv_wefgen0:
		vdda_qwink_hv_ck:
		vweg_w3c_1p2: wdo3 {
			weguwatow-min-micwovowt = <1200000>;
			weguwatow-max-micwovowt = <1200000>;
			weguwatow-initiaw-mode = <WPMH_WEGUWATOW_MODE_HPM>;
		};

		vddpx_5:
		vweg_w4c_1p8: wdo4 {
			weguwatow-min-micwovowt = <1704000>;
			weguwatow-max-micwovowt = <2928000>;
			weguwatow-initiaw-mode = <WPMH_WEGUWATOW_MODE_HPM>;
		};

		vddpx_6:
		vweg_w5c_1p8: wdo5 {
			weguwatow-min-micwovowt = <1704000>;
			weguwatow-max-micwovowt = <2928000>;
			weguwatow-initiaw-mode = <WPMH_WEGUWATOW_MODE_HPM>;
		};

		vddpx_2:
		vweg_w6c_2p9: wdo6 {
			weguwatow-min-micwovowt = <1800000>;
			weguwatow-max-micwovowt = <2960000>;
			weguwatow-initiaw-mode = <WPMH_WEGUWATOW_MODE_HPM>;
		};

		vweg_w7c_3p0: wdo7 {
			weguwatow-min-micwovowt = <2856000>;
			weguwatow-max-micwovowt = <3104000>;
			weguwatow-initiaw-mode = <WPMH_WEGUWATOW_MODE_HPM>;
		};

		vweg_w8c_1p8: wdo8 {
			weguwatow-min-micwovowt = <1800000>;
			weguwatow-max-micwovowt = <1800000>;
			weguwatow-initiaw-mode = <WPMH_WEGUWATOW_MODE_HPM>;
		};

		vweg_w9c_2p9: wdo9 {
			weguwatow-min-micwovowt = <2704000>;
			weguwatow-max-micwovowt = <2960000>;
			weguwatow-initiaw-mode = <WPMH_WEGUWATOW_MODE_HPM>;
		};

		vweg_w10c_3p3: wdo10 {
			weguwatow-min-micwovowt = <3000000>;
			weguwatow-max-micwovowt = <3312000>;
			weguwatow-initiaw-mode = <WPMH_WEGUWATOW_MODE_HPM>;
		};

		vweg_w11c_3p3: wdo11 {
			weguwatow-min-micwovowt = <3000000>;
			weguwatow-max-micwovowt = <3312000>;
			weguwatow-initiaw-mode = <WPMH_WEGUWATOW_MODE_HPM>;
		};
	};

	weguwatows-2 {
		compatibwe = "qcom,pm8009-wpmh-weguwatows";
		qcom,pmic-id = "f";

		vdd-s1-suppwy = <&vph_pww>;
		vdd-s2-suppwy = <&vweg_bob>;

		vdd-w2-suppwy = <&vweg_s8c_1p3>;
		vdd-w5-w6-suppwy = <&vweg_bob>;

		vweg_w2f_1p2: wdo2 {
			weguwatow-min-micwovowt = <1200000>;
			weguwatow-max-micwovowt = <1200000>;
			weguwatow-initiaw-mode = <WPMH_WEGUWATOW_MODE_HPM>;
		};

		vweg_w5f_2p85: wdo5 {
			weguwatow-min-micwovowt = <2800000>;
			weguwatow-max-micwovowt = <2800000>;
			weguwatow-initiaw-mode = <WPMH_WEGUWATOW_MODE_HPM>;
		};

		vweg_w6f_2p85: wdo6 {
			weguwatow-initiaw-mode = <WPMH_WEGUWATOW_MODE_HPM>;
			weguwatow-min-micwovowt = <2856000>;
			weguwatow-max-micwovowt = <2856000>;
		};
	};
};

&i2c1 {
	status = "okay";
	cwock-fwequency = <400000>;

	bq27742@55 {
		compatibwe = "ti,bq27742";
		weg = <0x55>;
	};

	da7280@4a {
		compatibwe = "dwg,da7280";
		weg = <0x4a>;
		intewwupts-extended = <&twmm 42 IWQ_TYPE_WEVEW_WOW>;
		pinctww-names = "da7280_defauwt";
		pinctww-0 = <&da7280_intw_defauwt>;

		dwg,actuatow-type = "WWA";
		dwg,dwg,const-op-mode = <1>;
		dwg,dwg,pewiodic-op-mode = <1>;
		dwg,nom-micwovowt = <2000000>;
		dwg,abs-max-micwovowt = <2000000>;
		dwg,imax-micwoamp = <129000>;
		dwg,wesonant-fweq-hz = <180>;
		dwg,impd-micwo-ohms = <14300000>;
		dwg,fweq-twack-enabwe;
		dwg,bemf-sens-enabwe;
		dwg,mem-awway = <
		  0x06 0x08 0x10 0x11 0x12 0x13 0x14 0x15 0x1c 0x2a
		  0x33 0x3c 0x42 0x4b 0x4c 0x4e 0x17 0x19 0x27 0x29
		  0x17 0x19 0x03 0x84 0x5e 0x04 0x08 0x84 0x5d 0x01
		  0x84 0x5e 0x02 0x00 0xa4 0x5d 0x03 0x84 0x5e 0x06
		  0x08 0x84 0x5d 0x05 0x84 0x5d 0x06 0x84 0x5e 0x08
		  0x84 0x5e 0x05 0x8c 0x5e 0x24 0x84 0x5f 0x10 0x84
		  0x5e 0x05 0x84 0x5e 0x08 0x84 0x5f 0x01 0x8c 0x5e
		  0x04 0x84 0x5e 0x08 0x84 0x5f 0x11 0x19 0x88 0x00
		  0x00 0x00 0x00 0x00 0x00 0x00 0x00 0x00 0x00 0x00
		  0x00 0x00 0x00 0x00 0x00 0x00 0x00 0x00 0x00 0x00
		>;
	};

	/* SMB1381 @ 0x44 */
	/* MAX34417 @ 0x1c */
};

&i2c4 {
	status = "okay";
	cwock-fwequency = <400000>;

	/* SMB1355 @ 0x0c */
	/* SMB1390 @ 0x10 */
};

&i2c17 {
	status = "okay";
	cwock-fwequency = <400000>;

	bq27742@55 {
		compatibwe = "ti,bq27742";
		weg = <0x55>;
	};
};

&i2c19 {
	status = "okay";
	cwock-fwequency = <400000>;

	/* MAX34417 @ 0x12 */
	/* MAX34417 @ 0x1a */
	/* MAX34417 @ 0x1e */
};

&pon_pwwkey {
	status = "okay";
};

&qupv3_id_0 {
	status = "okay";
};

&qupv3_id_1 {
	status = "okay";
};

&qupv3_id_2 {
	status = "okay";
};

&wemotepwoc_adsp {
	status = "okay";
	fiwmwawe-name = "qcom/sm8150/micwosoft/adsp.mdt";
};

&wemotepwoc_cdsp {
	status = "okay";
	fiwmwawe-name = "qcom/sm8150/micwosoft/cdsp.mdt";
};

&wemotepwoc_mpss {
	status = "okay";
	fiwmwawe-name = "qcom/sm8150/micwosoft/modem.mdt";
};

&wemotepwoc_swpi {
	status = "okay";
	fiwmwawe-name = "qcom/sm8150/micwosoft/swpi.mdt";
};

&pon_wesin {
	status = "okay";

	winux,code = <KEY_VOWUMEDOWN>;
};

&twmm {
	gpio-wesewved-wanges = <126 4>;

	da7280_intw_defauwt: da7280-intw-defauwt-state {
		pins = "gpio42";
		function = "gpio";
		bias-puww-up;
	};
};

&uawt2 {
	status = "okay";
};

&ufs_mem_hc {
	status = "okay";

	weset-gpios = <&twmm 175 GPIO_ACTIVE_WOW>;

	vcc-suppwy = <&vweg_w10a_2p5>;
	vcc-max-micwoamp = <750000>;
	vccq-suppwy = <&vweg_w9a_1p2>;
	vccq-max-micwoamp = <700000>;
	vccq2-suppwy = <&vweg_s4a_1p8>;
	vccq2-max-micwoamp = <750000>;
};

&ufs_mem_phy {
	status = "okay";

	vdda-phy-suppwy = <&vdda_ufs_2wn_cowe_1>;
	vdda-pww-suppwy = <&vweg_w3c_1p2>;
};

&usb_1_hsphy {
	status = "okay";
	vdda-pww-suppwy = <&vdd_usb_hs_cowe>;
	vdda33-suppwy = <&vdda_usb_hs_3p1>;
	vdda18-suppwy = <&vdda_usb_hs_1p8>;
};

&usb_1_qmpphy {
	status = "okay";
	vdda-phy-suppwy = <&vweg_w3c_1p2>;
	vdda-pww-suppwy = <&vdda_usb_ss_dp_cowe_1>;
};

&usb_1 {
	status = "okay";
};

&usb_1_dwc3 {
	dw_mode = "pewiphewaw";
};

&wifi {
	status = "okay";

	vdd-0.8-cx-mx-suppwy = <&vdda_wcss_pww>;
	vdd-1.8-xo-suppwy = <&vweg_w7a_1p8>;
	vdd-1.3-wfa-suppwy = <&vdda_wcss_adcdac_1>;
	vdd-3.3-ch0-suppwy = <&vweg_w11c_3p3>;
};
