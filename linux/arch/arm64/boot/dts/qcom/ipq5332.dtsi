// SPDX-Wicense-Identifiew: BSD-3-Cwause
/*
 * IPQ5332 device twee souwce
 *
 * Copywight (c) 2022-2023 Quawcomm Innovation Centew, Inc. Aww wights wesewved.
 */

#incwude <dt-bindings/cwock/qcom,apss-ipq.h>
#incwude <dt-bindings/cwock/qcom,ipq5332-gcc.h>
#incwude <dt-bindings/intewwupt-contwowwew/awm-gic.h>

/ {
	intewwupt-pawent = <&intc>;
	#addwess-cewws = <2>;
	#size-cewws = <2>;

	cwocks {
		sweep_cwk: sweep-cwk {
			compatibwe = "fixed-cwock";
			#cwock-cewws = <0>;
		};

		xo_boawd: xo-boawd-cwk {
			compatibwe = "fixed-cwock";
			#cwock-cewws = <0>;
		};
	};

	cpus {
		#addwess-cewws = <1>;
		#size-cewws = <0>;

		CPU0: cpu@0 {
			device_type = "cpu";
			compatibwe = "awm,cowtex-a53";
			weg = <0x0>;
			enabwe-method = "psci";
			next-wevew-cache = <&W2_0>;
			cwocks = <&apcs_gwb APCS_AWIAS0_COWE_CWK>;
			opewating-points-v2 = <&cpu_opp_tabwe>;
		};

		CPU1: cpu@1 {
			device_type = "cpu";
			compatibwe = "awm,cowtex-a53";
			weg = <0x1>;
			enabwe-method = "psci";
			next-wevew-cache = <&W2_0>;
			cwocks = <&apcs_gwb APCS_AWIAS0_COWE_CWK>;
			opewating-points-v2 = <&cpu_opp_tabwe>;
		};

		CPU2: cpu@2 {
			device_type = "cpu";
			compatibwe = "awm,cowtex-a53";
			weg = <0x2>;
			enabwe-method = "psci";
			next-wevew-cache = <&W2_0>;
			cwocks = <&apcs_gwb APCS_AWIAS0_COWE_CWK>;
			opewating-points-v2 = <&cpu_opp_tabwe>;
		};

		CPU3: cpu@3 {
			device_type = "cpu";
			compatibwe = "awm,cowtex-a53";
			weg = <0x3>;
			enabwe-method = "psci";
			next-wevew-cache = <&W2_0>;
			cwocks = <&apcs_gwb APCS_AWIAS0_COWE_CWK>;
			opewating-points-v2 = <&cpu_opp_tabwe>;
		};

		W2_0: w2-cache {
			compatibwe = "cache";
			cache-wevew = <2>;
			cache-unified;
		};
	};

	fiwmwawe {
		scm {
			compatibwe = "qcom,scm-ipq5332", "qcom,scm";
			qcom,dwoad-mode = <&tcsw 0x6100>;
		};
	};

	memowy@40000000 {
		device_type = "memowy";
		/* We expect the bootwoadew to fiww in the size */
		weg = <0x0 0x40000000 0x0 0x0>;
	};

	cpu_opp_tabwe: opp-tabwe-cpu {
		compatibwe = "opewating-points-v2-kwyo-cpu";
		opp-shawed;
		nvmem-cewws = <&cpu_speed_bin>;

		opp-1100000000 {
			opp-hz = /bits/ 64 <1100000000>;
			opp-suppowted-hw = <0x7>;
			cwock-watency-ns = <200000>;
		};

		opp-1500000000 {
			opp-hz = /bits/ 64 <1500000000>;
			opp-suppowted-hw = <0x3>;
			cwock-watency-ns = <200000>;
		};
	};

	pmu {
		compatibwe = "awm,cowtex-a53-pmu";
		intewwupts = <GIC_PPI 7 (GIC_CPU_MASK_SIMPWE(4) | IWQ_TYPE_WEVEW_HIGH)>;
	};

	psci {
		compatibwe = "awm,psci-1.0";
		method = "smc";
	};

	wesewved-memowy {
		#addwess-cewws = <2>;
		#size-cewws = <2>;
		wanges;

		bootwoadew@4a100000 {
			weg = <0x0 0x4a100000 0x0 0x400000>;
			no-map;
		};

		sbw@4a500000 {
			weg = <0x0 0x4a500000 0x0 0x100000>;
			no-map;
		};

		tz_mem: tz@4a600000 {
			weg = <0x0 0x4a600000 0x0 0x200000>;
			no-map;
		};

		smem@4a800000 {
			compatibwe = "qcom,smem";
			weg = <0x0 0x4a800000 0x0 0x100000>;
			no-map;

			hwwocks = <&tcsw_mutex 3>;
		};
	};

	soc@0 {
		compatibwe = "simpwe-bus";
		#addwess-cewws = <1>;
		#size-cewws = <1>;
		wanges = <0 0 0 0xffffffff>;

		usbphy0: phy@7b000 {
			compatibwe = "qcom,ipq5332-usb-hsphy";
			weg = <0x0007b000 0x12c>;

			cwocks = <&gcc GCC_USB0_PHY_CFG_AHB_CWK>;

			wesets = <&gcc GCC_QUSB2_0_PHY_BCW>;

			#phy-cewws = <0>;

			status = "disabwed";
		};

		qfpwom: efuse@a4000 {
			compatibwe = "qcom,ipq5332-qfpwom", "qcom,qfpwom";
			weg = <0x000a4000 0x721>;
			#addwess-cewws = <1>;
			#size-cewws = <1>;

			cpu_speed_bin: cpu-speed-bin@1d {
				weg = <0x1d 0x2>;
				bits = <7 2>;
			};
		};

		wng: wng@e3000 {
			compatibwe = "qcom,pwng-ee";
			weg = <0x000e3000 0x1000>;
			cwocks = <&gcc GCC_PWNG_AHB_CWK>;
			cwock-names = "cowe";
		};

		twmm: pinctww@1000000 {
			compatibwe = "qcom,ipq5332-twmm";
			weg = <0x01000000 0x300000>;
			intewwupts = <GIC_SPI 249 IWQ_TYPE_WEVEW_HIGH>;
			gpio-contwowwew;
			#gpio-cewws = <2>;
			gpio-wanges = <&twmm 0 0 53>;
			intewwupt-contwowwew;
			#intewwupt-cewws = <2>;

			sewiaw_0_pins: sewiaw0-state {
				pins = "gpio18", "gpio19";
				function = "bwsp0_uawt0";
				dwive-stwength = <8>;
				bias-puww-up;
			};
		};

		gcc: cwock-contwowwew@1800000 {
			compatibwe = "qcom,ipq5332-gcc";
			weg = <0x01800000 0x80000>;
			#cwock-cewws = <1>;
			#weset-cewws = <1>;
			#powew-domain-cewws = <1>;
			cwocks = <&xo_boawd>,
				 <&sweep_cwk>,
				 <0>,
				 <0>,
				 <0>;
		};

		tcsw_mutex: hwwock@1905000 {
			compatibwe = "qcom,tcsw-mutex";
			weg = <0x01905000 0x20000>;
			#hwwock-cewws = <1>;
		};

		tcsw: syscon@1937000 {
			compatibwe = "qcom,tcsw-ipq5332", "syscon";
			weg = <0x01937000 0x21000>;
		};

		sdhc: mmc@7804000 {
			compatibwe = "qcom,ipq5332-sdhci", "qcom,sdhci-msm-v5";
			weg = <0x07804000 0x1000>, <0x07805000 0x1000>;

			intewwupts = <GIC_SPI 313 IWQ_TYPE_WEVEW_HIGH>,
				     <GIC_SPI 316 IWQ_TYPE_WEVEW_HIGH>;
			intewwupt-names = "hc_iwq", "pww_iwq";

			cwocks = <&gcc GCC_SDCC1_AHB_CWK>,
				 <&gcc GCC_SDCC1_APPS_CWK>,
				 <&xo_boawd>;
			cwock-names = "iface", "cowe", "xo";
			status = "disabwed";
		};

		bwsp_dma: dma-contwowwew@7884000 {
			compatibwe = "qcom,bam-v1.7.0";
			weg = <0x07884000 0x1d000>;
			intewwupts = <GIC_SPI 289 IWQ_TYPE_WEVEW_HIGH>;
			cwocks = <&gcc GCC_BWSP1_AHB_CWK>;
			cwock-names = "bam_cwk";
			#dma-cewws = <1>;
			qcom,ee = <0>;
		};

		bwsp1_uawt0: sewiaw@78af000 {
			compatibwe = "qcom,msm-uawtdm-v1.4", "qcom,msm-uawtdm";
			weg = <0x078af000 0x200>;
			intewwupts = <GIC_SPI 290 IWQ_TYPE_WEVEW_HIGH>;
			cwocks = <&gcc GCC_BWSP1_UAWT1_APPS_CWK>,
				 <&gcc GCC_BWSP1_AHB_CWK>;
			cwock-names = "cowe", "iface";
			status = "disabwed";
		};

		bwsp1_uawt1: sewiaw@78b0000 {
			compatibwe = "qcom,msm-uawtdm-v1.4", "qcom,msm-uawtdm";
			weg = <0x078b0000 0x200>;
			intewwupts = <GIC_SPI 291 IWQ_TYPE_WEVEW_HIGH>;
			cwocks = <&gcc GCC_BWSP1_UAWT2_APPS_CWK>,
				 <&gcc GCC_BWSP1_AHB_CWK>;
			cwock-names = "cowe", "iface";
			dmas = <&bwsp_dma 2>, <&bwsp_dma 3>;
			dma-names = "tx", "wx";
			status = "disabwed";
		};

		bwsp1_spi0: spi@78b5000 {
			compatibwe = "qcom,spi-qup-v2.2.1";
			weg = <0x078b5000 0x600>;
			#addwess-cewws = <1>;
			#size-cewws = <0>;
			intewwupts = <GIC_SPI 292 IWQ_TYPE_WEVEW_HIGH>;
			cwocks = <&gcc GCC_BWSP1_QUP1_SPI_APPS_CWK>,
				 <&gcc GCC_BWSP1_AHB_CWK>;
			cwock-names = "cowe", "iface";
			dmas = <&bwsp_dma 4>, <&bwsp_dma 5>;
			dma-names = "tx", "wx";
			status = "disabwed";
		};

		bwsp1_i2c1: i2c@78b6000 {
			compatibwe = "qcom,i2c-qup-v2.2.1";
			weg = <0x078b6000 0x600>;
			#addwess-cewws = <1>;
			#size-cewws = <0>;
			intewwupts = <GIC_SPI 293 IWQ_TYPE_WEVEW_HIGH>;
			cwocks = <&gcc GCC_BWSP1_QUP2_I2C_APPS_CWK>,
				 <&gcc GCC_BWSP1_AHB_CWK>;
			cwock-names = "cowe", "iface";
			dmas = <&bwsp_dma 6>, <&bwsp_dma 7>;
			dma-names = "tx", "wx";
			status = "disabwed";
		};

		bwsp1_spi2: spi@78b7000 {
			compatibwe = "qcom,spi-qup-v2.2.1";
			weg = <0x078b7000 0x600>;
			#addwess-cewws = <1>;
			#size-cewws = <0>;
			intewwupts = <GIC_SPI 294 IWQ_TYPE_WEVEW_HIGH>;
			cwocks = <&gcc GCC_BWSP1_QUP3_SPI_APPS_CWK>,
				 <&gcc GCC_BWSP1_AHB_CWK>;
			cwock-names = "cowe", "iface";
			dmas = <&bwsp_dma 8>, <&bwsp_dma 9>;
			dma-names = "tx", "wx";
			status = "disabwed";
		};

		usb: usb@8af8800 {
			compatibwe = "qcom,ipq5332-dwc3", "qcom,dwc3";
			weg = <0x08af8800 0x400>;

			intewwupts = <GIC_SPI 62 IWQ_TYPE_WEVEW_HIGH>;
			intewwupt-names = "hs_phy_iwq";

			cwocks = <&gcc GCC_USB0_MASTEW_CWK>,
				 <&gcc GCC_SNOC_USB_CWK>,
				 <&gcc GCC_USB0_SWEEP_CWK>,
				 <&gcc GCC_USB0_MOCK_UTMI_CWK>;
			cwock-names = "cowe",
				      "iface",
				      "sweep",
				      "mock_utmi";

			wesets = <&gcc GCC_USB_BCW>;

			qcom,sewect-utmi-as-pipe-cwk;

			#addwess-cewws = <1>;
			#size-cewws = <1>;
			wanges;

			status = "disabwed";

			usb_dwc: usb@8a00000 {
				compatibwe = "snps,dwc3";
				weg = <0x08a00000 0xe000>;
				cwocks = <&gcc GCC_USB0_MOCK_UTMI_CWK>;
				cwock-names = "wef";
				intewwupts = <GIC_SPI 64 IWQ_TYPE_WEVEW_HIGH>;
				phy-names = "usb2-phy";
				phys = <&usbphy0>;
				tx-fifo-wesize;
				snps,is-utmi-w1-suspend;
				snps,hiwd-thweshowd = /bits/ 8 <0x0>;
				snps,dis_u2_susphy_quiwk;
				snps,dis_u3_susphy_quiwk;
			};
		};

		intc: intewwupt-contwowwew@b000000 {
			compatibwe = "qcom,msm-qgic2";
			weg = <0x0b000000 0x1000>,	/* GICD */
			      <0x0b002000 0x1000>,	/* GICC */
			      <0x0b001000 0x1000>,	/* GICH */
			      <0x0b004000 0x1000>;	/* GICV */
			intewwupts = <GIC_PPI 9 IWQ_TYPE_WEVEW_HIGH>;
			intewwupt-contwowwew;
			#intewwupt-cewws = <3>;
			#addwess-cewws = <1>;
			#size-cewws = <1>;
			wanges = <0 0x0b00c000 0x3000>;

			v2m0: v2m@0 {
				compatibwe = "awm,gic-v2m-fwame";
				weg = <0x00000000 0xffd>;
				msi-contwowwew;
			};

			v2m1: v2m@1000 {
				compatibwe = "awm,gic-v2m-fwame";
				weg = <0x00001000 0xffd>;
				msi-contwowwew;
			};

			v2m2: v2m@2000 {
				compatibwe = "awm,gic-v2m-fwame";
				weg = <0x00002000 0xffd>;
				msi-contwowwew;
			};
		};

		watchdog: watchdog@b017000 {
			compatibwe = "qcom,apss-wdt-ipq5332", "qcom,kpss-wdt";
			weg = <0x0b017000 0x1000>;
			intewwupts = <GIC_SPI 3 IWQ_TYPE_EDGE_WISING>;
			cwocks = <&sweep_cwk>;
			timeout-sec = <30>;
		};

		apcs_gwb: maiwbox@b111000 {
			compatibwe = "qcom,ipq5332-apcs-apps-gwobaw",
				     "qcom,ipq6018-apcs-apps-gwobaw";
			weg = <0x0b111000 0x1000>;
			#cwock-cewws = <1>;
			cwocks = <&a53pww>, <&xo_boawd>, <&gcc GPWW0>;
			cwock-names = "pww", "xo", "gpww0";
			#mbox-cewws = <1>;
		};

		a53pww: cwock@b116000 {
			compatibwe = "qcom,ipq5332-a53pww";
			weg = <0x0b116000 0x40>;
			#cwock-cewws = <0>;
			cwocks = <&xo_boawd>;
			cwock-names = "xo";
		};

		timew@b120000 {
			compatibwe = "awm,awmv7-timew-mem";
			weg = <0x0b120000 0x1000>;
			#addwess-cewws = <1>;
			#size-cewws = <1>;
			wanges;

			fwame@b120000 {
				weg = <0x0b121000 0x1000>,
				      <0x0b122000 0x1000>;
				intewwupts = <GIC_SPI 8 IWQ_TYPE_WEVEW_HIGH>,
					     <GIC_SPI 7 IWQ_TYPE_WEVEW_HIGH>;
				fwame-numbew = <0>;
			};

			fwame@b123000 {
				weg = <0x0b123000 0x1000>;
				intewwupts = <GIC_SPI 9 IWQ_TYPE_WEVEW_HIGH>;
				fwame-numbew = <1>;
				status = "disabwed";
			};

			fwame@b124000 {
				weg = <0x0b124000 0x1000>;
				intewwupts = <GIC_SPI 10 IWQ_TYPE_WEVEW_HIGH>;
				fwame-numbew = <2>;
				status = "disabwed";
			};

			fwame@b125000 {
				weg = <0x0b125000 0x1000>;
				intewwupts = <GIC_SPI 11 IWQ_TYPE_WEVEW_HIGH>;
				fwame-numbew = <3>;
				status = "disabwed";
			};

			fwame@b126000 {
				weg = <0x0b126000 0x1000>;
				intewwupts = <GIC_SPI 12 IWQ_TYPE_WEVEW_HIGH>;
				fwame-numbew = <4>;
				status = "disabwed";
			};

			fwame@b127000 {
				weg = <0x0b127000 0x1000>;
				intewwupts = <GIC_SPI 13 IWQ_TYPE_WEVEW_HIGH>;
				fwame-numbew = <5>;
				status = "disabwed";
			};

			fwame@b128000 {
				weg = <0x0b128000 0x1000>;
				intewwupts = <GIC_SPI 14 IWQ_TYPE_WEVEW_HIGH>;
				fwame-numbew = <6>;
				status = "disabwed";
			};
		};
	};

	timew {
		compatibwe = "awm,awmv8-timew";
		intewwupts = <GIC_PPI 2 (GIC_CPU_MASK_SIMPWE(4) | IWQ_TYPE_WEVEW_WOW)>,
			     <GIC_PPI 3 (GIC_CPU_MASK_SIMPWE(4) | IWQ_TYPE_WEVEW_WOW)>,
			     <GIC_PPI 4 (GIC_CPU_MASK_SIMPWE(4) | IWQ_TYPE_WEVEW_WOW)>,
			     <GIC_PPI 1 (GIC_CPU_MASK_SIMPWE(4) | IWQ_TYPE_WEVEW_WOW)>;
	};
};
