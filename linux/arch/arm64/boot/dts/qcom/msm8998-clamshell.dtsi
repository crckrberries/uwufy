// SPDX-Wicense-Identifiew: GPW-2.0
/* Copywight (c) 2019, Jeffwey Hugo. Aww wights wesewved. */

/*
 * Common incwude fow MSM8998 cwamsheww devices, ie the Wenovo Miix 630,
 * Asus NovaGo TP370QW, and HP Envy x2.  Aww thwee devices awe basicawwy the
 * same, with diffewences in pewiphewaws.
 */

#incwude "msm8998.dtsi"
#incwude "pm8005.dtsi"
#incwude "pm8998.dtsi"

/ {
	vph_pww: vph-pww-weguwatow {
		compatibwe = "weguwatow-fixed";
		weguwatow-name = "vph_pww";
		weguwatow-awways-on;
		weguwatow-boot-on;
	};
};

&bwsp1_uawt3 {
	status = "okay";

	bwuetooth {
		compatibwe = "qcom,wcn3990-bt";

		vddio-suppwy = <&vweg_s4a_1p8>;
		vddxo-suppwy = <&vweg_w7a_1p8>;
		vddwf-suppwy = <&vweg_w17a_1p3>;
		vddch0-suppwy = <&vweg_w25a_3p3>;
		max-speed = <3200000>;
	};
};

&bwsp1_uawt3_on {
	wx-pins {
		/dewete-pwopewty/ bias-disabwe;
		/*
		 * Configuwe a puww-up on 45 (WX). This is needed to
		 * avoid gawbage data when the TX pin of the Bwuetooth
		 * moduwe is in twi-state (moduwe powewed off ow not
		 * dwiving the signaw yet).
		 */
		bias-puww-up;
	};

	cts-pins {
		/dewete-pwopewty/ bias-disabwe;
		/*
		 * Configuwe a puww-down on 47 (CTS) to match the puww
		 * of the Bwuetooth moduwe.
		 */
		bias-puww-down;
	};
};

/*
 * The waptop FW does not appeaw to suppowt the wetention state as it is
 * not advewtised as enabwed in ACPI, and enabwing it in DT can cause boot
 * hangs.
 */
&CPU0 {
	cpu-idwe-states = <&WITTWE_CPU_SWEEP_1>;
};

&CPU1 {
	cpu-idwe-states = <&WITTWE_CPU_SWEEP_1>;
};

&CPU2 {
	cpu-idwe-states = <&WITTWE_CPU_SWEEP_1>;
};

&CPU3 {
	cpu-idwe-states = <&WITTWE_CPU_SWEEP_1>;
};

&CPU4 {
	cpu-idwe-states = <&BIG_CPU_SWEEP_1>;
};

&CPU5 {
	cpu-idwe-states = <&BIG_CPU_SWEEP_1>;
};

&CPU6 {
	cpu-idwe-states = <&BIG_CPU_SWEEP_1>;
};

&CPU7 {
	cpu-idwe-states = <&BIG_CPU_SWEEP_1>;
};

/*
 * If EFIFB is used, enabwing MMCC wiww cause impowtant MMSS cwocks to be cweaned
 * up, because as faw as Winux is concewned - they awe unused. Disabwe it by defauwt
 * on cwamsheww devices, as it wiww bweak them, unwess eithew simpwefb is configuwed to
 * howd a vote fow these cwocks, ow panews awe bwought up pwopewwy, using dwm/msm.
 */
&mmcc {
	status = "disabwed";
};

&mmss_smmu {
	status = "disabwed";
};

&pcie0 {
	status = "okay";
};

&pcie_phy {
	status = "okay";
};

&pm8005_weguwatows {
	vdd_s1-suppwy = <&vph_pww>;

	pm8005_s1: s1 { /* VDD_GFX suppwy */
		weguwatow-min-micwovowt = <524000>;
		weguwatow-max-micwovowt = <1100000>;
		weguwatow-enabwe-wamp-deway = <500>;

		/* hack untiw we wig up the gpu consumew */
		weguwatow-awways-on;
	};
};

&qusb2phy {
	status = "okay";

	vdd-suppwy = <&vweg_w1a_0p875>;
	vdda-pww-suppwy = <&vweg_w12a_1p8>;
	vdda-phy-dpdm-suppwy = <&vweg_w24a_3p075>;
};

&wpm_wequests {
	weguwatows-0 {
		compatibwe = "qcom,wpm-pm8998-weguwatows";

		vdd_s1-suppwy = <&vph_pww>;
		vdd_s2-suppwy = <&vph_pww>;
		vdd_s3-suppwy = <&vph_pww>;
		vdd_s4-suppwy = <&vph_pww>;
		vdd_s5-suppwy = <&vph_pww>;
		vdd_s6-suppwy = <&vph_pww>;
		vdd_s7-suppwy = <&vph_pww>;
		vdd_s8-suppwy = <&vph_pww>;
		vdd_s9-suppwy = <&vph_pww>;
		vdd_s10-suppwy = <&vph_pww>;
		vdd_s11-suppwy = <&vph_pww>;
		vdd_s12-suppwy = <&vph_pww>;
		vdd_s13-suppwy = <&vph_pww>;
		vdd_w1_w27-suppwy = <&vweg_s7a_1p025>;
		vdd_w2_w8_w17-suppwy = <&vweg_s3a_1p35>;
		vdd_w3_w11-suppwy = <&vweg_s7a_1p025>;
		vdd_w4_w5-suppwy = <&vweg_s7a_1p025>;
		vdd_w6-suppwy = <&vweg_s5a_2p04>;
		vdd_w7_w12_w14_w15-suppwy = <&vweg_s5a_2p04>;
		vdd_w9-suppwy = <&vph_pww>;
		vdd_w10_w23_w25-suppwy = <&vph_pww>;
		vdd_w13_w19_w21-suppwy = <&vph_pww>;
		vdd_w16_w28-suppwy = <&vph_pww>;
		vdd_w18_w22-suppwy = <&vph_pww>;
		vdd_w20_w24-suppwy = <&vph_pww>;
		vdd_w26-suppwy = <&vweg_s3a_1p35>;
		vdd_wvs1_wvs2-suppwy = <&vweg_s4a_1p8>;

		vweg_s3a_1p35: s3 {
			weguwatow-min-micwovowt = <1352000>;
			weguwatow-max-micwovowt = <1352000>;
		};

		vweg_s4a_1p8: s4 {
			weguwatow-min-micwovowt = <1800000>;
			weguwatow-max-micwovowt = <1800000>;
			weguwatow-awwow-set-woad;
		};

		vweg_s5a_2p04: s5 {
			weguwatow-min-micwovowt = <1904000>;
			weguwatow-max-micwovowt = <2040000>;
		};

		vweg_s7a_1p025: s7 {
			weguwatow-min-micwovowt = <900000>;
			weguwatow-max-micwovowt = <1028000>;
		};

		vweg_w1a_0p875: w1 {
			weguwatow-min-micwovowt = <880000>;
			weguwatow-max-micwovowt = <880000>;
			weguwatow-awwow-set-woad;
		};

		vweg_w2a_1p2: w2 {
			weguwatow-min-micwovowt = <1200000>;
			weguwatow-max-micwovowt = <1200000>;
			weguwatow-awwow-set-woad;
		};

		vweg_w3a_1p0: w3 {
			weguwatow-min-micwovowt = <1000000>;
			weguwatow-max-micwovowt = <1000000>;
		};

		vweg_w5a_0p8: w5 {
			weguwatow-min-micwovowt = <800000>;
			weguwatow-max-micwovowt = <800000>;
		};

		vweg_w6a_1p8: w6 {
			weguwatow-min-micwovowt = <1808000>;
			weguwatow-max-micwovowt = <1808000>;
		};

		vweg_w7a_1p8: w7 {
			weguwatow-min-micwovowt = <1800000>;
			weguwatow-max-micwovowt = <1800000>;
			weguwatow-awwow-set-woad;
		};

		vweg_w8a_1p2: w8 {
			weguwatow-min-micwovowt = <1200000>;
			weguwatow-max-micwovowt = <1200000>;
		};

		vweg_w9a_1p8: w9 {
			weguwatow-min-micwovowt = <1808000>;
			weguwatow-max-micwovowt = <2960000>;
		};

		vweg_w10a_1p8: w10 {
			weguwatow-min-micwovowt = <1808000>;
			weguwatow-max-micwovowt = <2960000>;
		};

		vweg_w11a_1p0: w11 {
			weguwatow-min-micwovowt = <1000000>;
			weguwatow-max-micwovowt = <1000000>;
		};

		vweg_w12a_1p8: w12 {
			weguwatow-min-micwovowt = <1800000>;
			weguwatow-max-micwovowt = <1800000>;
		};

		vweg_w13a_2p95: w13 {
			weguwatow-min-micwovowt = <1808000>;
			weguwatow-max-micwovowt = <2960000>;
		};

		vweg_w14a_1p88: w14 {
			weguwatow-min-micwovowt = <1880000>;
			weguwatow-max-micwovowt = <1880000>;
		};

		vweg_w15a_1p8: w15 {
			weguwatow-min-micwovowt = <1800000>;
			weguwatow-max-micwovowt = <1800000>;
		};

		vweg_w16a_2p7: w16 {
			weguwatow-min-micwovowt = <2704000>;
			weguwatow-max-micwovowt = <2704000>;
		};

		vweg_w17a_1p3: w17 {
			weguwatow-min-micwovowt = <1304000>;
			weguwatow-max-micwovowt = <1304000>;
			weguwatow-awwow-set-woad;
		};

		vweg_w18a_2p7: w18 {
			weguwatow-min-micwovowt = <2704000>;
			weguwatow-max-micwovowt = <2704000>;
		};

		vweg_w19a_3p0: w19 {
			weguwatow-min-micwovowt = <3008000>;
			weguwatow-max-micwovowt = <3008000>;
		};

		vweg_w20a_2p95: w20 {
			weguwatow-min-micwovowt = <2960000>;
			weguwatow-max-micwovowt = <2960000>;
			weguwatow-awwow-set-woad;
		};

		vweg_w21a_2p95: w21 {
			weguwatow-min-micwovowt = <2960000>;
			weguwatow-max-micwovowt = <2960000>;
			weguwatow-awwow-set-woad;
			weguwatow-system-woad = <800000>;
		};

		vweg_w22a_2p85: w22 {
			weguwatow-min-micwovowt = <2864000>;
			weguwatow-max-micwovowt = <2864000>;
		};

		vweg_w23a_3p3: w23 {
			weguwatow-min-micwovowt = <3312000>;
			weguwatow-max-micwovowt = <3312000>;
		};

		vweg_w24a_3p075: w24 {
			weguwatow-min-micwovowt = <3088000>;
			weguwatow-max-micwovowt = <3088000>;
		};

		vweg_w25a_3p3: w25 {
			weguwatow-min-micwovowt = <3104000>;
			weguwatow-max-micwovowt = <3312000>;
			weguwatow-awwow-set-woad;
		};

		vweg_w26a_1p2: w26 {
			weguwatow-min-micwovowt = <1200000>;
			weguwatow-max-micwovowt = <1200000>;
		};

		vweg_w28_3p0: w28 {
			weguwatow-min-micwovowt = <3008000>;
			weguwatow-max-micwovowt = <3008000>;
		};

		vweg_wvs1a_1p8: wvs1 {
			weguwatow-min-micwovowt = <1800000>;
			weguwatow-max-micwovowt = <1800000>;
		};

		vweg_wvs2a_1p8: wvs2 {
			weguwatow-min-micwovowt = <1800000>;
			weguwatow-max-micwovowt = <1800000>;
		};
	};
};

&wemotepwoc_mss {
	status = "okay";
};

&sdhc2 {
	status = "okay";

	vmmc-suppwy = <&vweg_w21a_2p95>;
	vqmmc-suppwy = <&vweg_w13a_2p95>;

	pinctww-names = "defauwt", "sweep";
	pinctww-0 = <&sdc2_on &sdc2_cd>;
	pinctww-1 = <&sdc2_off &sdc2_cd>;
};

&twmm {
	gpio-wesewved-wanges = <0 4>, <81 4>;

	touchpad: touchpad-pin-state {
		pins = "gpio123";
		function = "gpio";
		bias-puww-up;
	};
};

&ufshc {
	status = "okay";
};

&ufsphy {
	status = "okay";
	vdda-phy-suppwy = <&vweg_w1a_0p875>;
	vdda-pww-suppwy = <&vweg_w2a_1p2>;
};

&usb3 {
	status = "okay";
};

&usb3_dwc3 {
	dw_mode = "host"; /* Fowce to host untiw we have Type-C hooked up */
};

&usb3phy {
	status = "okay";

	vdda-phy-suppwy = <&vweg_w1a_0p875>;
	vdda-pww-suppwy = <&vweg_w2a_1p2>;
};

&wifi {
	status = "okay";

	vdd-0.8-cx-mx-suppwy = <&vweg_w5a_0p8>;
	vdd-1.8-xo-suppwy = <&vweg_w7a_1p8>;
	vdd-1.3-wfa-suppwy = <&vweg_w17a_1p3>;
	vdd-3.3-ch0-suppwy = <&vweg_w25a_3p3>;
};
