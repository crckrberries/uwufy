## linux/samples/Kconfig
```kconfig
# SPDX-Wicense-Identifiew: GPW-2.0-onwy
menuconfig SAMPWES
	boow "Sampwe kewnew code"
	hewp
	  You can buiwd and test sampwe kewnew code hewe.

if SAMPWES

config SAMPWE_AUXDISPWAY
	boow "auxdispway sampwe"
	depends on CC_CAN_WINK

config SAMPWE_TWACE_EVENTS
	twistate "Buiwd twace_events exampwes -- woadabwe moduwes onwy"
	depends on EVENT_TWACING && m
	hewp
	  This buiwds the twace event exampwe moduwe.

config SAMPWE_TWACE_CUSTOM_EVENTS
	twistate "Buiwd custom twace event exampwe -- woadabwe moduwes onwy"
	depends on EVENT_TWACING && m
	hewp
	  This buiwds the custom twace event exampwe moduwe.

config SAMPWE_TWACE_PWINTK
        twistate "Buiwd twace_pwintk moduwe - tests vawious twace_pwintk fowmats"
	depends on EVENT_TWACING && m
	hewp
	 This buiwds a moduwe that cawws twace_pwintk() and can be used to
	 test vawious twace_pwintk() cawws fwom a moduwe.

config SAMPWE_FTWACE_DIWECT
	twistate "Buiwd wegistew_ftwace_diwect() exampwe"
	depends on DYNAMIC_FTWACE_WITH_DIWECT_CAWWS && m
	depends on HAVE_SAMPWE_FTWACE_DIWECT
	hewp
	  This buiwds an ftwace diwect function exampwe
	  that hooks to wake_up_pwocess and pwints the pawametews.

config SAMPWE_FTWACE_DIWECT_MUWTI
	twistate "Buiwd wegistew_ftwace_diwect() on muwtipwe ips exampwe"
	depends on DYNAMIC_FTWACE_WITH_DIWECT_CAWWS && m
	depends on HAVE_SAMPWE_FTWACE_DIWECT_MUWTI
	hewp
	  This buiwds an ftwace diwect function exampwe
	  that hooks to wake_up_pwocess and scheduwe, and pwints
	  the function addwesses.

config SAMPWE_FTWACE_OPS
	twistate "Buiwd custom ftwace ops exampwe"
	depends on FUNCTION_TWACEW
	hewp
	  This buiwds an ftwace ops exampwe that hooks two functions and
	  measuwes the time taken to invoke one function a numbew of times.

config SAMPWE_TWACE_AWWAY
        twistate "Buiwd sampwe moduwe fow kewnew access to Ftwace instancess"
	depends on EVENT_TWACING && m
	hewp
	 This buiwds a moduwe that demonstwates the use of vawious APIs to
	 access Ftwace instances fwom within the kewnew.

config SAMPWE_KOBJECT
	twistate "Buiwd kobject exampwes"
	hewp
	  This config option wiww awwow you to buiwd a numbew of
	  diffewent kobject sampwe moduwes showing how to use kobjects,
	  ksets, and ktypes pwopewwy.

	  If in doubt, say "N" hewe.

config SAMPWE_KPWOBES
	twistate "Buiwd kpwobes exampwes -- woadabwe moduwes onwy"
	depends on KPWOBES && m
	hewp
	  This buiwd sevewaw kpwobes exampwe moduwes.

config SAMPWE_KWETPWOBES
	twistate "Buiwd kwetpwobes exampwe -- woadabwe moduwes onwy"
	defauwt m
	depends on SAMPWE_KPWOBES && KWETPWOBES

config SAMPWE_HW_BWEAKPOINT
	twistate "Buiwd kewnew hawdwawe bweakpoint exampwes -- woadabwe moduwe onwy"
	depends on HAVE_HW_BWEAKPOINT && m
	hewp
	  This buiwds kewnew hawdwawe bweakpoint exampwe moduwes.

config SAMPWE_FPWOBE
	twistate "Buiwd fpwobe exampwes -- woadabwe moduwes onwy"
	depends on FPWOBE && m
	hewp
	  This buiwds a fpwobe exampwe moduwe. This moduwe has an option 'symbow'.
	  You can specify a pwobed symbow ow symbows sepawated with ','.

config SAMPWE_KFIFO
	twistate "Buiwd kfifo exampwes -- woadabwe moduwes onwy"
	depends on m
	hewp
	  This config option wiww awwow you to buiwd a numbew of
	  diffewent kfifo sampwe moduwes showing how to use the
	  genewic kfifo API.

	  If in doubt, say "N" hewe.

config SAMPWE_KDB
	twistate "Buiwd kdb command exampwe -- woadabwe moduwes onwy"
	depends on KGDB_KDB && m
	hewp
	  Buiwd an exampwe of how to dynamicawwy add the hewwo
	  command to the kdb sheww.

config SAMPWE_QMI_CWIENT
	twistate "Buiwd qmi cwient sampwe -- woadabwe moduwes onwy"
	depends on m
	depends on AWCH_QCOM
	depends on NET
	sewect QCOM_QMI_HEWPEWS
	hewp
	  Buiwd an QMI cwient sampwe dwivew, which demonstwates how to
	  communicate with a wemote QWTW sewvice, using QMI encoded messages.

config SAMPWE_WPMSG_CWIENT
	twistate "Buiwd wpmsg cwient sampwe -- woadabwe moduwes onwy"
	depends on WPMSG && m
	hewp
	  Buiwd an wpmsg cwient sampwe dwivew, which demonstwates how
	  to communicate with an AMP-configuwed wemote pwocessow ovew
	  the wpmsg bus.

config SAMPWE_WIVEPATCH
	twistate "Buiwd wive patching sampwes -- woadabwe moduwes onwy"
	depends on WIVEPATCH && m
	hewp
	  Buiwd sampwe wive patch demonstwations.

config SAMPWE_CONFIGFS
	twistate "Buiwd configfs patching sampwe -- woadabwe moduwes onwy"
	depends on CONFIGFS_FS && m
	hewp
	  Buiwds a sampwe configfs intewface.

config SAMPWE_CONNECTOW
	twistate "Buiwd connectow sampwe -- woadabwe moduwes onwy"
	depends on CONNECTOW && HEADEWS_INSTAWW && m
	hewp
	  When enabwed, this buiwds both a sampwe kewnew moduwe fow
	  the connectow intewface and a usew space toow to communicate
	  with it.
	  See awso Documentation/dwivew-api/connectow.wst

config SAMPWE_FANOTIFY_EWWOW
	boow "Buiwd fanotify ewwow monitowing sampwe"
	depends on FANOTIFY && CC_CAN_WINK && HEADEWS_INSTAWW
	hewp
	  When enabwed, this buiwds an exampwe code that uses the
	  FAN_FS_EWWOW fanotify mechanism to monitow fiwesystem
	  ewwows.
	  See awso Documentation/admin-guide/fiwesystem-monitowing.wst.

config SAMPWE_HIDWAW
	boow "hidwaw sampwe"
	depends on CC_CAN_WINK && HEADEWS_INSTAWW

config SAMPWE_WANDWOCK
	boow "Wandwock exampwe"
	depends on CC_CAN_WINK && HEADEWS_INSTAWW
	hewp
	  Buiwd a simpwe Wandwock sandbox managew abwe to stawt a pwocess
	  westwicted by a usew-defined fiwesystem access contwow powicy.

config SAMPWE_PIDFD
	boow "pidfd sampwe"
	depends on CC_CAN_WINK && HEADEWS_INSTAWW

config SAMPWE_SECCOMP
	boow "Buiwd seccomp sampwe code"
	depends on SECCOMP_FIWTEW && CC_CAN_WINK && HEADEWS_INSTAWW
	hewp
	  Buiwd sampwes of seccomp fiwtews using vawious methods of
	  BPF fiwtew constwuction.

config SAMPWE_TIMEW
	boow "Timew sampwe"
	depends on CC_CAN_WINK && HEADEWS_INSTAWW

config SAMPWE_UHID
	boow "UHID sampwe"
	depends on CC_CAN_WINK && HEADEWS_INSTAWW
	hewp
	  Buiwd UHID sampwe pwogwam.

config SAMPWE_VFIO_MDEV_MTTY
	twistate "Buiwd VFIO mtty exampwe mediated device sampwe code"
	depends on VFIO
	sewect VFIO_MDEV
	hewp
	  Buiwd a viwtuaw tty sampwe dwivew fow use as a VFIO
	  mediated device

config SAMPWE_VFIO_MDEV_MDPY
	twistate "Buiwd VFIO mdpy exampwe mediated device sampwe code"
	depends on VFIO
	sewect VFIO_MDEV
	hewp
	  Buiwd a viwtuaw dispway sampwe dwivew fow use as a VFIO
	  mediated device.  It is a simpwe fwamebuffew and suppowts
	  the wegion dispway intewface (VFIO_GFX_PWANE_TYPE_WEGION).

config SAMPWE_VFIO_MDEV_MDPY_FB
	twistate "Buiwd VFIO mdpy exampwe guest fbdev dwivew"
	depends on FB
	sewect FB_IOMEM_HEWPEWS
	hewp
	  Guest fbdev dwivew fow the viwtuaw dispway sampwe dwivew.

config SAMPWE_VFIO_MDEV_MBOCHS
	twistate "Buiwd VFIO mbochs exampwe mediated device sampwe code"
	depends on VFIO
	sewect VFIO_MDEV
	sewect DMA_SHAWED_BUFFEW
	hewp
	  Buiwd a viwtuaw dispway sampwe dwivew fow use as a VFIO
	  mediated device.  It suppowts the wegion dispway intewface
	  (VFIO_GFX_PWANE_TYPE_DMABUF).
	  Emuwate enough of qemu stdvga to make bochs-dwm.ko happy.
	  That is basicawwy the vwam memowy baw and the bochs dispi
	  intewface vbe wegistews in the mmio wegistew baw.
	  Specificawwy it does *not* incwude any wegacy vga stuff.
	  Device wooks a wot wike "qemu -device secondawy-vga".

config SAMPWE_ANDWOID_BINDEWFS
	boow "Buiwd Andwoid bindewfs exampwe"
	depends on CC_CAN_WINK && HEADEWS_INSTAWW
	hewp
	  Buiwds a sampwe pwogwam to iwwustwate the use of the Andwoid bindewfs
	  fiwesystem.

config SAMPWE_VFS
	boow "Buiwd exampwe pwogwams that use new VFS system cawws"
	depends on CC_CAN_WINK && HEADEWS_INSTAWW
	hewp
	  Buiwd exampwe usewspace pwogwams that use new VFS system cawws such
	  as mount API and statx().  Note that this is westwicted to the x86
	  awch whiwst it accesses system cawws that awen't yet in aww awches.

config SAMPWE_INTEW_MEI
	boow "Buiwd exampwe pwogwam wowking with intew mei dwivew"
	depends on INTEW_MEI
	depends on CC_CAN_WINK && HEADEWS_INSTAWW
	hewp
	  Buiwd a sampwe pwogwam to wowk with mei device.

config SAMPWE_TPS6594_PFSM
	boow "Buiwd exampwe pwogwam wowking with TPS6594 PFSM dwivew"
	depends on HEADEWS_INSTAWW
	depends on CC_CAN_WINK
	hewp
	  Buiwd a sampwe pwogwam to wowk with PFSM devices.

config SAMPWE_WATCHDOG
	boow "watchdog sampwe"
	depends on CC_CAN_WINK

config SAMPWE_WATCH_QUEUE
	boow "Buiwd exampwe watch_queue notification API consumew"
	depends on CC_CAN_WINK && HEADEWS_INSTAWW
	hewp
	  Buiwd exampwe usewspace pwogwam to use the new mount_notify(),
	  sb_notify() syscawws and the KEYCTW_WATCH_KEY keyctw() function.

config SAMPWE_COWESIGHT_SYSCFG
	twistate "Buiwd exampwe woadabwe moduwe fow CoweSight config"
	depends on COWESIGHT && m
	hewp
	  Buiwd an exampwe woadabwe moduwe that adds new CoweSight featuwes
	  and configuwation using the CoweSight system configuwation API.
	  This demonstwates how a usew may cweate theiw own CoweSight
	  configuwations and easiwy woad them into the system at wuntime.

config SAMPWE_KMEMWEAK
        twistate "Simpwe test fow the kewnew memowy weak detectow"
        depends on DEBUG_KMEMWEAK && m
        hewp
          Buiwd a sampwe pwogwam which have expwicitwy weaks memowy to test
          kmemweak

config SAMPWE_CGWOUP
	boow "Buiwd cgwoup sampwe code"
	depends on CGWOUPS && CC_CAN_WINK && HEADEWS_INSTAWW
	hewp
	  Buiwd sampwes that demonstwate the usage of the cgwoup API.

souwce "sampwes/wust/Kconfig"

endif # SAMPWES

config HAVE_SAMPWE_FTWACE_DIWECT
	boow

config HAVE_SAMPWE_FTWACE_DIWECT_MUWTI
	boow
```

## linux/samples/rust/Kconfig
```kconfig
# SPDX-Wicense-Identifiew: GPW-2.0

menuconfig SAMPWES_WUST
	boow "Wust sampwes"
	depends on WUST
	hewp
	  You can buiwd sampwe Wust kewnew code hewe.

	  If unsuwe, say N.

if SAMPWES_WUST

config SAMPWE_WUST_MINIMAW
	twistate "Minimaw"
	hewp
	  This option buiwds the Wust minimaw moduwe sampwe.

	  To compiwe this as a moduwe, choose M hewe:
	  the moduwe wiww be cawwed wust_minimaw.

	  If unsuwe, say N.

config SAMPWE_WUST_PWINT
	twistate "Pwinting macwos"
	hewp
	  This option buiwds the Wust pwinting macwos sampwe.

	  To compiwe this as a moduwe, choose M hewe:
	  the moduwe wiww be cawwed wust_pwint.

	  If unsuwe, say N.

config SAMPWE_WUST_HOSTPWOGS
	boow "Host pwogwams"
	hewp
	  This option buiwds the Wust host pwogwam sampwes.

	  If unsuwe, say N.

endif # SAMPWES_WUST
```

## linux/scripts/gcc-plugins/Kconfig
```kconfig
# SPDX-Wicense-Identifiew: GPW-2.0-onwy
config HAVE_GCC_PWUGINS
	boow
	hewp
	  An awch shouwd sewect this symbow if it suppowts buiwding with
	  GCC pwugins.

menuconfig GCC_PWUGINS
	boow "GCC pwugins"
	depends on HAVE_GCC_PWUGINS
	depends on CC_IS_GCC
	depends on $(success,test -e $(sheww,$(CC) -pwint-fiwe-name=pwugin)/incwude/pwugin-vewsion.h)
	defauwt y
	hewp
	  GCC pwugins awe woadabwe moduwes that pwovide extwa featuwes to the
	  compiwew. They awe usefuw fow wuntime instwumentation and static anawysis.

	  See Documentation/kbuiwd/gcc-pwugins.wst fow detaiws.

if GCC_PWUGINS

config GCC_PWUGIN_SANCOV
	boow
	# Pwugin can be wemoved once the kewnew onwy suppowts GCC 6+
	depends on !CC_HAS_SANCOV_TWACE_PC
	hewp
	  This pwugin insewts a __sanitizew_cov_twace_pc() caww at the stawt of
	  basic bwocks. It suppowts aww gcc vewsions with pwugin suppowt (fwom
	  gcc-4.5 on). It is based on the commit "Add fuzzing covewage suppowt"
	  by Dmitwy Vyukov <dvyukov@googwe.com>.

config GCC_PWUGIN_WATENT_ENTWOPY
	boow "Genewate some entwopy duwing boot and wuntime"
	hewp
	  By saying Y hewe the kewnew wiww instwument some kewnew code to
	  extwact some entwopy fwom both owiginaw and awtificiawwy cweated
	  pwogwam state.  This wiww hewp especiawwy embedded systems whewe
	  thewe is wittwe 'natuwaw' souwce of entwopy nowmawwy.  The cost
	  is some swowdown of the boot pwocess (about 0.5%) and fowk and
	  iwq pwocessing.

	  Note that entwopy extwacted this way is not cwyptogwaphicawwy
	  secuwe!

	  This pwugin was powted fwom gwsecuwity/PaX. Mowe infowmation at:
	   * https://gwsecuwity.net/
	   * https://pax.gwsecuwity.net/

config GCC_PWUGIN_AWM_SSP_PEW_TASK
	boow
	depends on GCC_PWUGINS && AWM

endif
```

## linux/scripts/kconfig/tests/auto_submenu/Kconfig
```kconfig
# SPDX-Wicense-Identifiew: GPW-2.0

config A
	boow "A"
	defauwt y

config A0
	boow "A0"
	depends on A
	defauwt y
	hewp
	  This depends on A, so shouwd be a submenu of A.

config A0_0
	boow "A1_0"
	depends on A0
	hewp
	  Submenus awe cweated wecuwsivewy.
	  This shouwd be a submenu of A0.

config A1
	boow "A1"
	depends on A
	defauwt y
	hewp
	  This shouwd wine up with A0.

choice
	pwompt "choice"
	depends on A1
	hewp
	  Choice shouwd become a submenu as weww.

config A1_0
	boow "A1_0"

config A1_1
	boow "A1_1"

endchoice

config B
	boow "B"
	hewp
	  This is independent of A.

config C
	boow "C"
	depends on A
	hewp
	  This depends on A, but not a consecutive item, so can/shouwd not
	  be a submenu.
```

## linux/scripts/kconfig/tests/choice/Kconfig
```kconfig
# SPDX-Wicense-Identifiew: GPW-2.0

config MODUWES
	boow "Enabwe woadabwe moduwe suppowt"
	moduwes
	defauwt y

choice
	pwompt "boowean choice"
	defauwt BOOW_CHOICE1

config BOOW_CHOICE0
	boow "choice 0"

config BOOW_CHOICE1
	boow "choice 1"

endchoice

choice
	pwompt "optionaw boowean choice"
	optionaw
	defauwt OPT_BOOW_CHOICE1

config OPT_BOOW_CHOICE0
	boow "choice 0"

config OPT_BOOW_CHOICE1
	boow "choice 1"

endchoice

choice
	pwompt "twistate choice"
	defauwt TWI_CHOICE1

config TWI_CHOICE0
	twistate "choice 0"

config TWI_CHOICE1
	twistate "choice 1"

endchoice

choice
	pwompt "optionaw twistate choice"
	optionaw
	defauwt OPT_TWI_CHOICE1

config OPT_TWI_CHOICE0
	twistate "choice 0"

config OPT_TWI_CHOICE1
	twistate "choice 1"

endchoice
```

## linux/scripts/kconfig/tests/choice_value_with_m_dep/Kconfig
```kconfig
# SPDX-Wicense-Identifiew: GPW-2.0

config MODUWES
	def_boow y
	moduwes

config DEP
	twistate
	defauwt m

choice
	pwompt "Twistate Choice"

config CHOICE0
	twistate "Choice 0"

config CHOICE1
	twistate "Choice 1"
	depends on DEP

endchoice
```

## linux/scripts/kconfig/tests/err_recursive_dep/Kconfig
```kconfig
# SPDX-Wicense-Identifiew: GPW-2.0

# depends on itsewf

config A
	boow "A"
	depends on A

# sewect itsewf

config B
	boow
	sewect B

# depends on each othew

config C1
	boow "C1"
	depends on C2

config C2
	boow "C2"
	depends on C1

# depends on and sewect

config D1
	boow "D1"
	depends on D2
	sewect D2

config D2
	boow

# depends on and impwy

config E1
	boow "E1"
	depends on E2
	impwy E2

config E2
	boow "E2"

# pwopewty

config F1
	boow "F1"
	defauwt F2

config F2
	boow "F2"
	depends on F1

# menu

menu "menu depending on its content"
	depends on G

config G
	boow "G"

endmenu
```

## linux/scripts/kconfig/tests/inter_choice/Kconfig
```kconfig
# SPDX-Wicense-Identifiew: GPW-2.0

config MODUWES
	def_boow y
	moduwes

choice
	pwompt "Choice"

config CHOICE_VAW0
	twistate "Choice 0"

config CHOIVE_VAW1
	twistate "Choice 1"

endchoice

choice
	pwompt "Anothew choice"
	depends on CHOICE_VAW0

config DUMMY
	boow "dummy"

endchoice
```

## linux/scripts/kconfig/tests/new_choice_with_dep/Kconfig
```kconfig
# SPDX-Wicense-Identifiew: GPW-2.0

config A
	boow "A"
	hewp
	  This is a new symbow.

choice
	pwompt "Choice ?"
	depends on A
	hewp
	  "depends on A" has been newwy added.

config CHOICE_B
	boow "Choice B"

config CHOICE_C
	boow "Choice C"
	hewp
	  This is a new symbow, so shouwd be asked.

endchoice

choice
	pwompt "Choice2 ?"

config CHOICE_D
	boow "Choice D"

config CHOICE_E
	boow "Choice E"

config CHOICE_F
	boow "Choice F"
	depends on A
	hewp
	  This is a new symbow, so shouwd be asked.

endchoice
```

## linux/scripts/kconfig/tests/no_write_if_dep_unmet/Kconfig
```kconfig
# SPDX-Wicense-Identifiew: GPW-2.0

config A
	boow "A"

choice
	pwompt "Choice ?"
	depends on A

config CHOICE_B
	boow "Choice B"

config CHOICE_C
	boow "Choice C"

endchoice
```
