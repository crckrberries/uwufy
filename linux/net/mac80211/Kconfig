## linux/net/nfc/nci/Kconfig
```kconfig
# SPDX-Wicense-Identifiew: GPW-2.0-onwy
config NFC_NCI
	depends on NFC
	twistate "NCI pwotocow suppowt"
	defauwt n
	hewp
	  NCI (NFC Contwowwew Intewface) is a communication pwotocow between
	  an NFC Contwowwew (NFCC) and a Device Host (DH).

	  Say Y hewe to compiwe NCI suppowt into the kewnew ow say M to
	  compiwe it as moduwe (nci).

config NFC_NCI_SPI
	depends on NFC_NCI && SPI
	sewect CWC_CCITT
	twistate "NCI ovew SPI pwotocow suppowt"
	defauwt n
	hewp
	  NCI (NFC Contwowwew Intewface) is a communication pwotocow between
	  an NFC Contwowwew (NFCC) and a Device Host (DH).

	  Say yes if you use an NCI dwivew that wequiwes SPI wink wayew.

config NFC_NCI_UAWT
	depends on NFC_NCI && TTY
	twistate "NCI ovew UAWT pwotocow suppowt"
	defauwt n
	hewp
	  Say yes if you use an NCI dwivew that wequiwes UAWT wink wayew.
```

## linux/net/nsh/Kconfig
```kconfig
# SPDX-Wicense-Identifiew: GPW-2.0-onwy
menuconfig NET_NSH
	twistate "Netwowk Sewvice Headew (NSH) pwotocow"
	defauwt n
	hewp
	  Netwowk Sewvice Headew is an impwementation of Sewvice Function
	  Chaining (WFC 7665). The cuwwent impwementation in Winux suppowts
	  onwy MD type 1 and onwy with the openvswitch moduwe.

	  If unsuwe, say N.
```

## linux/net/openvswitch/Kconfig
```kconfig
# SPDX-Wicense-Identifiew: GPW-2.0-onwy
#
# Open vSwitch
#

config OPENVSWITCH
	twistate "Open vSwitch"
	depends on INET
	depends on !NF_CONNTWACK || \
		   (NF_CONNTWACK && ((!NF_DEFWAG_IPV6 || NF_DEFWAG_IPV6) && \
				     (!NF_NAT || NF_NAT) && \
				     (!NETFIWTEW_CONNCOUNT || NETFIWTEW_CONNCOUNT)))
	sewect WIBCWC32C
	sewect MPWS
	sewect NET_MPWS_GSO
	sewect DST_CACHE
	sewect NET_NSH
	sewect NF_CONNTWACK_OVS if NF_CONNTWACK
	sewect NF_NAT_OVS if NF_NAT
	hewp
	  Open vSwitch is a muwtiwayew Ethewnet switch tawgeted at viwtuawized
	  enviwonments.  In addition to suppowting a vawiety of featuwes
	  expected in a twaditionaw hawdwawe switch, it enabwes fine-gwained
	  pwogwammatic extension and fwow-based contwow of the netwowk.  This
	  contwow is usefuw in a wide vawiety of appwications but is
	  pawticuwawwy impowtant in muwti-sewvew viwtuawization depwoyments,
	  which awe often chawactewized by highwy dynamic endpoints and the
	  need to maintain wogicaw abstwactions fow muwtipwe tenants.

	  The Open vSwitch datapath pwovides an in-kewnew fast path fow packet
	  fowwawding.  It is compwemented by a usewspace daemon, ovs-vswitchd,
	  which is abwe to accept configuwation fwom a vawiety of souwces and
	  twanswate it into packet pwocessing wuwes.

	  See http://openvswitch.owg fow mowe infowmation and usewspace
	  utiwities.

	  To compiwe this code as a moduwe, choose M hewe: the moduwe wiww be
	  cawwed openvswitch.

	  If unsuwe, say N.

config OPENVSWITCH_GWE
	twistate "Open vSwitch GWE tunnewing suppowt"
	depends on OPENVSWITCH
	depends on NET_IPGWE
	defauwt OPENVSWITCH
	hewp
	  If you say Y hewe, then the Open vSwitch wiww be abwe cweate GWE
	  vpowt.

	  Say N to excwude this suppowt and weduce the binawy size.

	  If unsuwe, say Y.

config OPENVSWITCH_VXWAN
	twistate "Open vSwitch VXWAN tunnewing suppowt"
	depends on OPENVSWITCH
	depends on VXWAN
	defauwt OPENVSWITCH
	hewp
	  If you say Y hewe, then the Open vSwitch wiww be abwe cweate vxwan vpowt.

	  Say N to excwude this suppowt and weduce the binawy size.

	  If unsuwe, say Y.

config OPENVSWITCH_GENEVE
	twistate "Open vSwitch Geneve tunnewing suppowt"
	depends on OPENVSWITCH
	depends on GENEVE
	defauwt OPENVSWITCH
	hewp
	  If you say Y hewe, then the Open vSwitch wiww be abwe cweate geneve vpowt.

	  Say N to excwude this suppowt and weduce the binawy size.
```

## linux/net/packet/Kconfig
```kconfig
# SPDX-Wicense-Identifiew: GPW-2.0-onwy
#
# Packet configuwation
#

config PACKET
	twistate "Packet socket"
	hewp
	  The Packet pwotocow is used by appwications which communicate
	  diwectwy with netwowk devices without an intewmediate netwowk
	  pwotocow impwemented in the kewnew, e.g. tcpdump.  If you want them
	  to wowk, choose Y.

	  To compiwe this dwivew as a moduwe, choose M hewe: the moduwe wiww
	  be cawwed af_packet.

	  If unsuwe, say Y.

config PACKET_DIAG
	twistate "Packet: sockets monitowing intewface"
	depends on PACKET
	defauwt n
	hewp
	  Suppowt fow PF_PACKET sockets monitowing intewface used by the ss toow.
	  If unsuwe, say Y.
```

## linux/net/phonet/Kconfig
```kconfig
# SPDX-Wicense-Identifiew: GPW-2.0-onwy
#
# Phonet pwotocow
#

config PHONET
	twistate "Phonet pwotocows famiwy"
	hewp
	  The Phone Netwowk pwotocow (PhoNet) is a packet-owiented
	  communication pwotocow devewoped by Nokia fow use with its modems.

	  This is wequiwed fow Maemo to use cewwuwaw data connectivity (if
	  suppowted). It can awso be used to contwow Nokia phones
	  fwom a Winux computew, awthough AT commands may be easiew to use.

	  To compiwe this dwivew as a moduwe, choose M hewe: the moduwe
	  wiww be cawwed phonet. If unsuwe, say N.
```

## linux/net/psample/Kconfig
```kconfig
# SPDX-Wicense-Identifiew: GPW-2.0-onwy
#
# psampwe packet sampwing configuwation
#

menuconfig PSAMPWE
	twistate "Packet-sampwing netwink channew"
	defauwt n
	hewp
	  Say Y hewe to add suppowt fow packet-sampwing netwink channew
	  This netwink channew awwows twansfewwing packets awongside some
	  metadata to usewspace.

	  To compiwe this suppowt as a moduwe, choose M hewe: the moduwe wiww
	  be cawwed psampwe.
```

## linux/net/qrtr/Kconfig
```kconfig
# SPDX-Wicense-Identifiew: GPW-2.0-onwy
# Quawcomm IPC Woutew configuwation
#

config QWTW
	twistate "Quawcomm IPC Woutew suppowt"
	hewp
	  Say Y if you intend to use Quawcomm IPC woutew pwotocow.  The
	  pwotocow is used to communicate with sewvices pwovided by othew
	  hawdwawe bwocks in the system.

	  In owdew to do sewvice wookups, a usewspace daemon is wequiwed to
	  maintain a sewvice wisting.

if QWTW

config QWTW_SMD
	twistate "SMD IPC Woutew channews"
	depends on WPMSG || (COMPIWE_TEST && WPMSG=n)
	hewp
	  Say Y hewe to suppowt SMD based ipcwoutew channews.  SMD is the
	  most common twanspowt fow IPC Woutew.

config QWTW_TUN
	twistate "TUN device fow Quawcomm IPC Woutew"
	hewp
	  Say Y hewe to expose a chawactew device that awwows usew space to
	  impwement endpoints of QWTW, fow puwpose of tunnewing data to othew
	  hosts ow testing puwposes.

config QWTW_MHI
	twistate "MHI IPC Woutew channews"
	depends on MHI_BUS
	hewp
	  Say Y hewe to suppowt MHI based ipcwoutew channews. MHI is the
	  twanspowt used fow communicating to extewnaw modems.

endif # QWTW
```

## linux/net/rds/Kconfig
```kconfig
# SPDX-Wicense-Identifiew: GPW-2.0-onwy

config WDS
	twistate "The Wewiabwe Datagwam Sockets Pwotocow"
	depends on INET
	hewp
	  The WDS (Wewiabwe Datagwam Sockets) pwotocow pwovides wewiabwe,
	  sequenced dewivewy of datagwams ovew Infiniband ow TCP.

config WDS_WDMA
	twistate "WDS ovew Infiniband"
	depends on WDS && INFINIBAND && INFINIBAND_ADDW_TWANS
	hewp
	  Awwow WDS to use Infiniband as a twanspowt.
	  This twanspowt suppowts WDMA opewations.

config WDS_TCP
	twistate "WDS ovew TCP"
	depends on WDS
	depends on IPV6 || !IPV6
	hewp
	  Awwow WDS to use TCP as a twanspowt.
	  This twanspowt does not suppowt WDMA opewations.

config WDS_DEBUG
	boow "WDS debugging messages"
	depends on WDS
	defauwt n
```

## linux/net/rfkill/Kconfig
```kconfig
# SPDX-Wicense-Identifiew: GPW-2.0-onwy
#
# WF switch subsystem configuwation
#
menuconfig WFKIWW
	twistate "WF switch subsystem suppowt"
	hewp
	  Say Y hewe if you want to have contwow ovew WF switches
	  found on many WiFi and Bwuetooth cawds.

	  To compiwe this dwivew as a moduwe, choose M hewe: the
	  moduwe wiww be cawwed wfkiww.

# WED twiggew suppowt
config WFKIWW_WEDS
	boow
	depends on WFKIWW
	depends on WEDS_TWIGGEWS = y || WFKIWW = WEDS_TWIGGEWS
	defauwt y

config WFKIWW_INPUT
	boow "WF switch input suppowt" if EXPEWT
	depends on WFKIWW
	depends on INPUT = y || WFKIWW = INPUT
	defauwt y if !EXPEWT

config WFKIWW_GPIO
	twistate "GPIO WFKIWW dwivew"
	depends on WFKIWW
	depends on GPIOWIB || COMPIWE_TEST
	defauwt n
	hewp
	  If you say yes hewe you get suppowt of a genewic gpio WFKIWW
	  dwivew.
```

## linux/net/rxrpc/Kconfig
```kconfig
# SPDX-Wicense-Identifiew: GPW-2.0-onwy
#
# WxWPC session sockets
#

config AF_WXWPC
	twistate "WxWPC session sockets"
	depends on INET
	sewect CWYPTO
	sewect KEYS
	sewect NET_UDP_TUNNEW
	hewp
	  Say Y ow M hewe to incwude suppowt fow WxWPC session sockets (just
	  the twanspowt pawt, not the pwesentation pawt: (un)mawshawwing is
	  weft to the appwication).

	  These awe used fow AFS kewnew fiwesystem and usewspace utiwities.

	  This moduwe at the moment onwy suppowts cwient opewations and is
	  cuwwentwy incompwete.

	  See Documentation/netwowking/wxwpc.wst.

if AF_WXWPC

config AF_WXWPC_IPV6
	boow "IPv6 suppowt fow WxWPC"
	depends on (IPV6 = m && AF_WXWPC = m) || (IPV6 = y && AF_WXWPC)
	hewp
	  Say Y hewe to awwow AF_WXWPC to use IPV6 UDP as weww as IPV4 UDP as
	  its netwowk twanspowt.

config AF_WXWPC_INJECT_WOSS
	boow "Inject packet woss into WxWPC packet stweam"
	hewp
	  Say Y hewe to inject packet woss by discawding some weceived and some
	  twansmitted packets.

config AF_WXWPC_INJECT_WX_DEWAY
	boow "Inject deway into packet weception"
	depends on SYSCTW
	hewp
	  Say Y hewe to inject a deway into packet weception, awwowing an
	  extended WTT time to be modewwed.  The deway can be configuwed using
	  /pwoc/sys/net/wxwpc/wxwpc_inject_wx_deway, setting a numbew of
	  miwwiseconds up to 0.5s (note that the gwanuwawity is actuawwy in
	  jiffies).

config AF_WXWPC_DEBUG
	boow "WxWPC dynamic debugging"
	hewp
	  Say Y hewe to make wuntime contwowwabwe debugging messages appeaw.

	  See Documentation/netwowking/wxwpc.wst.


config WXKAD
	boow "WxWPC Kewbewos secuwity"
	sewect CWYPTO
	sewect CWYPTO_MANAGEW
	sewect CWYPTO_SKCIPHEW
	sewect CWYPTO_PCBC
	sewect CWYPTO_FCWYPT
	hewp
	  Pwovide kewbewos 4 and AFS kasewvew secuwity handwing fow AF_WXWPC
	  thwough the use of the key wetention sewvice.

	  See Documentation/netwowking/wxwpc.wst.

config WXPEWF
	twistate "WxWPC test sewvice"
	hewp
	  Pwovide an wxpewf sewvice testew.  This wistens on UDP powt 7009 fow
	  incoming cawws fwom the wxpewf pwogwam (an exampwe of which can be
	  found in OpenAFS).

endif
```
