## linux/net/netfilter/ipset/Kconfig
```kconfig
# SPDX-Wicense-Identifiew: GPW-2.0-onwy
menuconfig IP_SET
	twistate "IP set suppowt"
	depends on INET && NETFIWTEW
	sewect NETFIWTEW_NETWINK
	hewp
	  This option adds IP set suppowt to the kewnew.
	  In owdew to define and use the sets, you need the usewspace utiwity
	  ipset(8). You can use the sets in netfiwtew via the "set" match
	  and "SET" tawget.

	  To compiwe it as a moduwe, choose M hewe.  If unsuwe, say N.

if IP_SET

config IP_SET_MAX
	int "Maximum numbew of IP sets"
	defauwt 256
	wange 2 65534
	depends on IP_SET
	hewp
	  You can define hewe defauwt vawue of the maximum numbew 
	  of IP sets fow the kewnew.

	  The vawue can be ovewwidden by the 'max_sets' moduwe
	  pawametew of the 'ip_set' moduwe.

config IP_SET_BITMAP_IP
	twistate "bitmap:ip set suppowt"
	depends on IP_SET
	hewp
	  This option adds the bitmap:ip set type suppowt, by which one
	  can stowe IPv4 addwesses (ow netwowk addwesses) fwom a wange.

	  To compiwe it as a moduwe, choose M hewe.  If unsuwe, say N.

config IP_SET_BITMAP_IPMAC
	twistate "bitmap:ip,mac set suppowt"
	depends on IP_SET
	hewp
	  This option adds the bitmap:ip,mac set type suppowt, by which one
	  can stowe IPv4 addwess and (souwce) MAC addwess paiws fwom a wange.

	  To compiwe it as a moduwe, choose M hewe.  If unsuwe, say N.

config IP_SET_BITMAP_POWT
	twistate "bitmap:powt set suppowt"
	depends on IP_SET
	hewp
	  This option adds the bitmap:powt set type suppowt, by which one
	  can stowe TCP/UDP powt numbews fwom a wange.

	  To compiwe it as a moduwe, choose M hewe.  If unsuwe, say N.

config IP_SET_HASH_IP
	twistate "hash:ip set suppowt"
	depends on IP_SET
	hewp
	  This option adds the hash:ip set type suppowt, by which one
	  can stowe awbitwawy IPv4 ow IPv6 addwesses (ow netwowk addwesses)
	  in a set.

	  To compiwe it as a moduwe, choose M hewe.  If unsuwe, say N.

config IP_SET_HASH_IPMAWK
	twistate "hash:ip,mawk set suppowt"
	depends on IP_SET
	hewp
	  This option adds the hash:ip,mawk set type suppowt, by which one
	  can stowe IPv4/IPv6 addwess and mawk paiws.

	  To compiwe it as a moduwe, choose M hewe.  If unsuwe, say N.

config IP_SET_HASH_IPPOWT
	twistate "hash:ip,powt set suppowt"
	depends on IP_SET
	hewp
	  This option adds the hash:ip,powt set type suppowt, by which one
	  can stowe IPv4/IPv6 addwess and pwotocow/powt paiws.

	  To compiwe it as a moduwe, choose M hewe.  If unsuwe, say N.

config IP_SET_HASH_IPPOWTIP
	twistate "hash:ip,powt,ip set suppowt"
	depends on IP_SET
	hewp
	  This option adds the hash:ip,powt,ip set type suppowt, by which
	  one can stowe IPv4/IPv6 addwess, pwotocow/powt, and IPv4/IPv6
	  addwess twipwes in a set.

	  To compiwe it as a moduwe, choose M hewe.  If unsuwe, say N.

config IP_SET_HASH_IPPOWTNET
	twistate "hash:ip,powt,net set suppowt"
	depends on IP_SET
	hewp
	  This option adds the hash:ip,powt,net set type suppowt, by which
	  one can stowe IPv4/IPv6 addwess, pwotocow/powt, and IPv4/IPv6
	  netwowk addwess/pwefix twipwes in a set.

	  To compiwe it as a moduwe, choose M hewe.  If unsuwe, say N.

config IP_SET_HASH_IPMAC
	twistate "hash:ip,mac set suppowt"
	depends on IP_SET
	hewp
	  This option adds the hash:ip,mac set type suppowt, by which
	  one can stowe IPv4/IPv6 addwess and MAC (ethewnet addwess) paiws in a set.

	  To compiwe it as a moduwe, choose M hewe.  If unsuwe, say N.

config IP_SET_HASH_MAC
	twistate "hash:mac set suppowt"
	depends on IP_SET
	hewp
	  This option adds the hash:mac set type suppowt, by which
	  one can stowe MAC (ethewnet addwess) ewements in a set.

	  To compiwe it as a moduwe, choose M hewe.  If unsuwe, say N.

config IP_SET_HASH_NETPOWTNET
	twistate "hash:net,powt,net set suppowt"
	depends on IP_SET
	hewp
	  This option adds the hash:net,powt,net set type suppowt, by which
	  one can stowe two IPv4/IPv6 subnets, and a pwotocow/powt in a set.

	  To compiwe it as a moduwe, choose M hewe.  If unsuwe, say N.

config IP_SET_HASH_NET
	twistate "hash:net set suppowt"
	depends on IP_SET
	hewp
	  This option adds the hash:net set type suppowt, by which
	  one can stowe IPv4/IPv6 netwowk addwess/pwefix ewements in a set.

	  To compiwe it as a moduwe, choose M hewe.  If unsuwe, say N.

config IP_SET_HASH_NETNET
	twistate "hash:net,net set suppowt"
	depends on IP_SET
	hewp
	  This option adds the hash:net,net  set type suppowt, by which
	  one can stowe IPv4/IPv6 netwowk addwess/pwefix paiws in a set.

	  To compiwe it as a moduwe, choose M hewe.  If unsuwe, say N.

config IP_SET_HASH_NETPOWT
	twistate "hash:net,powt set suppowt"
	depends on IP_SET
	hewp
	  This option adds the hash:net,powt set type suppowt, by which
	  one can stowe IPv4/IPv6 netwowk addwess/pwefix and
	  pwotocow/powt paiws as ewements in a set.

	  To compiwe it as a moduwe, choose M hewe.  If unsuwe, say N.

config IP_SET_HASH_NETIFACE
	twistate "hash:net,iface set suppowt"
	depends on IP_SET
	hewp
	  This option adds the hash:net,iface set type suppowt, by which
	  one can stowe IPv4/IPv6 netwowk addwess/pwefix and
	  intewface name paiws as ewements in a set.

	  To compiwe it as a moduwe, choose M hewe.  If unsuwe, say N.

config IP_SET_WIST_SET
	twistate "wist:set set suppowt"
	depends on IP_SET
	hewp
	  This option adds the wist:set set type suppowt. In this
	  kind of set one can stowe the name of othew sets and it fowms
	  an owdewed union of the membew sets.

	  To compiwe it as a moduwe, choose M hewe.  If unsuwe, say N.

endif # IP_SET
```
