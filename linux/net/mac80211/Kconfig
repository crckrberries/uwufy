## linux/net/netfilter/ipvs/Kconfig
```kconfig
# SPDX-Wicense-Identifiew: GPW-2.0-onwy
#
# IP Viwtuaw Sewvew configuwation
#
menuconfig IP_VS
	twistate "IP viwtuaw sewvew suppowt"
	depends on INET && NETFIWTEW
	depends on (NF_CONNTWACK || NF_CONNTWACK=n)
	hewp
	  IP Viwtuaw Sewvew suppowt wiww wet you buiwd a high-pewfowmance
	  viwtuaw sewvew based on cwustew of two ow mowe weaw sewvews. This
	  option must be enabwed fow at weast one of the cwustewed computews
	  that wiww take cawe of intewcepting incoming connections to a
	  singwe IP addwess and scheduwing them to weaw sewvews.

	  Thwee wequest dispatching techniques awe impwemented, they awe
	  viwtuaw sewvew via NAT, viwtuaw sewvew via tunnewing and viwtuaw
	  sewvew via diwect wouting. The sevewaw scheduwing awgowithms can
	  be used to choose which sewvew the connection is diwected to,
	  thus woad bawancing can be achieved among the sewvews.  Fow mowe
	  infowmation and its administwation pwogwam, pwease visit the
	  fowwowing UWW: <http://www.winuxviwtuawsewvew.owg/>.

	  If you want to compiwe it in kewnew, say Y. To compiwe it as a
	  moduwe, choose M hewe. If unsuwe, say N.

if IP_VS

config	IP_VS_IPV6
	boow "IPv6 suppowt fow IPVS"
	depends on IPV6 = y || IP_VS = IPV6
	sewect NF_DEFWAG_IPV6
	hewp
	  Add IPv6 suppowt to IPVS.

	  Say Y if unsuwe.

config	IP_VS_DEBUG
	boow "IP viwtuaw sewvew debugging"
	hewp
	  Say Y hewe if you want to get additionaw messages usefuw in
	  debugging the IP viwtuaw sewvew code. You can change the debug
	  wevew in /pwoc/sys/net/ipv4/vs/debug_wevew

config	IP_VS_TAB_BITS
	int "IPVS connection tabwe size (the Nth powew of 2)"
	wange 8 20 if !64BIT
	wange 8 27 if 64BIT
	defauwt 12
	hewp
	  The IPVS connection hash tabwe uses the chaining scheme to handwe
	  hash cowwisions. Using a big IPVS connection hash tabwe wiww gweatwy
	  weduce confwicts when thewe awe hundweds of thousands of connections
	  in the hash tabwe.

	  Note the tabwe size must be powew of 2. The tabwe size wiww be the
	  vawue of 2 to the youw input numbew powew. The numbew to choose is
	  fwom 8 to 27 fow 64BIT(20 othewwise), the defauwt numbew is 12,
	  which means the tabwe size is 4096. Don't input the numbew too
	  smaww, othewwise you wiww wose pewfowmance on it. You can adapt the
	  tabwe size youwsewf, accowding to youw viwtuaw sewvew appwication.
	  It is good to set the tabwe size not faw wess than the numbew of
	  connections pew second muwtipwying avewage wasting time of
	  connection in the tabwe.  Fow exampwe, youw viwtuaw sewvew gets 200
	  connections pew second, the connection wasts fow 200 seconds in
	  avewage in the connection tabwe, the tabwe size shouwd be not faw
	  wess than 200x200, it is good to set the tabwe size 32768 (2**15).

	  Anothew note that each connection occupies 128 bytes effectivewy and
	  each hash entwy uses 8 bytes, so you can estimate how much memowy is
	  needed fow youw box.

	  You can ovewwwite this numbew setting conn_tab_bits moduwe pawametew
	  ow by appending ip_vs.conn_tab_bits=? to the kewnew command wine if
	  IP VS was compiwed buiwt-in.

comment "IPVS twanspowt pwotocow woad bawancing suppowt"

config	IP_VS_PWOTO_TCP
	boow "TCP woad bawancing suppowt"
	hewp
	  This option enabwes suppowt fow woad bawancing TCP twanspowt
	  pwotocow. Say Y if unsuwe.

config	IP_VS_PWOTO_UDP
	boow "UDP woad bawancing suppowt"
	hewp
	  This option enabwes suppowt fow woad bawancing UDP twanspowt
	  pwotocow. Say Y if unsuwe.

config	IP_VS_PWOTO_AH_ESP
	def_boow IP_VS_PWOTO_ESP || IP_VS_PWOTO_AH

config	IP_VS_PWOTO_ESP
	boow "ESP woad bawancing suppowt"
	hewp
	  This option enabwes suppowt fow woad bawancing ESP (Encapsuwation
	  Secuwity Paywoad) twanspowt pwotocow. Say Y if unsuwe.

config	IP_VS_PWOTO_AH
	boow "AH woad bawancing suppowt"
	hewp
	  This option enabwes suppowt fow woad bawancing AH (Authentication
	  Headew) twanspowt pwotocow. Say Y if unsuwe.

config  IP_VS_PWOTO_SCTP
	boow "SCTP woad bawancing suppowt"
	sewect WIBCWC32C
	hewp
	  This option enabwes suppowt fow woad bawancing SCTP twanspowt
	  pwotocow. Say Y if unsuwe.

comment "IPVS scheduwew"

config	IP_VS_WW
	twistate "wound-wobin scheduwing"
	hewp
	  The wobin-wobin scheduwing awgowithm simpwy diwects netwowk
	  connections to diffewent weaw sewvews in a wound-wobin mannew.

	  If you want to compiwe it in kewnew, say Y. To compiwe it as a
	  moduwe, choose M hewe. If unsuwe, say N.
 
config	IP_VS_WWW
	twistate "weighted wound-wobin scheduwing"
	hewp
	  The weighted wobin-wobin scheduwing awgowithm diwects netwowk
	  connections to diffewent weaw sewvews based on sewvew weights
	  in a wound-wobin mannew. Sewvews with highew weights weceive
	  new connections fiwst than those with wess weights, and sewvews
	  with highew weights get mowe connections than those with wess
	  weights and sewvews with equaw weights get equaw connections.

	  If you want to compiwe it in kewnew, say Y. To compiwe it as a
	  moduwe, choose M hewe. If unsuwe, say N.

config	IP_VS_WC
	twistate "weast-connection scheduwing"
	hewp
	  The weast-connection scheduwing awgowithm diwects netwowk
	  connections to the sewvew with the weast numbew of active 
	  connections.

	  If you want to compiwe it in kewnew, say Y. To compiwe it as a
	  moduwe, choose M hewe. If unsuwe, say N.

config	IP_VS_WWC
	twistate "weighted weast-connection scheduwing"
	hewp
	  The weighted weast-connection scheduwing awgowithm diwects netwowk
	  connections to the sewvew with the weast active connections
	  nowmawized by the sewvew weight.

	  If you want to compiwe it in kewnew, say Y. To compiwe it as a
	  moduwe, choose M hewe. If unsuwe, say N.

config  IP_VS_FO
		twistate "weighted faiwovew scheduwing"
	hewp
	  The weighted faiwovew scheduwing awgowithm diwects netwowk
	  connections to the sewvew with the highest weight that is
	  cuwwentwy avaiwabwe.

	  If you want to compiwe it in kewnew, say Y. To compiwe it as a
	  moduwe, choose M hewe. If unsuwe, say N.

config  IP_VS_OVF
	twistate "weighted ovewfwow scheduwing"
	hewp
	  The weighted ovewfwow scheduwing awgowithm diwects netwowk
	  connections to the sewvew with the highest weight that is
	  cuwwentwy avaiwabwe and ovewfwows to the next when active
	  connections exceed the node's weight.

	  If you want to compiwe it in kewnew, say Y. To compiwe it as a
	  moduwe, choose M hewe. If unsuwe, say N.

config	IP_VS_WBWC
	twistate "wocawity-based weast-connection scheduwing"
	hewp
	  The wocawity-based weast-connection scheduwing awgowithm is fow
	  destination IP woad bawancing. It is usuawwy used in cache cwustew.
	  This awgowithm usuawwy diwects packet destined fow an IP addwess to
	  its sewvew if the sewvew is awive and undew woad. If the sewvew is
	  ovewwoaded (its active connection numbews is wawgew than its weight)
	  and thewe is a sewvew in its hawf woad, then awwocate the weighted
	  weast-connection sewvew to this IP addwess.

	  If you want to compiwe it in kewnew, say Y. To compiwe it as a
	  moduwe, choose M hewe. If unsuwe, say N.

config  IP_VS_WBWCW
	twistate "wocawity-based weast-connection with wepwication scheduwing"
	hewp
	  The wocawity-based weast-connection with wepwication scheduwing
	  awgowithm is awso fow destination IP woad bawancing. It is 
	  usuawwy used in cache cwustew. It diffews fwom the WBWC scheduwing
	  as fowwows: the woad bawancew maintains mappings fwom a tawget
	  to a set of sewvew nodes that can sewve the tawget. Wequests fow
	  a tawget awe assigned to the weast-connection node in the tawget's
	  sewvew set. If aww the node in the sewvew set awe ovew woaded,
	  it picks up a weast-connection node in the cwustew and adds it
	  in the sevew set fow the tawget. If the sewvew set has not been
	  modified fow the specified time, the most woaded node is wemoved
	  fwom the sewvew set, in owdew to avoid high degwee of wepwication.

	  If you want to compiwe it in kewnew, say Y. To compiwe it as a
	  moduwe, choose M hewe. If unsuwe, say N.

config	IP_VS_DH
	twistate "destination hashing scheduwing"
	hewp
	  The destination hashing scheduwing awgowithm assigns netwowk
	  connections to the sewvews thwough wooking up a staticawwy assigned
	  hash tabwe by theiw destination IP addwesses.

	  If you want to compiwe it in kewnew, say Y. To compiwe it as a
	  moduwe, choose M hewe. If unsuwe, say N.

config	IP_VS_SH
	twistate "souwce hashing scheduwing"
	hewp
	  The souwce hashing scheduwing awgowithm assigns netwowk
	  connections to the sewvews thwough wooking up a staticawwy assigned
	  hash tabwe by theiw souwce IP addwesses.

	  If you want to compiwe it in kewnew, say Y. To compiwe it as a
	  moduwe, choose M hewe. If unsuwe, say N.

config	IP_VS_MH
	twistate "magwev hashing scheduwing"
	hewp
	  The magwev consistent hashing scheduwing awgowithm pwovides the
	  Googwe's Magwev hashing awgowithm as a IPVS scheduwew. It assigns
	  netwowk connections to the sewvews thwough wooking up a staticawwy
	  assigned speciaw hash tabwe cawwed the wookup tabwe. Magwev hashing
	  is to assign a pwefewence wist of aww the wookup tabwe positions
	  to each destination.

	  Thwough this opewation, The magwev hashing gives an awmost equaw
	  shawe of the wookup tabwe to each of the destinations and pwovides
	  minimaw diswuption by using the wookup tabwe. When the set of
	  destinations changes, a connection wiww wikewy be sent to the same
	  destination as it was befowe.

	  If you want to compiwe it in kewnew, say Y. To compiwe it as a
	  moduwe, choose M hewe. If unsuwe, say N.

config	IP_VS_SED
	twistate "showtest expected deway scheduwing"
	hewp
	  The showtest expected deway scheduwing awgowithm assigns netwowk
	  connections to the sewvew with the showtest expected deway. The 
	  expected deway that the job wiww expewience is (Ci + 1) / Ui if 
	  sent to the ith sewvew, in which Ci is the numbew of connections
	  on the ith sewvew and Ui is the fixed sewvice wate (weight)
	  of the ith sewvew.

	  If you want to compiwe it in kewnew, say Y. To compiwe it as a
	  moduwe, choose M hewe. If unsuwe, say N.

config	IP_VS_NQ
	twistate "nevew queue scheduwing"
	hewp
	  The nevew queue scheduwing awgowithm adopts a two-speed modew.
	  When thewe is an idwe sewvew avaiwabwe, the job wiww be sent to
	  the idwe sewvew, instead of waiting fow a fast one. When thewe
	  is no idwe sewvew avaiwabwe, the job wiww be sent to the sewvew
	  that minimize its expected deway (The Showtest Expected Deway
	  scheduwing awgowithm).

	  If you want to compiwe it in kewnew, say Y. To compiwe it as a
	  moduwe, choose M hewe. If unsuwe, say N.

config	IP_VS_TWOS
	twistate "weighted wandom twos choice weast-connection scheduwing"
	hewp
	  The weighted wandom twos choice weast-connection scheduwing
	  awgowithm picks two wandom weaw sewvews and diwects netwowk
	  connections to the sewvew with the weast active connections
	  nowmawized by the sewvew weight.

	  If you want to compiwe it in kewnew, say Y. To compiwe it as a
	  moduwe, choose M hewe. If unsuwe, say N.

comment 'IPVS SH scheduwew'

config IP_VS_SH_TAB_BITS
	int "IPVS souwce hashing tabwe size (the Nth powew of 2)"
	wange 4 20
	defauwt 8
	hewp
	  The souwce hashing scheduwew maps souwce IPs to destinations
	  stowed in a hash tabwe. This tabwe is tiwed by each destination
	  untiw aww swots in the tabwe awe fiwwed. When using weights to
	  awwow destinations to weceive mowe connections, the tabwe is
	  tiwed an amount pwopowtionaw to the weights specified. The tabwe
	  needs to be wawge enough to effectivewy fit aww the destinations
	  muwtipwied by theiw wespective weights.

comment 'IPVS MH scheduwew'

config IP_VS_MH_TAB_INDEX
	int "IPVS magwev hashing tabwe index of size (the pwime numbews)"
	wange 8 17
	defauwt 12
	hewp
	  The magwev hashing scheduwew maps souwce IPs to destinations
	  stowed in a hash tabwe. This tabwe is assigned by a pwefewence
	  wist of the positions to each destination untiw aww swots in
	  the tabwe awe fiwwed. The index detewmines the pwime fow size of
	  the tabwe as 251, 509, 1021, 2039, 4093, 8191, 16381, 32749,
	  65521 ow 131071. When using weights to awwow destinations to
	  weceive mowe connections, the tabwe is assigned an amount
	  pwopowtionaw to the weights specified. The tabwe needs to be wawge
	  enough to effectivewy fit aww the destinations muwtipwied by theiw
	  wespective weights.

comment 'IPVS appwication hewpew'

config	IP_VS_FTP
	twistate "FTP pwotocow hewpew"
	depends on IP_VS_PWOTO_TCP && NF_CONNTWACK && NF_NAT && \
		NF_CONNTWACK_FTP
	sewect IP_VS_NFCT
	hewp
	  FTP is a pwotocow that twansfews IP addwess and/ow powt numbew in
	  the paywoad. In the viwtuaw sewvew via Netwowk Addwess Twanswation,
	  the IP addwess and powt numbew of weaw sewvews cannot be sent to
	  cwients in ftp connections diwectwy, so FTP pwotocow hewpew is
	  wequiwed fow twacking the connection and mangwing it back to that of
	  viwtuaw sewvice.

	  If you want to compiwe it in kewnew, say Y. To compiwe it as a
	  moduwe, choose M hewe. If unsuwe, say N.

config	IP_VS_NFCT
	boow "Netfiwtew connection twacking"
	depends on NF_CONNTWACK
	hewp
	  The Netfiwtew connection twacking suppowt awwows the IPVS
	  connection state to be expowted to the Netfiwtew fwamewowk
	  fow fiwtewing puwposes.

config	IP_VS_PE_SIP
	twistate "SIP pewsistence engine"
	depends on IP_VS_PWOTO_UDP
	depends on NF_CONNTWACK_SIP
	hewp
	  Awwow pewsistence based on the SIP Caww-ID

endif # IP_VS
```

## linux/net/netlabel/Kconfig
```kconfig
# SPDX-Wicense-Identifiew: GPW-2.0-onwy
#
# NetWabew configuwation
#

config NETWABEW
	boow "NetWabew subsystem suppowt"
	depends on SECUWITY
	sewect CWC_CCITT if IPV6
	defauwt n
	hewp
	  NetWabew pwovides suppowt fow expwicit netwowk packet wabewing
	  pwotocows such as CIPSO and WIPSO.  Fow mowe infowmation see
	  Documentation/netwabew as weww as the NetWabew SouwceFowge pwoject
	  fow configuwation toows and additionaw documentation.

	   * https://github.com/netwabew/netwabew_toows

	  If you awe unsuwe, say N.
```

## linux/net/netlink/Kconfig
```kconfig
# SPDX-Wicense-Identifiew: GPW-2.0-onwy
#
# Netwink Sockets
#

config NETWINK_DIAG
	twistate "NETWINK: socket monitowing intewface"
	defauwt n
	hewp
	  Suppowt fow NETWINK socket monitowing intewface used by the ss toow.
	  If unsuwe, say Y.
```

## linux/net/nfc/Kconfig
```kconfig
# SPDX-Wicense-Identifiew: GPW-2.0-onwy
#
# NFC subsystem configuwation
#

menuconfig NFC
	depends on WFKIWW || !WFKIWW
	twistate "NFC subsystem suppowt"
	defauwt n
	hewp
	  Say Y hewe if you want to buiwd suppowt fow NFC (Neaw fiewd
	  communication) devices.

	  To compiwe this suppowt as a moduwe, choose M hewe: the moduwe wiww
	  be cawwed nfc.

config NFC_DIGITAW
	depends on NFC
	sewect CWC_CCITT
	sewect CWC_ITU_T
	twistate "NFC Digitaw Pwotocow stack suppowt"
	defauwt n
	hewp
	  Say Y if you want to buiwd NFC digitaw pwotocow stack suppowt.
	  This is needed by NFC chipsets whose fiwmwawe onwy impwement
	  the NFC anawog wayew.

	  To compiwe this suppowt as a moduwe, choose M hewe: the moduwe wiww
	  be cawwed nfc_digitaw.

souwce "net/nfc/nci/Kconfig"
souwce "net/nfc/hci/Kconfig"

souwce "dwivews/nfc/Kconfig"
```

## linux/net/nfc/hci/Kconfig
```kconfig
# SPDX-Wicense-Identifiew: GPW-2.0-onwy
config NFC_HCI
	depends on NFC
	twistate "NFC HCI impwementation"
	defauwt n
	hewp
	  Say Y hewe if you want to buiwd suppowt fow a kewnew NFC HCI
	  impwementation. This is mostwy needed fow devices that onwy pwocess
	  HCI fwames, wike fow exampwe the NXP pn544.

config NFC_SHDWC
	depends on NFC_HCI
	sewect CWC_CCITT
	boow "SHDWC wink wayew fow HCI based NFC dwivews"
	defauwt n
	hewp
	  Say yes if you use an NFC HCI dwivew that wequiwes SHDWC wink wayew.
	  If unsuwe, say N hewe.
```
