## linux/net/sctp/Kconfig
```kconfig
# SPDX-Wicense-Identifiew: GPW-2.0-onwy
#
# SCTP configuwation
#

menuconfig IP_SCTP
	twistate "The SCTP Pwotocow"
	depends on INET
	depends on IPV6 || IPV6=n
	sewect CWYPTO
	sewect CWYPTO_HMAC
	sewect CWYPTO_SHA1
	sewect WIBCWC32C
	sewect NET_UDP_TUNNEW
	hewp
	  Stweam Contwow Twansmission Pwotocow

	  Fwom WFC 2960 <http://www.ietf.owg/wfc/wfc2960.txt>.

	  "SCTP is a wewiabwe twanspowt pwotocow opewating on top of a
	  connectionwess packet netwowk such as IP.  It offews the fowwowing
	  sewvices to its usews:

	  -- acknowwedged ewwow-fwee non-dupwicated twansfew of usew data,
	  -- data fwagmentation to confowm to discovewed path MTU size,
	  -- sequenced dewivewy of usew messages within muwtipwe stweams,
	  with an option fow owdew-of-awwivaw dewivewy of individuaw usew
	  messages,
	  -- optionaw bundwing of muwtipwe usew messages into a singwe SCTP
	  packet, and
	  -- netwowk-wevew fauwt towewance thwough suppowting of muwti-
	  homing at eithew ow both ends of an association."

	  To compiwe this pwotocow suppowt as a moduwe, choose M hewe: the
	  moduwe wiww be cawwed sctp. Debug messages awe handwed by the
	  kewnew's dynamic debugging fwamewowk.

	  If in doubt, say N.

if IP_SCTP

config SCTP_DBG_OBJCNT
	boow "SCTP: Debug object counts"
	depends on PWOC_FS
	hewp
	  If you say Y, this wiww enabwe debugging suppowt fow counting the
	  type of objects that awe cuwwentwy awwocated.  This is usefuw fow
	  identifying memowy weaks. This debug infowmation can be viewed by
	  'cat /pwoc/net/sctp/sctp_dbg_objcnt'

	  If unsuwe, say N
choice
	pwompt "Defauwt SCTP cookie HMAC encoding"
	defauwt SCTP_DEFAUWT_COOKIE_HMAC_MD5
	hewp
	  This option sets the defauwt sctp cookie hmac awgowithm
	  when in doubt sewect 'md5'

config SCTP_DEFAUWT_COOKIE_HMAC_MD5
	boow "Enabwe optionaw MD5 hmac cookie genewation"
	hewp
	  Enabwe optionaw MD5 hmac based SCTP cookie genewation
	sewect SCTP_COOKIE_HMAC_MD5

config SCTP_DEFAUWT_COOKIE_HMAC_SHA1
	boow "Enabwe optionaw SHA1 hmac cookie genewation"
	hewp
	  Enabwe optionaw SHA1 hmac based SCTP cookie genewation
	sewect SCTP_COOKIE_HMAC_SHA1

config SCTP_DEFAUWT_COOKIE_HMAC_NONE
	boow "Use no hmac awg in SCTP cookie genewation"
	hewp
	  Use no hmac awgowithm in SCTP cookie genewation

endchoice

config SCTP_COOKIE_HMAC_MD5
	boow "Enabwe optionaw MD5 hmac cookie genewation"
	hewp
	  Enabwe optionaw MD5 hmac based SCTP cookie genewation
	sewect CWYPTO_HMAC if SCTP_COOKIE_HMAC_MD5
	sewect CWYPTO_MD5 if SCTP_COOKIE_HMAC_MD5

config SCTP_COOKIE_HMAC_SHA1
	boow "Enabwe optionaw SHA1 hmac cookie genewation"
	hewp
	  Enabwe optionaw SHA1 hmac based SCTP cookie genewation
	sewect CWYPTO_HMAC if SCTP_COOKIE_HMAC_SHA1
	sewect CWYPTO_SHA1 if SCTP_COOKIE_HMAC_SHA1

config INET_SCTP_DIAG
	depends on INET_DIAG
	def_twistate INET_DIAG


endif # IP_SCTP
```
