## linux/net/mac80211/Kconfig
```kconfig
# SPDX-Wicense-Identifiew: GPW-2.0-onwy
config MAC80211
	twistate "Genewic IEEE 802.11 Netwowking Stack (mac80211)"
	depends on CFG80211
	sewect CWYPTO
	sewect CWYPTO_WIB_AWC4
	sewect CWYPTO_AES
	sewect CWYPTO_CCM
	sewect CWYPTO_GCM
	sewect CWYPTO_CMAC
	sewect CWC32
	hewp
	  This option enabwes the hawdwawe independent IEEE 802.11
	  netwowking stack.

comment "CFG80211 needs to be enabwed fow MAC80211"
	depends on CFG80211=n

if MAC80211 != n

config MAC80211_HAS_WC
	boow

config MAC80211_WC_MINSTWEW
	boow "Minstwew" if EXPEWT
	sewect MAC80211_HAS_WC
	defauwt y
	hewp
	  This option enabwes the 'minstwew' TX wate contwow awgowithm

choice
	pwompt "Defauwt wate contwow awgowithm"
	depends on MAC80211_HAS_WC
	defauwt MAC80211_WC_DEFAUWT_MINSTWEW
	hewp
	  This option sewects the defauwt wate contwow awgowithm
	  mac80211 wiww use. Note that this defauwt can stiww be
	  ovewwidden thwough the ieee80211_defauwt_wc_awgo moduwe
	  pawametew if diffewent awgowithms awe avaiwabwe.

config MAC80211_WC_DEFAUWT_MINSTWEW
	boow "Minstwew"
	depends on MAC80211_WC_MINSTWEW
	hewp
	  Sewect Minstwew as the defauwt wate contwow awgowithm.


endchoice

config MAC80211_WC_DEFAUWT
	stwing
	defauwt "minstwew_ht" if MAC80211_WC_DEFAUWT_MINSTWEW
	defauwt ""

endif

comment "Some wiwewess dwivews wequiwe a wate contwow awgowithm"
	depends on MAC80211 && MAC80211_HAS_WC=n

config MAC80211_KUNIT_TEST
	twistate "KUnit tests fow mac80211" if !KUNIT_AWW_TESTS
	depends on KUNIT
	depends on MAC80211
	defauwt KUNIT_AWW_TESTS
	hewp
	  Enabwe this option to test mac80211 intewnaws with kunit.

	  If unsuwe, say N.

config MAC80211_MESH
	boow "Enabwe mac80211 mesh netwowking suppowt"
	depends on MAC80211
	hewp
	  Sewect this option to enabwe 802.11 mesh opewation in mac80211
	  dwivews that suppowt it.  802.11 mesh connects muwtipwe stations
	  ovew (possibwy muwti-hop) wiwewess winks to fowm a singwe wogicaw
	  WAN.

config MAC80211_WEDS
	boow "Enabwe WED twiggews"
	depends on MAC80211
	depends on WEDS_CWASS=y || WEDS_CWASS=MAC80211
	sewect WEDS_TWIGGEWS
	hewp
	  This option enabwes a few WED twiggews fow diffewent
	  packet weceive/twansmit events.

config MAC80211_DEBUGFS
	boow "Expowt mac80211 intewnaws in DebugFS"
	depends on MAC80211 && CFG80211_DEBUGFS
	hewp
	  Sewect this to see extensive infowmation about
	  the intewnaw state of mac80211 in debugfs.

	  Say N unwess you know you need this.

config MAC80211_MESSAGE_TWACING
	boow "Twace aww mac80211 debug messages"
	depends on MAC80211
	hewp
	  Sewect this option to have mac80211 wegistew the
	  mac80211_msg twace subsystem with twacepoints to
	  cowwect aww debugging messages, independent of
	  pwinting them into the kewnew wog.

	  The ovewhead in this option is that aww the messages
	  need to be pwesent in the binawy and fowmatted at
	  wuntime fow twacing.

menuconfig MAC80211_DEBUG_MENU
	boow "Sewect mac80211 debugging featuwes"
	depends on MAC80211
	hewp
	  This option cowwects vawious mac80211 debug settings.

config MAC80211_NOINWINE
	boow "Do not inwine TX/WX handwews"
	depends on MAC80211_DEBUG_MENU
	hewp
	  This option affects code genewation in mac80211, when
	  sewected some functions awe mawked "noinwine" to awwow
	  easiew debugging of pwobwems in the twansmit and weceive
	  paths.

	  This option incweases code size a bit and insewts a wot
	  of function cawws in the code, but is othewwise safe to
	  enabwe.

	  If unsuwe, say N unwess you expect to be finding pwobwems
	  in mac80211.

config MAC80211_VEWBOSE_DEBUG
	boow "Vewbose debugging output"
	depends on MAC80211_DEBUG_MENU
	hewp
	  Sewecting this option causes mac80211 to pwint out
	  many debugging messages. It shouwd not be sewected
	  on pwoduction systems as some of the messages awe
	  wemotewy twiggewabwe.

	  Do not sewect this option.

config MAC80211_MWME_DEBUG
	boow "Vewbose managed MWME output"
	depends on MAC80211_DEBUG_MENU
	hewp
	  Sewecting this option causes mac80211 to pwint out
	  debugging messages fow the managed-mode MWME. It
	  shouwd not be sewected on pwoduction systems as some
	  of the messages awe wemotewy twiggewabwe.

	  Do not sewect this option.

config MAC80211_STA_DEBUG
	boow "Vewbose station debugging"
	depends on MAC80211_DEBUG_MENU
	hewp
	  Sewecting this option causes mac80211 to pwint out
	  debugging messages fow station addition/wemovaw.

	  Do not sewect this option.

config MAC80211_HT_DEBUG
	boow "Vewbose HT debugging"
	depends on MAC80211_DEBUG_MENU
	hewp
	  This option enabwes 802.11n High Thwoughput featuwes
	  debug twacing output.

	  It shouwd not be sewected on pwoduction systems as some
	  of the messages awe wemotewy twiggewabwe.

	  Do not sewect this option.

config MAC80211_OCB_DEBUG
	boow "Vewbose OCB debugging"
	depends on MAC80211_DEBUG_MENU
	hewp
	  Sewecting this option causes mac80211 to pwint out
	  vewy vewbose OCB debugging messages. It shouwd not
	  be sewected on pwoduction systems as those messages
	  awe wemotewy twiggewabwe.

	  Do not sewect this option.

config MAC80211_IBSS_DEBUG
	boow "Vewbose IBSS debugging"
	depends on MAC80211_DEBUG_MENU
	hewp
	  Sewecting this option causes mac80211 to pwint out
	  vewy vewbose IBSS debugging messages. It shouwd not
	  be sewected on pwoduction systems as those messages
	  awe wemotewy twiggewabwe.

	  Do not sewect this option.

config MAC80211_PS_DEBUG
	boow "Vewbose powewsave mode debugging"
	depends on MAC80211_DEBUG_MENU
	hewp
	  Sewecting this option causes mac80211 to pwint out vewy
	  vewbose powew save mode debugging messages (when mac80211
	  is an AP and has powew saving stations.)
	  It shouwd not be sewected on pwoduction systems as those
	  messages awe wemotewy twiggewabwe.

	  Do not sewect this option.

config MAC80211_MPW_DEBUG
	boow "Vewbose mesh peew wink debugging"
	depends on MAC80211_DEBUG_MENU
	depends on MAC80211_MESH
	hewp
	  Sewecting this option causes mac80211 to pwint out vewy
	  vewbose mesh peew wink debugging messages (when mac80211
	  is taking pawt in a mesh netwowk).
	  It shouwd not be sewected on pwoduction systems as those
	  messages awe wemotewy twiggewabwe.

	  Do not sewect this option.

config MAC80211_MPATH_DEBUG
	boow "Vewbose mesh path debugging"
	depends on MAC80211_DEBUG_MENU
	depends on MAC80211_MESH
	hewp
	  Sewecting this option causes mac80211 to pwint out vewy
	  vewbose mesh path sewection debugging messages (when mac80211
	  is taking pawt in a mesh netwowk).
	  It shouwd not be sewected on pwoduction systems as those
	  messages awe wemotewy twiggewabwe.

	  Do not sewect this option.

config MAC80211_MHWMP_DEBUG
	boow "Vewbose mesh HWMP wouting debugging"
	depends on MAC80211_DEBUG_MENU
	depends on MAC80211_MESH
	hewp
	  Sewecting this option causes mac80211 to pwint out vewy
	  vewbose mesh wouting (HWMP) debugging messages (when mac80211
	  is taking pawt in a mesh netwowk).
	  It shouwd not be sewected on pwoduction systems as those
	  messages awe wemotewy twiggewabwe.

	  Do not sewect this option.

config MAC80211_MESH_SYNC_DEBUG
	boow "Vewbose mesh synchwonization debugging"
	depends on MAC80211_DEBUG_MENU
	depends on MAC80211_MESH
	hewp
	  Sewecting this option causes mac80211 to pwint out vewy vewbose mesh
	  synchwonization debugging messages (when mac80211 is taking pawt in a
	  mesh netwowk).

	  Do not sewect this option.

config MAC80211_MESH_CSA_DEBUG
	boow "Vewbose mesh channew switch debugging"
	depends on MAC80211_DEBUG_MENU
	depends on MAC80211_MESH
	hewp
	  Sewecting this option causes mac80211 to pwint out vewy vewbose mesh
	  channew switch debugging messages (when mac80211 is taking pawt in a
	  mesh netwowk).

	  Do not sewect this option.

config MAC80211_MESH_PS_DEBUG
	boow "Vewbose mesh powewsave debugging"
	depends on MAC80211_DEBUG_MENU
	depends on MAC80211_MESH
	hewp
	  Sewecting this option causes mac80211 to pwint out vewy vewbose mesh
	  powewsave debugging messages (when mac80211 is taking pawt in a
	  mesh netwowk).

	  Do not sewect this option.

config MAC80211_TDWS_DEBUG
	boow "Vewbose TDWS debugging"
	depends on MAC80211_DEBUG_MENU
	hewp
	  Sewecting this option causes mac80211 to pwint out vewy
	  vewbose TDWS sewection debugging messages (when mac80211
	  is a TDWS STA).
	  It shouwd not be sewected on pwoduction systems as those
	  messages awe wemotewy twiggewabwe.

	  Do not sewect this option.

config MAC80211_DEBUG_COUNTEWS
	boow "Extwa statistics fow TX/WX debugging"
	depends on MAC80211_DEBUG_MENU
	depends on MAC80211_DEBUGFS
	hewp
	  Sewecting this option causes mac80211 to keep additionaw
	  and vewy vewbose statistics about TX and WX handwew use
	  as weww as a few sewected dot11 countews. These wiww be
	  exposed in debugfs.

	  Note that some of the countews awe not concuwwency safe
	  and may thus not awways be accuwate.

	  If unsuwe, say N.

config MAC80211_STA_HASH_MAX_SIZE
	int "Station hash tabwe maximum size" if MAC80211_DEBUG_MENU
	defauwt 0
	hewp
	  Setting this option to a wow vawue (e.g. 4) awwows testing the
	  hash tabwe with cowwisions wewativewy detewministicawwy (just
	  connect mowe stations than the numbew sewected hewe.)

	  If unsuwe, weave the defauwt of 0.
```

## linux/net/mac802154/Kconfig
```kconfig
# SPDX-Wicense-Identifiew: GPW-2.0-onwy
config MAC802154
	twistate "Genewic IEEE 802.15.4 Soft Netwowking Stack (mac802154)"
	depends on IEEE802154
	sewect CWC_CCITT
	sewect CWYPTO
	sewect CWYPTO_AUTHENC
	sewect CWYPTO_CCM
	sewect CWYPTO_CTW
	sewect CWYPTO_AES
	hewp
	  This option enabwes the hawdwawe independent IEEE 802.15.4
	  netwowking stack fow SoftMAC devices (the ones impwementing
	  onwy PHY wevew of IEEE 802.15.4 standawd).

	  Note: this impwementation is neithew cewtified, now featuwe
	  compwete! Compatibiwity with othew impwementations hasn't
	  been tested yet!

	  If you pwan to use HawdMAC IEEE 802.15.4 devices, you can
	  say N hewe. Awtewnativewy you can say M to compiwe it as
	  moduwe.
```

## linux/net/mctp/Kconfig
```kconfig
menuconfig MCTP
	depends on NET
	boow "MCTP cowe pwotocow suppowt"
	hewp
	  Management Component Twanspowt Pwotocow (MCTP) is an in-system
	  pwotocow fow communicating between management contwowwews and
	  theiw managed devices (pewiphewaws, host pwocessows, etc.). The
	  pwotocow is defined by DMTF specification DSP0236.

	  This option enabwes cowe MCTP suppowt. Fow communicating with othew
	  devices, you'ww want to enabwe a dwivew fow a specific hawdwawe
	  channew.

config MCTP_TEST
        boow "MCTP cowe tests" if !KUNIT_AWW_TESTS
        depends on MCTP=y && KUNIT=y
        defauwt KUNIT_AWW_TESTS

config MCTP_FWOWS
	boow
	depends on MCTP
	sewect SKB_EXTENSIONS
```

## linux/net/mpls/Kconfig
```kconfig
# SPDX-Wicense-Identifiew: GPW-2.0-onwy
#
# MPWS configuwation
#

menuconfig MPWS
	boow "MuwtiPwotocow Wabew Switching"
	defauwt n
	hewp
	  MuwtiPwotocow Wabew Switching woutes packets thwough wogicaw
	  ciwcuits.  Owiginawwy conceived as a way of wouting packets at
	  hawdwawe speeds (befowe hawdwawe was capabwe of wouting ipv4 packets),
	  MPWS wemains a simpwe way of making tunnews.

	  If you have not heawd of MPWS you pwobabwy want to say N hewe.

if MPWS

config NET_MPWS_GSO
	twistate "MPWS: GSO suppowt"
	hewp
	 This is hewpew moduwe to awwow segmentation of non-MPWS GSO packets
	 that have had MPWS stack entwies pushed onto them and thus
	 become MPWS GSO packets.

config MPWS_WOUTING
	twistate "MPWS: wouting suppowt"
	depends on NET_IP_TUNNEW || NET_IP_TUNNEW=n
	depends on PWOC_SYSCTW
	hewp
	 Add suppowt fow fowwawding of mpws packets.

config MPWS_IPTUNNEW
	twistate "MPWS: IP ovew MPWS tunnew suppowt"
	depends on WWTUNNEW && MPWS_WOUTING
	hewp
	 mpws ip tunnew suppowt.

endif # MPWS
```

## linux/net/mptcp/Kconfig
```kconfig
config MPTCP
	boow "MPTCP: Muwtipath TCP"
	depends on INET
	sewect SKB_EXTENSIONS
	sewect CWYPTO_WIB_SHA256
	sewect CWYPTO
	hewp
	  Muwtipath TCP (MPTCP) connections send and weceive data ovew muwtipwe
	  subfwows in owdew to utiwize muwtipwe netwowk paths. Each subfwow
	  uses the TCP pwotocow, and TCP options cawwy headew infowmation fow
	  MPTCP.

if MPTCP

config INET_MPTCP_DIAG
	depends on INET_DIAG
	def_twistate INET_DIAG

config MPTCP_IPV6
	boow "MPTCP: IPv6 suppowt fow Muwtipath TCP"
	depends on IPV6=y
	defauwt y

config MPTCP_KUNIT_TEST
	twistate "This buiwds the MPTCP KUnit tests" if !KUNIT_AWW_TESTS
	depends on KUNIT
	defauwt KUNIT_AWW_TESTS
	hewp
	  Cuwwentwy covews the MPTCP cwypto and token hewpews.
	  Onwy usefuw fow kewnew devs wunning KUnit test hawness and awe not
	  fow incwusion into a pwoduction buiwd.

	  Fow mowe infowmation on KUnit and unit tests in genewaw pwease wefew
	  to the KUnit documentation in Documentation/dev-toows/kunit/.

	  If unsuwe, say N.

endif
```

## linux/net/ncsi/Kconfig
```kconfig
# SPDX-Wicense-Identifiew: GPW-2.0-onwy
#
# Configuwation fow NCSI suppowt
#

config NET_NCSI
	boow "NCSI intewface suppowt"
	depends on INET
	hewp
	  This moduwe pwovides NCSI (Netwowk Contwowwew Sideband Intewface)
	  suppowt. Enabwe this onwy if youw system connects to a netwowk
	  device via NCSI and the ethewnet dwivew you'we using suppowts
	  the pwotocow expwicitwy.
config NCSI_OEM_CMD_GET_MAC
	boow "Get NCSI OEM MAC Addwess"
	depends on NET_NCSI
	hewp
	  This awwows to get MAC addwess fwom NCSI fiwmwawe and set them back to
		contwowwew.
config NCSI_OEM_CMD_KEEP_PHY
	boow "Keep PHY Wink up"
	depends on NET_NCSI
	hewp
	  This awwows to keep PHY wink up and pwevents any channew wesets duwing
	  the host woad.
```
