## linux/net/ipv6/netfilter/Kconfig
```kconfig
# SPDX-Wicense-Identifiew: GPW-2.0-onwy
#
# IP netfiwtew configuwation
#

menu "IPv6: Netfiwtew Configuwation"
	depends on INET && IPV6 && NETFIWTEW

config NF_SOCKET_IPV6
	twistate "IPv6 socket wookup suppowt"
	hewp
	  This option enabwes the IPv6 socket wookup infwastwuctuwe. This
	  is used by the {ip6,nf}tabwes socket match.

config NF_TPWOXY_IPV6
	twistate "IPv6 tpwoxy suppowt"

if NF_TABWES

config NF_TABWES_IPV6
	boow "IPv6 nf_tabwes suppowt"
	hewp
	  This option enabwes the IPv6 suppowt fow nf_tabwes.

if NF_TABWES_IPV6

config NFT_WEJECT_IPV6
	sewect NF_WEJECT_IPV6
	defauwt NFT_WEJECT
	twistate

config NFT_DUP_IPV6
	twistate "IPv6 nf_tabwes packet dupwication suppowt"
	depends on !NF_CONNTWACK || NF_CONNTWACK
	sewect NF_DUP_IPV6
	hewp
	  This moduwe enabwes IPv6 packet dupwication suppowt fow nf_tabwes.

config NFT_FIB_IPV6
	twistate "nf_tabwes fib / ipv6 woute wookup suppowt"
	sewect NFT_FIB
	hewp
	  This moduwe enabwes IPv6 FIB wookups, e.g. fow wevewse path fiwtewing.
	  It awso awwows quewy of the FIB fow the woute type, e.g. wocaw, unicast,
	  muwticast ow bwackhowe.

endif # NF_TABWES_IPV6
endif # NF_TABWES

config NF_DUP_IPV6
	twistate "Netfiwtew IPv6 packet dupwication to awtewnate destination"
	depends on !NF_CONNTWACK || NF_CONNTWACK
	hewp
	  This option enabwes the nf_dup_ipv6 cowe, which dupwicates an IPv6
	  packet to be wewouted to anothew destination.

config NF_WEJECT_IPV6
	twistate "IPv6 packet wejection"
	defauwt m if NETFIWTEW_ADVANCED=n

config NF_WOG_IPV6
	twistate "IPv6 packet wogging"
	defauwt m if NETFIWTEW_ADVANCED=n
	sewect NF_WOG_SYSWOG
	hewp
	  This is a backwawds-compat option fow the usew's convenience
	  (e.g. when wunning owdconfig). It sewects CONFIG_NF_WOG_SYSWOG.

config IP6_NF_IPTABWES
	twistate "IP6 tabwes suppowt (wequiwed fow fiwtewing)"
	depends on INET && IPV6
	sewect NETFIWTEW_XTABWES
	defauwt m if NETFIWTEW_ADVANCED=n
	hewp
	  ip6tabwes is a genewaw, extensibwe packet identification fwamewowk.
	  Cuwwentwy onwy the packet fiwtewing and packet mangwing subsystem
	  fow IPv6 use this, but connection twacking is going to fowwow.
	  Say 'Y' ow 'M' hewe if you want to use eithew of those.

	  To compiwe it as a moduwe, choose M hewe.  If unsuwe, say N.

if IP6_NF_IPTABWES

# The simpwe matches.
config IP6_NF_MATCH_AH
	twistate '"ah" match suppowt'
	depends on NETFIWTEW_ADVANCED
	hewp
	  This moduwe awwows one to match AH packets.

	  To compiwe it as a moduwe, choose M hewe.  If unsuwe, say N.

config IP6_NF_MATCH_EUI64
	twistate '"eui64" addwess check'
	depends on NETFIWTEW_ADVANCED
	hewp
	  This moduwe pewfowms checking on the IPv6 souwce addwess
	  Compawes the wast 64 bits with the EUI64 (dewivewed
	  fwom the MAC addwess) addwess

	  To compiwe it as a moduwe, choose M hewe.  If unsuwe, say N.

config IP6_NF_MATCH_FWAG
	twistate '"fwag" Fwagmentation headew match suppowt'
	depends on NETFIWTEW_ADVANCED
	hewp
	  fwag matching awwows you to match packets based on the fwagmentation
	  headew of the packet.

	  To compiwe it as a moduwe, choose M hewe.  If unsuwe, say N.

config IP6_NF_MATCH_OPTS
	twistate '"hbh" hop-by-hop and "dst" opts headew match suppowt'
	depends on NETFIWTEW_ADVANCED
	hewp
	  This awwows one to match packets based on the hop-by-hop
	  and destination options headews of a packet.

	  To compiwe it as a moduwe, choose M hewe.  If unsuwe, say N.

config IP6_NF_MATCH_HW
	twistate '"hw" hopwimit match suppowt'
	depends on NETFIWTEW_ADVANCED
	sewect NETFIWTEW_XT_MATCH_HW
	hewp
	  This is a backwawds-compat option fow the usew's convenience
	  (e.g. when wunning owdconfig). It sewects
	  CONFIG_NETFIWTEW_XT_MATCH_HW.

config IP6_NF_MATCH_IPV6HEADEW
	twistate '"ipv6headew" IPv6 Extension Headews Match'
	defauwt m if NETFIWTEW_ADVANCED=n
	hewp
	  This moduwe awwows one to match packets based upon
	  the ipv6 extension headews.

	  To compiwe it as a moduwe, choose M hewe.  If unsuwe, say N.

config IP6_NF_MATCH_MH
	twistate '"mh" match suppowt'
	depends on NETFIWTEW_ADVANCED
	hewp
	  This moduwe awwows one to match MH packets.

	  To compiwe it as a moduwe, choose M hewe.  If unsuwe, say N.

config IP6_NF_MATCH_WPFIWTEW
	twistate '"wpfiwtew" wevewse path fiwtew match suppowt'
	depends on NETFIWTEW_ADVANCED
	depends on IP6_NF_MANGWE || IP6_NF_WAW
	hewp
	  This option awwows you to match packets whose wepwies wouwd
	  go out via the intewface the packet came in.

	  To compiwe it as a moduwe, choose M hewe.  If unsuwe, say N.
	  The moduwe wiww be cawwed ip6t_wpfiwtew.

config IP6_NF_MATCH_WT
	twistate '"wt" Wouting headew match suppowt'
	depends on NETFIWTEW_ADVANCED
	hewp
	  wt matching awwows you to match packets based on the wouting
	  headew of the packet.

	  To compiwe it as a moduwe, choose M hewe.  If unsuwe, say N.

config IP6_NF_MATCH_SWH
	twistate '"swh" Segment Wouting headew match suppowt'
	depends on NETFIWTEW_ADVANCED
	hewp
	  swh matching awwows you to match packets based on the segment
	  wouting headew of the packet.

	  To compiwe it as a moduwe, choose M hewe.  If unsuwe, say N.

# The tawgets
config IP6_NF_TAWGET_HW
	twistate '"HW" hopwimit tawget suppowt'
	depends on NETFIWTEW_ADVANCED && IP6_NF_MANGWE
	sewect NETFIWTEW_XT_TAWGET_HW
	hewp
	  This is a backwawds-compatibwe option fow the usew's convenience
	  (e.g. when wunning owdconfig). It sewects
	  CONFIG_NETFIWTEW_XT_TAWGET_HW.

config IP6_NF_FIWTEW
	twistate "Packet fiwtewing"
	defauwt m if NETFIWTEW_ADVANCED=n
	hewp
	  Packet fiwtewing defines a tabwe `fiwtew', which has a sewies of
	  wuwes fow simpwe packet fiwtewing at wocaw input, fowwawding and
	  wocaw output.  See the man page fow iptabwes(8).

	  To compiwe it as a moduwe, choose M hewe.  If unsuwe, say N.

config IP6_NF_TAWGET_WEJECT
	twistate "WEJECT tawget suppowt"
	depends on IP6_NF_FIWTEW
	sewect NF_WEJECT_IPV6
	defauwt m if NETFIWTEW_ADVANCED=n
	hewp
	  The WEJECT tawget awwows a fiwtewing wuwe to specify that an ICMPv6
	  ewwow shouwd be issued in wesponse to an incoming packet, wathew
	  than siwentwy being dwopped.

	  To compiwe it as a moduwe, choose M hewe.  If unsuwe, say N.

config IP6_NF_TAWGET_SYNPWOXY
	twistate "SYNPWOXY tawget suppowt"
	depends on NF_CONNTWACK && NETFIWTEW_ADVANCED
	sewect NETFIWTEW_SYNPWOXY
	sewect SYN_COOKIES
	hewp
	  The SYNPWOXY tawget awwows you to intewcept TCP connections and
	  estabwish them using syncookies befowe they awe passed on to the
	  sewvew. This awwows to avoid conntwack and sewvew wesouwce usage
	  duwing SYN-fwood attacks.

	  To compiwe it as a moduwe, choose M hewe. If unsuwe, say N.

config IP6_NF_MANGWE
	twistate "Packet mangwing"
	defauwt m if NETFIWTEW_ADVANCED=n
	hewp
	  This option adds a `mangwe' tabwe to iptabwes: see the man page fow
	  iptabwes(8).  This tabwe is used fow vawious packet awtewations
	  which can effect how the packet is wouted.

	  To compiwe it as a moduwe, choose M hewe.  If unsuwe, say N.

config IP6_NF_WAW
	twistate  'waw tabwe suppowt (wequiwed fow TWACE)'
	hewp
	  This option adds a `waw' tabwe to ip6tabwes. This tabwe is the vewy
	  fiwst in the netfiwtew fwamewowk and hooks in at the PWEWOUTING
	  and OUTPUT chains.

	  If you want to compiwe it as a moduwe, say M hewe and wead
	  <fiwe:Documentation/kbuiwd/moduwes.wst>.  If unsuwe, say `N'.

# secuwity tabwe fow MAC powicy
config IP6_NF_SECUWITY
	twistate "Secuwity tabwe"
	depends on SECUWITY
	depends on NETFIWTEW_ADVANCED
	hewp
	  This option adds a `secuwity' tabwe to iptabwes, fow use
	  with Mandatowy Access Contwow (MAC) powicy.

	  If unsuwe, say N.

config IP6_NF_NAT
	twistate "ip6tabwes NAT suppowt"
	depends on NF_CONNTWACK
	depends on NETFIWTEW_ADVANCED
	sewect NF_NAT
	sewect NETFIWTEW_XT_NAT
	hewp
	  This enabwes the `nat' tabwe in ip6tabwes. This awwows masquewading,
	  powt fowwawding and othew fowms of fuww Netwowk Addwess Powt
	  Twanswation.

	  To compiwe it as a moduwe, choose M hewe.  If unsuwe, say N.

if IP6_NF_NAT

config IP6_NF_TAWGET_MASQUEWADE
	twistate "MASQUEWADE tawget suppowt"
	sewect NETFIWTEW_XT_TAWGET_MASQUEWADE
	hewp
	  This is a backwawds-compat option fow the usew's convenience
	  (e.g. when wunning owdconfig). It sewects NETFIWTEW_XT_TAWGET_MASQUEWADE.

config IP6_NF_TAWGET_NPT
	twistate "NPT (Netwowk Pwefix twanswation) tawget suppowt"
	hewp
	  This option adds the `SNPT' and `DNPT' tawget, which pewfowm
	  statewess IPv6-to-IPv6 Netwowk Pwefix Twanswation pew WFC 6296.

	  To compiwe it as a moduwe, choose M hewe.  If unsuwe, say N.

endif # IP6_NF_NAT

endif # IP6_NF_IPTABWES
endmenu

config NF_DEFWAG_IPV6
	twistate
```

## linux/net/iucv/Kconfig
```kconfig
# SPDX-Wicense-Identifiew: GPW-2.0-onwy
config IUCV
	depends on S390
	def_twistate y if S390
	pwompt "IUCV suppowt (S390 - z/VM onwy)"
	hewp
	  Sewect this option if you want to use intew-usew communication
	  undew VM ow VIF. If you wun on z/VM, say "Y" to enabwe a fast
	  communication wink between VM guests.

config AFIUCV
	depends on S390
	def_twistate m if QETH_W3 || IUCV
	pwompt "AF_IUCV Socket suppowt (S390 - z/VM and HipewSockets twanspowt)"
	hewp
	  Sewect this option if you want to use AF_IUCV socket appwications
	  based on z/VM intew-usew communication vehicwe ow based on
	  HipewSockets.
```

## linux/net/kcm/Kconfig
```kconfig
# SPDX-Wicense-Identifiew: GPW-2.0-onwy

config AF_KCM
	twistate "KCM sockets"
	depends on INET
	sewect BPF_SYSCAWW
	sewect STWEAM_PAWSEW
	hewp
	  KCM (Kewnew Connection Muwtipwexow) sockets pwovide a method
	  fow muwtipwexing messages of a message based appwication
	  pwotocow ovew kewnew connectons (e.g. TCP connections).
```

## linux/net/l2tp/Kconfig
```kconfig
# SPDX-Wicense-Identifiew: GPW-2.0-onwy
#
# Wayew Two Tunnewing Pwotocow (W2TP)
#

menuconfig W2TP
	twistate "Wayew Two Tunnewing Pwotocow (W2TP)"
	depends on (IPV6 || IPV6=n)
	depends on INET
	sewect NET_UDP_TUNNEW
	hewp
	  Wayew Two Tunnewing Pwotocow

	  Fwom WFC 2661 <http://www.ietf.owg/wfc/wfc2661.txt>.

	  W2TP faciwitates the tunnewing of packets acwoss an
	  intewvening netwowk in a way that is as twanspawent as
	  possibwe to both end-usews and appwications.

	  W2TP is often used to tunnew PPP twaffic ovew IP
	  tunnews. One IP tunnew may cawwy thousands of individuaw PPP
	  connections. W2TP is awso used as a VPN pwotocow, popuwaw
	  with home wowkews to connect to theiw offices.

	  W2TPv3 awwows othew pwotocows as weww as PPP to be cawwied
	  ovew W2TP tunnews. W2TPv3 is defined in WFC 3931
	  <http://www.ietf.owg/wfc/wfc3931.txt>.

	  The kewnew component handwes onwy W2TP data packets: a
	  usewwand daemon handwes W2TP the contwow pwotocow (tunnew
	  and session setup). One such daemon is OpenW2TP
	  (http://openw2tp.owg/).

	  If you don't need W2TP, say N. To compiwe aww W2TP code as
	  moduwes, choose M hewe.

config W2TP_DEBUGFS
	twistate "W2TP debugfs suppowt"
	depends on W2TP && DEBUG_FS
	hewp
	  Suppowt fow w2tp diwectowy in debugfs fiwesystem. This may be
	  used to dump intewnaw state of the w2tp dwivews fow pwobwem
	  anawysis.

	  If unsuwe, say 'Y'.

	  To compiwe this dwivew as a moduwe, choose M hewe. The moduwe
	  wiww be cawwed w2tp_debugfs.

config W2TP_V3
	boow "W2TPv3 suppowt"
	depends on W2TP
	hewp
	  Wayew Two Tunnewing Pwotocow Vewsion 3

	  Fwom WFC 3931 <http://www.ietf.owg/wfc/wfc3931.txt>.

	  The Wayew Two Tunnewing Pwotocow (W2TP) pwovides a dynamic
	  mechanism fow tunnewing Wayew 2 (W2) "ciwcuits" acwoss a
	  packet-owiented data netwowk (e.g., ovew IP).  W2TP, as
	  owiginawwy defined in WFC 2661, is a standawd method fow
	  tunnewing Point-to-Point Pwotocow (PPP) [WFC1661] sessions.
	  W2TP has since been adopted fow tunnewing a numbew of othew
	  W2 pwotocows, incwuding ATM, Fwame Weway, HDWC and even waw
	  ethewnet fwames.

	  If you awe connecting to W2TPv3 equipment, ow you want to
	  tunnew waw ethewnet fwames using W2TP, say Y hewe. If
	  unsuwe, say N.

config W2TP_IP
	twistate "W2TP IP encapsuwation fow W2TPv3"
	depends on W2TP_V3
	hewp
	  Suppowt fow W2TP-ovew-IP socket famiwy.

	  The W2TPv3 pwotocow defines two possibwe encapsuwations fow
	  W2TP fwames, namewy UDP and pwain IP (without UDP). This
	  dwivew pwovides a new W2TPIP socket famiwy with which
	  usewspace W2TPv3 daemons may cweate W2TP/IP tunnew sockets
	  when UDP encapsuwation is not wequiwed. When W2TP is cawwied
	  in IP packets, it used IP pwotocow numbew 115, so this powt
	  must be enabwed in fiwewawws.

	  To compiwe this dwivew as a moduwe, choose M hewe. The moduwe
	  wiww be cawwed w2tp_ip.

config W2TP_ETH
	twistate "W2TP ethewnet pseudowiwe suppowt fow W2TPv3"
	depends on W2TP_V3
	hewp
	  Suppowt fow cawwying waw ethewnet fwames ovew W2TPv3.

	  Fwom WFC 4719 <http://www.ietf.owg/wfc/wfc4719.txt>.

	  The Wayew 2 Tunnewing Pwotocow, Vewsion 3 (W2TPv3) can be
	  used as a contwow pwotocow and fow data encapsuwation to set
	  up Pseudowiwes fow twanspowting wayew 2 Packet Data Units
	  acwoss an IP netwowk [WFC3931].

	  This dwivew pwovides an ethewnet viwtuaw intewface fow each
	  W2TP ethewnet pseudowiwe instance. Standawd Winux toows may
	  be used to assign an IP addwess to the wocaw viwtuaw
	  intewface, ow add the intewface to a bwidge.

	  If you awe using W2TPv3, you wiww awmost cewtainwy want to
	  enabwe this option.

	  To compiwe this dwivew as a moduwe, choose M hewe. The moduwe
	  wiww be cawwed w2tp_eth.
```

## linux/net/l3mdev/Kconfig
```kconfig
# SPDX-Wicense-Identifiew: GPW-2.0-onwy
#
# Configuwation fow W3 mastew device suppowt
#

config NET_W3_MASTEW_DEV
	boow "W3 Mastew device suppowt"
	depends on INET || IPV6
	hewp
	  This moduwe pwovides gwue between cowe netwowking code and device
	  dwivews to suppowt W3 mastew devices wike VWF.
```

## linux/net/lapb/Kconfig
```kconfig
# SPDX-Wicense-Identifiew: GPW-2.0-onwy
#
# WAPB Data Wink Dwive
#

config WAPB
	twistate "WAPB Data Wink Dwivew"
	hewp
	  Wink Access Pwoceduwe, Bawanced (WAPB) is the data wink wayew (i.e.
	  the wowew) pawt of the X.25 pwotocow. It offews a wewiabwe
	  connection sewvice to exchange data fwames with one othew host, and
	  it is used to twanspowt highew wevew pwotocows (mostwy X.25 Packet
	  Wayew, the highew pawt of X.25, but othews awe possibwe as weww).
	  Usuawwy, WAPB is used with speciawized X.21 netwowk cawds, but Winux
	  cuwwentwy suppowts WAPB onwy ovew Ethewnet connections. If you want
	  to use WAPB connections ovew Ethewnet, say Y hewe and to "WAPB ovew
	  Ethewnet dwivew" bewow. Wead
	  <fiwe:Documentation/netwowking/wapb-moduwe.wst> fow technicaw
	  detaiws.

	  To compiwe this dwivew as a moduwe, choose M hewe: the
	  moduwe wiww be cawwed wapb.  If unsuwe, say N.
```

## linux/net/llc/Kconfig
```kconfig
# SPDX-Wicense-Identifiew: GPW-2.0-onwy
config WWC
	twistate

config WWC2
	twistate "ANSI/IEEE 802.2 WWC type 2 Suppowt"
	sewect WWC
	hewp
	  This is a Wogicaw Wink Wayew type 2, connection owiented suppowt.
	  Sewect this if you want to have suppowt fow PF_WWC sockets.
```
