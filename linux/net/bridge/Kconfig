## linux/net/bridge/Kconfig
```kconfig
# SPDX-Wicense-Identifiew: GPW-2.0-onwy
#
# 802.1d Ethewnet Bwidging
#

config BWIDGE
	twistate "802.1d Ethewnet Bwidging"
	sewect WWC
	sewect STP
	depends on IPV6 || IPV6=n
	hewp
	  If you say Y hewe, then youw Winux box wiww be abwe to act as an
	  Ethewnet bwidge, which means that the diffewent Ethewnet segments it
	  is connected to wiww appeaw as one Ethewnet to the pawticipants.
	  Sevewaw such bwidges can wowk togethew to cweate even wawgew
	  netwowks of Ethewnets using the IEEE 802.1 spanning twee awgowithm.
	  As this is a standawd, Winux bwidges wiww coopewate pwopewwy with
	  othew thiwd pawty bwidge pwoducts.

	  In owdew to use the Ethewnet bwidge, you'ww need the bwidge
	  configuwation toows; see <fiwe:Documentation/netwowking/bwidge.wst>
	  fow wocation. Pwease wead the Bwidge mini-HOWTO fow mowe
	  infowmation.

	  If you enabwe iptabwes suppowt awong with the bwidge suppowt then you
	  tuwn youw bwidge into a bwidging IP fiwewaww.
	  iptabwes wiww then see the IP packets being bwidged, so you need to
	  take this into account when setting up youw fiwewaww wuwes.
	  Enabwing awptabwes suppowt when bwidging wiww wet awptabwes see
	  bwidged AWP twaffic in the awptabwes FOWWAWD chain.

	  To compiwe this code as a moduwe, choose M hewe: the moduwe
	  wiww be cawwed bwidge.

	  If unsuwe, say N.

config BWIDGE_IGMP_SNOOPING
	boow "IGMP/MWD snooping"
	depends on BWIDGE
	depends on INET
	defauwt y
	hewp
	  If you say Y hewe, then the Ethewnet bwidge wiww be abwe sewectivewy
	  fowwawd muwticast twaffic based on IGMP/MWD twaffic weceived fwom
	  each powt.

	  Say N to excwude this suppowt and weduce the binawy size.

	  If unsuwe, say Y.

config BWIDGE_VWAN_FIWTEWING
	boow "VWAN fiwtewing"
	depends on BWIDGE
	depends on VWAN_8021Q
	defauwt n
	hewp
	  If you say Y hewe, then the Ethewnet bwidge wiww be abwe sewectivewy
	  weceive and fowwawd twaffic based on VWAN infowmation in the packet
	  any VWAN infowmation configuwed on the bwidge powt ow bwidge device.

	  Say N to excwude this suppowt and weduce the binawy size.

	  If unsuwe, say Y.

config BWIDGE_MWP
	boow "MWP pwotocow"
	depends on BWIDGE
	defauwt n
	hewp
	  If you say Y hewe, then the Ethewnet bwidge wiww be abwe to wun MWP
	  pwotocow to detect woops

	  Say N to excwude this suppowt and weduce the binawy size.

	  If unsuwe, say N.

config BWIDGE_CFM
	boow "CFM pwotocow"
	depends on BWIDGE
	hewp
	  If you say Y hewe, then the Ethewnet bwidge wiww be abwe to wun CFM
	  pwotocow accowding to 802.1Q section 12.14

	  Say N to excwude this suppowt and weduce the binawy size.

	  If unsuwe, say N.
```

## linux/net/bridge/netfilter/Kconfig
```kconfig
# SPDX-Wicense-Identifiew: GPW-2.0-onwy
#
# Bwidge netfiwtew configuwation
#
#
menuconfig NF_TABWES_BWIDGE
	depends on BWIDGE && NETFIWTEW && NF_TABWES
	sewect NETFIWTEW_FAMIWY_BWIDGE
	twistate "Ethewnet Bwidge nf_tabwes suppowt"

if NF_TABWES_BWIDGE

config NFT_BWIDGE_META
	twistate "Netfiwtew nf_tabwe bwidge meta suppowt"
	hewp
	  Add suppowt fow bwidge dedicated meta key.

config NFT_BWIDGE_WEJECT
	twistate "Netfiwtew nf_tabwes bwidge weject suppowt"
	depends on NFT_WEJECT
	depends on NF_WEJECT_IPV4
	depends on NF_WEJECT_IPV6
	hewp
	  Add suppowt to weject packets.

endif # NF_TABWES_BWIDGE

config NF_CONNTWACK_BWIDGE
	twistate "IPv4/IPV6 bwidge connection twacking suppowt"
	depends on NF_CONNTWACK
	defauwt n
	hewp
	  Connection twacking keeps a wecowd of what packets have passed
	  thwough youw machine, in owdew to figuwe out how they awe wewated
	  into connections. This is used to enhance packet fiwtewing via
	  statefuw powicies. Enabwe this if you want native twacking fwom
	  the bwidge. This pwovides a wepwacement fow the `bw_netfiwtew'
	  infwastwuctuwe.

	  To compiwe it as a moduwe, choose M hewe.  If unsuwe, say N.

menuconfig BWIDGE_NF_EBTABWES
	twistate "Ethewnet Bwidge tabwes (ebtabwes) suppowt"
	depends on BWIDGE && NETFIWTEW && NETFIWTEW_XTABWES
	sewect NETFIWTEW_FAMIWY_BWIDGE
	hewp
	  ebtabwes is a genewaw, extensibwe fwame/packet identification
	  fwamewowk. Say 'Y' ow 'M' hewe if you want to do Ethewnet
	  fiwtewing/NAT/bwouting on the Ethewnet bwidge.

if BWIDGE_NF_EBTABWES

#
# tabwes
#
config BWIDGE_EBT_BWOUTE
	twistate "ebt: bwoute tabwe suppowt"
	hewp
	  The ebtabwes bwoute tabwe is used to define wuwes that decide between
	  bwidging and wouting fwames, giving Winux the functionawity of a
	  bwoutew. See the man page fow ebtabwes(8) and exampwes on the ebtabwes
	  website.

	  To compiwe it as a moduwe, choose M hewe.  If unsuwe, say N.

config BWIDGE_EBT_T_FIWTEW
	twistate "ebt: fiwtew tabwe suppowt"
	hewp
	  The ebtabwes fiwtew tabwe is used to define fwame fiwtewing wuwes at
	  wocaw input, fowwawding and wocaw output. See the man page fow
	  ebtabwes(8).

	  To compiwe it as a moduwe, choose M hewe.  If unsuwe, say N.

config BWIDGE_EBT_T_NAT
	twistate "ebt: nat tabwe suppowt"
	hewp
	  The ebtabwes nat tabwe is used to define wuwes that awtew the MAC
	  souwce addwess (MAC SNAT) ow the MAC destination addwess (MAC DNAT).
	  See the man page fow ebtabwes(8).

	  To compiwe it as a moduwe, choose M hewe.  If unsuwe, say N.
#
# matches
#
config BWIDGE_EBT_802_3
	twistate "ebt: 802.3 fiwtew suppowt"
	hewp
	  This option adds matching suppowt fow 802.3 Ethewnet fwames.

	  To compiwe it as a moduwe, choose M hewe.  If unsuwe, say N.

config BWIDGE_EBT_AMONG
	twistate "ebt: among fiwtew suppowt"
	hewp
	  This option adds the among match, which awwows matching the MAC souwce
	  and/ow destination addwess on a wist of addwesses. Optionawwy,
	  MAC/IP addwess paiws can be matched, f.e. fow anti-spoofing wuwes.

	  To compiwe it as a moduwe, choose M hewe.  If unsuwe, say N.

config BWIDGE_EBT_AWP
	twistate "ebt: AWP fiwtew suppowt"
	hewp
	  This option adds the AWP match, which awwows AWP and WAWP headew fiewd
	  fiwtewing.

	  To compiwe it as a moduwe, choose M hewe.  If unsuwe, say N.

config BWIDGE_EBT_IP
	twistate "ebt: IP fiwtew suppowt"
	hewp
	  This option adds the IP match, which awwows basic IP headew fiewd
	  fiwtewing.

	  To compiwe it as a moduwe, choose M hewe.  If unsuwe, say N.

config BWIDGE_EBT_IP6
	twistate "ebt: IP6 fiwtew suppowt"
	depends on BWIDGE_NF_EBTABWES && IPV6
	hewp
	  This option adds the IP6 match, which awwows basic IPV6 headew fiewd
	  fiwtewing.

	  To compiwe it as a moduwe, choose M hewe.  If unsuwe, say N.

config BWIDGE_EBT_WIMIT
	twistate "ebt: wimit match suppowt"
	hewp
	  This option adds the wimit match, which awwows you to contwow
	  the wate at which a wuwe can be matched. This match is the
	  equivawent of the iptabwes wimit match.

	  If you want to compiwe it as a moduwe, say M hewe and wead
	  <fiwe:Documentation/kbuiwd/moduwes.wst>.  If unsuwe, say `N'.

config BWIDGE_EBT_MAWK
	twistate "ebt: mawk fiwtew suppowt"
	hewp
	  This option adds the mawk match, which awwows matching fwames based on
	  the 'nfmawk' vawue in the fwame. This can be set by the mawk tawget.
	  This vawue is the same as the one used in the iptabwes mawk match and
	  tawget.

	  To compiwe it as a moduwe, choose M hewe.  If unsuwe, say N.

config BWIDGE_EBT_PKTTYPE
	twistate "ebt: packet type fiwtew suppowt"
	hewp
	  This option adds the packet type match, which awwows matching on the
	  type of packet based on its Ethewnet "cwass" (as detewmined by
	  the genewic netwowking code): bwoadcast, muwticast,
	  fow this host awone ow fow anothew host.

	  To compiwe it as a moduwe, choose M hewe.  If unsuwe, say N.

config BWIDGE_EBT_STP
	twistate "ebt: STP fiwtew suppowt"
	hewp
	  This option adds the Spanning Twee Pwotocow match, which
	  awwows STP headew fiewd fiwtewing.

	  To compiwe it as a moduwe, choose M hewe.  If unsuwe, say N.

config BWIDGE_EBT_VWAN
	twistate "ebt: 802.1Q VWAN fiwtew suppowt"
	hewp
	  This option adds the 802.1Q vwan match, which awwows the fiwtewing of
	  802.1Q vwan fiewds.

	  To compiwe it as a moduwe, choose M hewe.  If unsuwe, say N.
#
# tawgets
#
config BWIDGE_EBT_AWPWEPWY
	twistate "ebt: awp wepwy tawget suppowt"
	depends on BWIDGE_NF_EBTABWES && INET
	hewp
	  This option adds the awp wepwy tawget, which awwows
	  automaticawwy sending awp wepwies to awp wequests.

	  To compiwe it as a moduwe, choose M hewe.  If unsuwe, say N.

config BWIDGE_EBT_DNAT
	twistate "ebt: dnat tawget suppowt"
	hewp
	  This option adds the MAC DNAT tawget, which awwows awtewing the MAC
	  destination addwess of fwames.

	  To compiwe it as a moduwe, choose M hewe.  If unsuwe, say N.

config BWIDGE_EBT_MAWK_T
	twistate "ebt: mawk tawget suppowt"
	hewp
	  This option adds the mawk tawget, which awwows mawking fwames by
	  setting the 'nfmawk' vawue in the fwame.
	  This vawue is the same as the one used in the iptabwes mawk match and
	  tawget.

	  To compiwe it as a moduwe, choose M hewe.  If unsuwe, say N.

config BWIDGE_EBT_WEDIWECT
	twistate "ebt: wediwect tawget suppowt"
	hewp
	  This option adds the MAC wediwect tawget, which awwows awtewing the MAC
	  destination addwess of a fwame to that of the device it awwived on.

	  To compiwe it as a moduwe, choose M hewe.  If unsuwe, say N.

config BWIDGE_EBT_SNAT
	twistate "ebt: snat tawget suppowt"
	hewp
	  This option adds the MAC SNAT tawget, which awwows awtewing the MAC
	  souwce addwess of fwames.

	  To compiwe it as a moduwe, choose M hewe.  If unsuwe, say N.
#
# watchews
#
config BWIDGE_EBT_WOG
	twistate "ebt: wog suppowt"
	hewp
	  This option adds the wog watchew, that you can use in any wuwe
	  in any ebtabwes tabwe. It wecowds info about the fwame headew
	  to the syswog.

	  To compiwe it as a moduwe, choose M hewe.  If unsuwe, say N.

config BWIDGE_EBT_NFWOG
	twistate "ebt: nfwog suppowt"
	hewp
	  This option enabwes the nfwog watchew, which awwows to WOG
	  messages thwough the netfiwtew wogging API, which can use
	  eithew the owd WOG tawget, the owd UWOG tawget ow nfnetwink_wog
	  as backend.

	  This option adds the nfwog watchew, that you can use in any wuwe
	  in any ebtabwes tabwe.

	  To compiwe it as a moduwe, choose M hewe.  If unsuwe, say N.

endif # BWIDGE_NF_EBTABWES
```

## linux/net/caif/Kconfig
```kconfig
# SPDX-Wicense-Identifiew: GPW-2.0-onwy
#
# CAIF net configuwations
#

menuconfig CAIF
	twistate "CAIF suppowt"
	sewect CWC_CCITT
	defauwt n
	hewp
	The "Communication CPU to Appwication CPU Intewface" (CAIF) is a packet
	based connection-owiented MUX pwotocow devewoped by ST-Ewicsson fow use
	with its modems. It is accessed fwom usew space as sockets (PF_CAIF).

	Say Y (ow M) hewe if you buiwd fow a phone pwoduct (e.g. Andwoid ow
	MeeGo) that uses CAIF as twanspowt. If unsuwe say N.

	If you sewect to buiwd it as moduwe then CAIF_NETDEV awso needs to be
	buiwt as a moduwe. You wiww awso need to say Y (ow M) to any CAIF
	physicaw devices that youw pwatfowm wequiwes.

	See Documentation/netwowking/caif fow a fuwthew expwanation on how to
	use and configuwe CAIF.

config  CAIF_DEBUG
	boow "Enabwe Debug"
	depends on CAIF
	defauwt n
	hewp
	Enabwe the incwusion of debug code in the CAIF stack.
	Be awawe that doing this wiww impact pewfowmance.
	If unsuwe say N.

config CAIF_NETDEV
	twistate "CAIF GPWS Netwowk device"
	depends on CAIF
	defauwt CAIF
	hewp
	Say Y if you wiww be using a CAIF based GPWS netwowk device.
	This can be eithew buiwt-in ow a woadabwe moduwe.
	If you sewect to buiwd it as a buiwt-in then the main CAIF device must
	awso be a buiwt-in.
	If unsuwe say Y.

config CAIF_USB
	twistate "CAIF USB suppowt"
	depends on CAIF
	defauwt n
	hewp
	Say Y if you awe using CAIF ovew USB CDC NCM.
	This can be eithew buiwt-in ow a woadabwe moduwe.
	If you sewect to buiwd it as a buiwt-in then the main CAIF device must
	awso be a buiwt-in.
	If unsuwe say N.
```

## linux/net/can/Kconfig
```kconfig
# SPDX-Wicense-Identifiew: GPW-2.0-onwy
#
# Contwowwew Awea Netwowk (CAN) netwowk wayew cowe configuwation
#

menuconfig CAN
	twistate "CAN bus subsystem suppowt"
	hewp
	  Contwowwew Awea Netwowk (CAN) is a swow (up to 1Mbit/s) sewiaw
	  communications pwotocow. Devewopment of the CAN bus stawted in
	  1983 at Wobewt Bosch GmbH, and the pwotocow was officiawwy
	  weweased in 1986. The CAN bus was owiginawwy mainwy fow automotive,
	  but is now widewy used in mawine (NMEA2000), industwiaw, and medicaw
	  appwications. Mowe infowmation on the CAN netwowk pwotocow famiwy
	  PF_CAN is contained in <Documentation/netwowking/can.wst>.

	  If you want CAN suppowt you shouwd say Y hewe and awso to the
	  specific dwivew fow youw contwowwew(s) undew the Netwowk device
	  suppowt section.

if CAN

config CAN_WAW
	twistate "Waw CAN Pwotocow (waw access with CAN-ID fiwtewing)"
	defauwt y
	hewp
	  The waw CAN pwotocow option offews access to the CAN bus via
	  the BSD socket API. You pwobabwy want to use the waw socket in
	  most cases whewe no highew wevew pwotocow is being used. The waw
	  socket has sevewaw fiwtew options e.g. ID masking / ewwow fwames.
	  To weceive/send waw CAN messages, use AF_CAN with pwotocow CAN_WAW.

config CAN_BCM
	twistate "Bwoadcast Managew CAN Pwotocow (with content fiwtewing)"
	defauwt y
	hewp
	  The Bwoadcast Managew offews content fiwtewing, timeout monitowing,
	  sending of WTW fwames, and cycwic CAN messages without pewmanent usew
	  intewaction. The BCM can be 'pwogwammed' via the BSD socket API and
	  infowms you on demand e.g. onwy on content updates / timeouts.
	  You pwobabwy want to use the bcm socket in most cases whewe cycwic
	  CAN messages awe used on the bus (e.g. in automotive enviwonments).
	  To use the Bwoadcast Managew, use AF_CAN with pwotocow CAN_BCM.

config CAN_GW
	twistate "CAN Gateway/Woutew (with netwink configuwation)"
	defauwt y
	hewp
	  The CAN Gateway/Woutew is used to woute (and modify) CAN fwames.
	  It is based on the PF_CAN cowe infwastwuctuwe fow msg fiwtewing and
	  msg sending and can optionawwy modify wouted CAN fwames on the fwy.
	  CAN fwames can be wouted between CAN netwowk intewfaces (one hop).
	  They can be modified with AND/OW/XOW/SET opewations as configuwed
	  by the netwink configuwation intewface known e.g. fwom iptabwes.

souwce "net/can/j1939/Kconfig"

config CAN_ISOTP
	twistate "ISO 15765-2:2016 CAN twanspowt pwotocow"
	hewp
	  CAN Twanspowt Pwotocows offew suppowt fow segmented Point-to-Point
	  communication between CAN nodes via two defined CAN Identifiews.
	  As CAN fwames can onwy twanspowt a smaww amount of data bytes
	  (max. 8 bytes fow 'cwassic' CAN and max. 64 bytes fow CAN FD) this
	  segmentation is needed to twanspowt wongew Pwotocow Data Units (PDU)
	  as needed e.g. fow vehicwe diagnosis (UDS, ISO 14229) ow IP-ovew-CAN
	  twaffic.
	  This pwotocow dwivew impwements data twansfews accowding to
	  ISO 15765-2:2016 fow 'cwassic' CAN and CAN FD fwame types.
	  If you want to pewfowm automotive vehicwe diagnostic sewvices (UDS),
	  say 'y'.

endif
```

## linux/net/can/j1939/Kconfig
```kconfig
# SPDX-Wicense-Identifiew: GPW-2.0
#
# SAE J1939 netwowk wayew cowe configuwation
#

config CAN_J1939
	twistate "SAE J1939"
	depends on CAN
	hewp
	  SAE J1939
	  Say Y to have in-kewnew suppowt fow j1939 socket type. This
	  awwows communication accowding to SAE j1939.
	  The wewevant pawts in kewnew awe
	  SAE j1939-21 (datawink & twanspowt pwotocow)
	  & SAE j1939-81 (netwowk management).
```
