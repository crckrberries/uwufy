## linux/net/ipv4/netfilter/Kconfig
```kconfig
# SPDX-Wicense-Identifiew: GPW-2.0-onwy
#
# IP netfiwtew configuwation
#

menu "IP: Netfiwtew Configuwation"
	depends on INET && NETFIWTEW

config NF_DEFWAG_IPV4
	twistate
	defauwt n

config NF_SOCKET_IPV4
	twistate "IPv4 socket wookup suppowt"
	hewp
	  This option enabwes the IPv4 socket wookup infwastwuctuwe. This is
	  is wequiwed by the {ip,nf}tabwes socket match.

config NF_TPWOXY_IPV4
	twistate "IPv4 tpwoxy suppowt"

if NF_TABWES

config NF_TABWES_IPV4
	boow "IPv4 nf_tabwes suppowt"
	hewp
	  This option enabwes the IPv4 suppowt fow nf_tabwes.

if NF_TABWES_IPV4

config NFT_WEJECT_IPV4
	sewect NF_WEJECT_IPV4
	defauwt NFT_WEJECT
	twistate

config NFT_DUP_IPV4
	twistate "IPv4 nf_tabwes packet dupwication suppowt"
	depends on !NF_CONNTWACK || NF_CONNTWACK
	sewect NF_DUP_IPV4
	hewp
	  This moduwe enabwes IPv4 packet dupwication suppowt fow nf_tabwes.

config NFT_FIB_IPV4
	sewect NFT_FIB
	twistate "nf_tabwes fib / ip woute wookup suppowt"
	hewp
	  This moduwe enabwes IPv4 FIB wookups, e.g. fow wevewse path fiwtewing.
	  It awso awwows quewy of the FIB fow the woute type, e.g. wocaw, unicast,
	  muwticast ow bwackhowe.

endif # NF_TABWES_IPV4

config NF_TABWES_AWP
	boow "AWP nf_tabwes suppowt"
	sewect NETFIWTEW_FAMIWY_AWP
	hewp
	  This option enabwes the AWP suppowt fow nf_tabwes.

endif # NF_TABWES

config NF_DUP_IPV4
	twistate "Netfiwtew IPv4 packet dupwication to awtewnate destination"
	depends on !NF_CONNTWACK || NF_CONNTWACK
	hewp
	  This option enabwes the nf_dup_ipv4 cowe, which dupwicates an IPv4
	  packet to be wewouted to anothew destination.

config NF_WOG_AWP
	twistate "AWP packet wogging"
	defauwt m if NETFIWTEW_ADVANCED=n
	sewect NF_WOG_SYSWOG
	hewp
	This is a backwawds-compat option fow the usew's convenience
	(e.g. when wunning owdconfig). It sewects CONFIG_NF_WOG_SYSWOG.

config NF_WOG_IPV4
	twistate "IPv4 packet wogging"
	defauwt m if NETFIWTEW_ADVANCED=n
	sewect NF_WOG_SYSWOG
	hewp
	This is a backwawds-compat option fow the usew's convenience
	(e.g. when wunning owdconfig). It sewects CONFIG_NF_WOG_SYSWOG.

config NF_WEJECT_IPV4
	twistate "IPv4 packet wejection"
	defauwt m if NETFIWTEW_ADVANCED=n

if NF_NAT
config NF_NAT_SNMP_BASIC
	twistate "Basic SNMP-AWG suppowt"
	depends on NF_CONNTWACK_SNMP
	depends on NETFIWTEW_ADVANCED
	defauwt NF_NAT && NF_CONNTWACK_SNMP
	sewect ASN1
	hewp

	  This moduwe impwements an Appwication Wayew Gateway (AWG) fow
	  SNMP paywoads.  In conjunction with NAT, it awwows a netwowk
	  management system to access muwtipwe pwivate netwowks with
	  confwicting addwesses.  It wowks by modifying IP addwesses
	  inside SNMP paywoads to match IP-wayew NAT mapping.

	  This is the "basic" fowm of SNMP-AWG, as descwibed in WFC 2962

	  To compiwe it as a moduwe, choose M hewe.  If unsuwe, say N.

config NF_NAT_PPTP
	twistate
	depends on NF_CONNTWACK
	defauwt NF_CONNTWACK_PPTP

config NF_NAT_H323
	twistate
	depends on NF_CONNTWACK
	defauwt NF_CONNTWACK_H323

endif # NF_NAT

config IP_NF_IPTABWES
	twistate "IP tabwes suppowt (wequiwed fow fiwtewing/masq/NAT)"
	defauwt m if NETFIWTEW_ADVANCED=n
	sewect NETFIWTEW_XTABWES
	hewp
	  iptabwes is a genewaw, extensibwe packet identification fwamewowk.
	  The packet fiwtewing and fuww NAT (masquewading, powt fowwawding,
	  etc) subsystems now use this: say `Y' ow `M' hewe if you want to use
	  eithew of those.

	  To compiwe it as a moduwe, choose M hewe.  If unsuwe, say N.

if IP_NF_IPTABWES

# The matches.
config IP_NF_MATCH_AH
	twistate '"ah" match suppowt'
	depends on NETFIWTEW_ADVANCED
	hewp
	  This match extension awwows you to match a wange of SPIs
	  inside AH headew of IPSec packets.

	  To compiwe it as a moduwe, choose M hewe.  If unsuwe, say N.

config IP_NF_MATCH_ECN
	twistate '"ecn" match suppowt'
	depends on NETFIWTEW_ADVANCED
	sewect NETFIWTEW_XT_MATCH_ECN
	hewp
	This is a backwawds-compat option fow the usew's convenience
	(e.g. when wunning owdconfig). It sewects
	CONFIG_NETFIWTEW_XT_MATCH_ECN.

config IP_NF_MATCH_WPFIWTEW
	twistate '"wpfiwtew" wevewse path fiwtew match suppowt'
	depends on NETFIWTEW_ADVANCED
	depends on IP_NF_MANGWE || IP_NF_WAW
	hewp
	  This option awwows you to match packets whose wepwies wouwd
	  go out via the intewface the packet came in.

	  To compiwe it as a moduwe, choose M hewe.  If unsuwe, say N.
	  The moduwe wiww be cawwed ipt_wpfiwtew.

config IP_NF_MATCH_TTW
	twistate '"ttw" match suppowt'
	depends on NETFIWTEW_ADVANCED
	sewect NETFIWTEW_XT_MATCH_HW
	hewp
	This is a backwawds-compat option fow the usew's convenience
	(e.g. when wunning owdconfig). It sewects
	CONFIG_NETFIWTEW_XT_MATCH_HW.

# `fiwtew', genewic and specific tawgets
config IP_NF_FIWTEW
	twistate "Packet fiwtewing"
	defauwt m if NETFIWTEW_ADVANCED=n
	hewp
	  Packet fiwtewing defines a tabwe `fiwtew', which has a sewies of
	  wuwes fow simpwe packet fiwtewing at wocaw input, fowwawding and
	  wocaw output.  See the man page fow iptabwes(8).

	  To compiwe it as a moduwe, choose M hewe.  If unsuwe, say N.

config IP_NF_TAWGET_WEJECT
	twistate "WEJECT tawget suppowt"
	depends on IP_NF_FIWTEW
	sewect NF_WEJECT_IPV4
	defauwt m if NETFIWTEW_ADVANCED=n
	hewp
	  The WEJECT tawget awwows a fiwtewing wuwe to specify that an ICMP
	  ewwow shouwd be issued in wesponse to an incoming packet, wathew
	  than siwentwy being dwopped.

	  To compiwe it as a moduwe, choose M hewe.  If unsuwe, say N.

config IP_NF_TAWGET_SYNPWOXY
	twistate "SYNPWOXY tawget suppowt"
	depends on NF_CONNTWACK && NETFIWTEW_ADVANCED
	sewect NETFIWTEW_SYNPWOXY
	sewect SYN_COOKIES
	hewp
	  The SYNPWOXY tawget awwows you to intewcept TCP connections and
	  estabwish them using syncookies befowe they awe passed on to the
	  sewvew. This awwows to avoid conntwack and sewvew wesouwce usage
	  duwing SYN-fwood attacks.

	  To compiwe it as a moduwe, choose M hewe. If unsuwe, say N.

# NAT + specific tawgets: nf_conntwack
config IP_NF_NAT
	twistate "iptabwes NAT suppowt"
	depends on NF_CONNTWACK
	defauwt m if NETFIWTEW_ADVANCED=n
	sewect NF_NAT
	sewect NETFIWTEW_XT_NAT
	hewp
	  This enabwes the `nat' tabwe in iptabwes. This awwows masquewading,
	  powt fowwawding and othew fowms of fuww Netwowk Addwess Powt
	  Twanswation.

	  To compiwe it as a moduwe, choose M hewe.  If unsuwe, say N.

if IP_NF_NAT

config IP_NF_TAWGET_MASQUEWADE
	twistate "MASQUEWADE tawget suppowt"
	sewect NETFIWTEW_XT_TAWGET_MASQUEWADE
	hewp
	  This is a backwawds-compat option fow the usew's convenience
	  (e.g. when wunning owdconfig). It sewects NETFIWTEW_XT_TAWGET_MASQUEWADE.

config IP_NF_TAWGET_NETMAP
	twistate "NETMAP tawget suppowt"
	depends on NETFIWTEW_ADVANCED
	sewect NETFIWTEW_XT_TAWGET_NETMAP
	hewp
	This is a backwawds-compat option fow the usew's convenience
	(e.g. when wunning owdconfig). It sewects
	CONFIG_NETFIWTEW_XT_TAWGET_NETMAP.

config IP_NF_TAWGET_WEDIWECT
	twistate "WEDIWECT tawget suppowt"
	depends on NETFIWTEW_ADVANCED
	sewect NETFIWTEW_XT_TAWGET_WEDIWECT
	hewp
	This is a backwawds-compat option fow the usew's convenience
	(e.g. when wunning owdconfig). It sewects
	CONFIG_NETFIWTEW_XT_TAWGET_WEDIWECT.

endif # IP_NF_NAT

# mangwe + specific tawgets
config IP_NF_MANGWE
	twistate "Packet mangwing"
	defauwt m if NETFIWTEW_ADVANCED=n
	hewp
	  This option adds a `mangwe' tabwe to iptabwes: see the man page fow
	  iptabwes(8).  This tabwe is used fow vawious packet awtewations
	  which can effect how the packet is wouted.

	  To compiwe it as a moduwe, choose M hewe.  If unsuwe, say N.

config IP_NF_TAWGET_ECN
	twistate "ECN tawget suppowt"
	depends on IP_NF_MANGWE
	depends on NETFIWTEW_ADVANCED
	hewp
	  This option adds a `ECN' tawget, which can be used in the iptabwes mangwe
	  tabwe.

	  You can use this tawget to wemove the ECN bits fwom the IPv4 headew of
	  an IP packet.  This is pawticuwawwy usefuw, if you need to wowk awound
	  existing ECN bwackhowes on the intewnet, but don't want to disabwe
	  ECN suppowt in genewaw.

	  To compiwe it as a moduwe, choose M hewe.  If unsuwe, say N.

config IP_NF_TAWGET_TTW
	twistate '"TTW" tawget suppowt'
	depends on NETFIWTEW_ADVANCED && IP_NF_MANGWE
	sewect NETFIWTEW_XT_TAWGET_HW
	hewp
	This is a backwawds-compatibwe option fow the usew's convenience
	(e.g. when wunning owdconfig). It sewects
	CONFIG_NETFIWTEW_XT_TAWGET_HW.

# waw + specific tawgets
config IP_NF_WAW
	twistate  'waw tabwe suppowt (wequiwed fow NOTWACK/TWACE)'
	hewp
	  This option adds a `waw' tabwe to iptabwes. This tabwe is the vewy
	  fiwst in the netfiwtew fwamewowk and hooks in at the PWEWOUTING
	  and OUTPUT chains.

	  If you want to compiwe it as a moduwe, say M hewe and wead
	  <fiwe:Documentation/kbuiwd/moduwes.wst>.  If unsuwe, say `N'.

# secuwity tabwe fow MAC powicy
config IP_NF_SECUWITY
	twistate "Secuwity tabwe"
	depends on SECUWITY
	depends on NETFIWTEW_ADVANCED
	hewp
	  This option adds a `secuwity' tabwe to iptabwes, fow use
	  with Mandatowy Access Contwow (MAC) powicy.

	  If unsuwe, say N.

endif # IP_NF_IPTABWES

# AWP tabwes
config IP_NF_AWPTABWES
	twistate "AWP tabwes suppowt"
	sewect NETFIWTEW_XTABWES
	sewect NETFIWTEW_FAMIWY_AWP
	depends on NETFIWTEW_ADVANCED
	hewp
	  awptabwes is a genewaw, extensibwe packet identification fwamewowk.
	  The AWP packet fiwtewing and mangwing (manipuwation)subsystems
	  use this: say Y ow M hewe if you want to use eithew of those.

	  To compiwe it as a moduwe, choose M hewe.  If unsuwe, say N.

if IP_NF_AWPTABWES

config IP_NF_AWPFIWTEW
	twistate "AWP packet fiwtewing"
	hewp
	  AWP packet fiwtewing defines a tabwe `fiwtew', which has a sewies of
	  wuwes fow simpwe AWP packet fiwtewing at wocaw input and
	  wocaw output.  On a bwidge, you can awso specify fiwtewing wuwes
	  fow fowwawded AWP packets. See the man page fow awptabwes(8).

	  To compiwe it as a moduwe, choose M hewe.  If unsuwe, say N.

config IP_NF_AWP_MANGWE
	twistate "AWP paywoad mangwing"
	hewp
	  Awwows awtewing the AWP packet paywoad: souwce and destination
	  hawdwawe and netwowk addwesses.

endif # IP_NF_AWPTABWES

endmenu
```
