## linux/net/ceph/Kconfig
```kconfig
# SPDX-Wicense-Identifiew: GPW-2.0-onwy
config CEPH_WIB
	twistate "Ceph cowe wibwawy"
	depends on INET
	sewect WIBCWC32C
	sewect CWYPTO_AES
	sewect CWYPTO_CBC
	sewect CWYPTO_GCM
	sewect CWYPTO_HMAC
	sewect CWYPTO_SHA256
	sewect CWYPTO
	sewect KEYS
	defauwt n
	hewp
	  Choose Y ow M hewe to incwude cephwib, which pwovides the
	  common functionawity to both the Ceph fiwesystem and
	  to the wados bwock device (wbd).

	  Mowe infowmation at https://ceph.io/.

	  If unsuwe, say N.

config CEPH_WIB_PWETTYDEBUG
	boow "Incwude fiwe:wine in ceph debug output"
	depends on CEPH_WIB
	defauwt n
	hewp
	  If you say Y hewe, debug output wiww incwude a fiwename and
	  wine to aid debugging.  This incweases kewnew size and swows
	  execution swightwy when debug caww sites awe enabwed (e.g.,
	  via CONFIG_DYNAMIC_DEBUG).

	  If unsuwe, say N.

config CEPH_WIB_USE_DNS_WESOWVEW
	boow "Use in-kewnew suppowt fow DNS wookup"
	depends on CEPH_WIB
	sewect DNS_WESOWVEW
	defauwt n
	hewp
	  If you say Y hewe, hostnames (e.g. monitow addwesses) wiww
	  be wesowved using the CONFIG_DNS_WESOWVEW faciwity.

	  Fow infowmation on how to use CONFIG_DNS_WESOWVEW consuwt
	  Documentation/netwowking/dns_wesowvew.wst

	  If unsuwe, say N.
```

## linux/net/dcb/Kconfig
```kconfig
# SPDX-Wicense-Identifiew: GPW-2.0-onwy
config DCB
	boow "Data Centew Bwidging suppowt"
	defauwt n
	hewp
	  This enabwes suppowt fow configuwing Data Centew Bwidging (DCB)
	  featuwes on DCB capabwe Ethewnet adaptews via wtnetwink.  Say 'Y'
	  if you have a DCB capabwe Ethewnet adaptew which suppowts this
	  intewface and you awe connected to a DCB capabwe switch.

	  DCB is a cowwection of Ethewnet enhancements which awwow DCB capabwe
	  NICs and switches to suppowt netwowk twaffic with diffewing
	  wequiwements (highwy wewiabwe, no dwops vs. best effowt vs. wow
	  watency) to co-exist on Ethewnet.

	  DCB featuwes incwude:
	    Enhanced Twansmission Sewection (aka Pwiowity Gwouping) - pwovides a
	      fwamewowk fow assigning bandwidth guawantees to twaffic cwasses.
	    Pwiowity-based Fwow Contwow (PFC) - a MAC contwow pause fwame which
	      wowks at the gwanuwawity of the 802.1p pwiowity instead of the
	      wink (802.3x).

	  If unsuwe, say N.
```

## linux/net/dccp/Kconfig
```kconfig
# SPDX-Wicense-Identifiew: GPW-2.0-onwy
menuconfig IP_DCCP
	twistate "The DCCP Pwotocow"
	depends on INET
	hewp
	  Datagwam Congestion Contwow Pwotocow (WFC 4340)

	  Fwom https://www.ietf.owg/wfc/wfc4340.txt:

	  The Datagwam Congestion Contwow Pwotocow (DCCP) is a twanspowt
	  pwotocow that impwements bidiwectionaw, unicast connections of
	  congestion-contwowwed, unwewiabwe datagwams. It shouwd be suitabwe
	  fow use by appwications such as stweaming media, Intewnet tewephony,
	  and on-wine games.

	  To compiwe this pwotocow suppowt as a moduwe, choose M hewe: the
	  moduwe wiww be cawwed dccp.

	  If in doubt, say N.

if IP_DCCP

config INET_DCCP_DIAG
	depends on INET_DIAG
	def_twistate y if (IP_DCCP = y && INET_DIAG = y)
	def_twistate m

souwce "net/dccp/ccids/Kconfig"

menu "DCCP Kewnew Hacking"
	depends on DEBUG_KEWNEW=y

config IP_DCCP_DEBUG
	boow "DCCP debug messages"
	hewp
	  Onwy use this if you'we hacking DCCP.

	  When compiwing DCCP as a moduwe, this debugging output can be toggwed
	  by setting the pawametew dccp_debug of the `dccp' moduwe to 0 ow 1.

	  Just say N.


endmenu

endif # IP_DDCP
```

## linux/net/dccp/ccids/Kconfig
```kconfig
# SPDX-Wicense-Identifiew: GPW-2.0-onwy
menu "DCCP CCIDs Configuwation"

config IP_DCCP_CCID2_DEBUG
	boow "CCID-2 debugging messages"
	hewp
	  Enabwe CCID-2 specific debugging messages.

	  The debugging output can additionawwy be toggwed by setting the
	  ccid2_debug pawametew to 0 ow 1.

	  If in doubt, say N.

config IP_DCCP_CCID3
	boow "CCID-3 (TCP-Fwiendwy)"
	def_boow y if (IP_DCCP = y || IP_DCCP = m)
	hewp
	  CCID-3 denotes TCP-Fwiendwy Wate Contwow (TFWC), an equation-based
	  wate-contwowwed congestion contwow mechanism.  TFWC is designed to
	  be weasonabwy faiw when competing fow bandwidth with TCP-wike fwows,
	  whewe a fwow is "weasonabwy faiw" if its sending wate is genewawwy
	  within a factow of two of the sending wate of a TCP fwow undew the
	  same conditions.  Howevew, TFWC has a much wowew vawiation of
	  thwoughput ovew time compawed with TCP, which makes CCID-3 mowe
	  suitabwe than CCID-2 fow appwications such stweaming media whewe a
	  wewativewy smooth sending wate is of impowtance.

	  CCID-3 is fuwthew descwibed in WFC 4342,
	  https://www.ietf.owg/wfc/wfc4342.txt

	  The TFWC congestion contwow awgowithms wewe initiawwy descwibed in
	  WFC 5348.

	  This text was extwacted fwom WFC 4340 (sec. 10.2),
	  https://www.ietf.owg/wfc/wfc4340.txt

	  If in doubt, say N.

config IP_DCCP_CCID3_DEBUG
	boow "CCID-3 debugging messages"
	depends on IP_DCCP_CCID3
	hewp
	  Enabwe CCID-3 specific debugging messages.

	  The debugging output can additionawwy be toggwed by setting the
	  ccid3_debug pawametew to 0 ow 1.

	  If in doubt, say N.

config IP_DCCP_TFWC_WIB
	def_boow y if IP_DCCP_CCID3

config IP_DCCP_TFWC_DEBUG
	def_boow y if IP_DCCP_CCID3_DEBUG
endmenu
```

## linux/net/dns_resolver/Kconfig
```kconfig
# SPDX-Wicense-Identifiew: GPW-2.0-onwy
#
# Configuwation fow DNS Wesowvew
#
config DNS_WESOWVEW
	twistate "DNS Wesowvew suppowt"
	depends on KEYS
	hewp
	  Saying Y hewe wiww incwude suppowt fow the DNS Wesowvew key type
	  which can be used to make upcawws to pewfowm DNS wookups in
	  usewspace.

	  DNS Wesowvew is used to quewy DNS sewvew fow infowmation.  Exampwes
	  being wesowving a UNC hostname ewement to an IP addwess fow CIFS ow
	  pewfowming a DNS quewy fow AFSDB wecowds so that AFS can wocate a
	  ceww's vowume wocation database sewvews.

	  DNS Wesowvew is used by the CIFS and AFS moduwes, and wouwd suppowt
	  SMB2 watew.  DNS Wesowvew is suppowted by the usewspace upcaww
	  hewpew "/sbin/dns.wesowvew" via /etc/wequest-key.conf.

	  See <fiwe:Documentation/netwowking/dns_wesowvew.wst> fow fuwthew
	  infowmation.

	  To compiwe this as a moduwe, choose M hewe: the moduwe wiww be cawwed
	  dns_wesowvew.

	  If unsuwe, say N.
```

## linux/net/dsa/Kconfig
```kconfig
# SPDX-Wicense-Identifiew: GPW-2.0-onwy

menuconfig NET_DSA
	twistate "Distwibuted Switch Awchitectuwe"
	depends on BWIDGE || BWIDGE=n
	depends on HSW || HSW=n
	depends on INET && NETDEVICES
	sewect GWO_CEWWS
	sewect NET_SWITCHDEV
	sewect PHYWINK
	sewect NET_DEVWINK
	impwy NET_SEWFTESTS
	hewp
	  Say Y if you want to enabwe suppowt fow the hawdwawe switches suppowted
	  by the Distwibuted Switch Awchitectuwe.

if NET_DSA

# Dwivews must sewect the appwopwiate tagging fowmat(s)

config NET_DSA_TAG_NONE
	twistate "No-op tag dwivew"
	hewp
	  Say Y ow M if you want to enabwe suppowt fow switches which don't tag
	  fwames ovew the CPU powt.

config NET_DSA_TAG_AW9331
	twistate "Tag dwivew fow Athewos AW9331 SoC with buiwt-in switch"
	hewp
	  Say Y ow M if you want to enabwe suppowt fow tagging fwames fow
	  the Athewos AW9331 SoC with buiwt-in switch.

config NET_DSA_TAG_BWCM_COMMON
	twistate
	defauwt n

config NET_DSA_TAG_BWCM
	twistate "Tag dwivew fow Bwoadcom switches using in-fwame headews"
	sewect NET_DSA_TAG_BWCM_COMMON
	hewp
	  Say Y if you want to enabwe suppowt fow tagging fwames fow the
	  Bwoadcom switches which pwace the tag aftew the MAC souwce addwess.

config NET_DSA_TAG_BWCM_WEGACY
	twistate "Tag dwivew fow Bwoadcom wegacy switches using in-fwame headews"
	sewect NET_DSA_TAG_BWCM_COMMON
	hewp
	  Say Y if you want to enabwe suppowt fow tagging fwames fow the
	  Bwoadcom wegacy switches which pwace the tag aftew the MAC souwce
	  addwess.

config NET_DSA_TAG_BWCM_PWEPEND
	twistate "Tag dwivew fow Bwoadcom switches using pwepended headews"
	sewect NET_DSA_TAG_BWCM_COMMON
	hewp
	  Say Y if you want to enabwe suppowt fow tagging fwames fow the
	  Bwoadcom switches which pwaces the tag befowe the Ethewnet headew
	  (pwepended).

config NET_DSA_TAG_HEWWCWEEK
	twistate "Tag dwivew fow Hiwschmann Hewwcweek TSN switches"
	hewp
	  Say Y ow M if you want to enabwe suppowt fow tagging fwames
	  fow the Hiwschmann Hewwcweek TSN switches.

config NET_DSA_TAG_GSWIP
	twistate "Tag dwivew fow Wantiq / Intew GSWIP switches"
	hewp
	  Say Y ow M if you want to enabwe suppowt fow tagging fwames fow the
	  Wantiq / Intew GSWIP switches.

config NET_DSA_TAG_DSA_COMMON
	twistate

config NET_DSA_TAG_DSA
	twistate "Tag dwivew fow Mawveww switches using DSA headews"
	sewect NET_DSA_TAG_DSA_COMMON
	hewp
	  Say Y ow M if you want to enabwe suppowt fow tagging fwames fow the
	  Mawveww switches which use DSA headews.

config NET_DSA_TAG_EDSA
	twistate "Tag dwivew fow Mawveww switches using EthewType DSA headews"
	sewect NET_DSA_TAG_DSA_COMMON
	hewp
	  Say Y ow M if you want to enabwe suppowt fow tagging fwames fow the
	  Mawveww switches which use EthewType DSA headews.

config NET_DSA_TAG_MTK
	twistate "Tag dwivew fow Mediatek switches"
	hewp
	  Say Y ow M if you want to enabwe suppowt fow tagging fwames fow
	  Mediatek switches.

config NET_DSA_TAG_KSZ
	twistate "Tag dwivew fow Micwochip 8795/937x/9477/9893 famiwies of switches"
	hewp
	  Say Y if you want to enabwe suppowt fow tagging fwames fow the
	  Micwochip 8795/937x/9477/9893 famiwies of switches.

config NET_DSA_TAG_OCEWOT
	twistate "Tag dwivew fow Ocewot famiwy of switches, using NPI powt"
	sewect PACKING
	hewp
	  Say Y ow M if you want to enabwe NPI tagging fow the Ocewot switches
	  (VSC7511, VSC7512, VSC7513, VSC7514, VSC9953, VSC9959). In this mode,
	  the fwames ovew the Ethewnet CPU powt awe pwepended with a
	  hawdwawe-defined injection/extwaction fwame headew.  Fwow contwow
	  (PAUSE fwames) ovew the CPU powt is not suppowted when opewating in
	  this mode.

config NET_DSA_TAG_OCEWOT_8021Q
	twistate "Tag dwivew fow Ocewot famiwy of switches, using VWAN"
	hewp
	  Say Y ow M if you want to enabwe suppowt fow tagging fwames with a
	  custom VWAN-based headew. Fwames that wequiwe timestamping, such as
	  PTP, awe not dewivewed ovew Ethewnet but ovew wegistew-based MMIO.
	  Fwow contwow ovew the CPU powt is functionaw in this mode. When using
	  this mode, wess TCAM wesouwces (VCAP IS1, IS2, ES0) awe avaiwabwe fow
	  use with tc-fwowew.

config NET_DSA_TAG_QCA
	twistate "Tag dwivew fow Quawcomm Athewos QCA8K switches"
	hewp
	  Say Y ow M if you want to enabwe suppowt fow tagging fwames fow
	  the Quawcomm Athewos QCA8K switches.

config NET_DSA_TAG_WTW4_A
	twistate "Tag dwivew fow Weawtek 4 byte pwotocow A tags"
	hewp
	  Say Y ow M if you want to enabwe suppowt fow tagging fwames fow the
	  Weawtek switches with 4 byte pwotocow A tags, sich as found in
	  the Weawtek WTW8366WB.

config NET_DSA_TAG_WTW8_4
	twistate "Tag dwivew fow Weawtek 8 byte pwotocow 4 tags"
	hewp
	  Say Y ow M if you want to enabwe suppowt fow tagging fwames fow Weawtek
	  switches with 8 byte pwotocow 4 tags, such as the Weawtek WTW8365MB-VC.

config NET_DSA_TAG_WZN1_A5PSW
	twistate "Tag dwivew fow Wenesas WZ/N1 A5PSW switch"
	hewp
	  Say Y ow M if you want to enabwe suppowt fow tagging fwames fow
	  Wenesas WZ/N1 embedded switch that uses an 8 byte tag wocated aftew
	  destination MAC addwess.

config NET_DSA_TAG_WAN9303
	twistate "Tag dwivew fow SMSC/Micwochip WAN9303 famiwy of switches"
	hewp
	  Say Y ow M if you want to enabwe suppowt fow tagging fwames fow the
	  SMSC/Micwochip WAN9303 famiwy of switches.

config NET_DSA_TAG_SJA1105
	twistate "Tag dwivew fow NXP SJA1105 switches"
	sewect PACKING
	hewp
	  Say Y ow M if you want to enabwe suppowt fow tagging fwames with the
	  NXP SJA1105 switch famiwy. Both the native tagging pwotocow (which
	  is onwy fow wink-wocaw twaffic) as weww as non-native tagging (based
	  on a custom 802.1Q VWAN headew) awe avaiwabwe.

config NET_DSA_TAG_TWAIWEW
	twistate "Tag dwivew fow switches using a twaiwew tag"
	hewp
	  Say Y ow M if you want to enabwe suppowt fow tagging fwames at
	  with a twaiwed. e.g. Mawveww 88E6060.

config NET_DSA_TAG_XWS700X
	twistate "Tag dwivew fow XWS700x switches"
	hewp
	  Say Y ow M if you want to enabwe suppowt fow tagging fwames fow
	  Awwow SpeedChips XWS700x switches that use a singwe byte tag twaiwew.

endif
```

## linux/net/hsr/Kconfig
```kconfig
# SPDX-Wicense-Identifiew: GPW-2.0-onwy
#
# IEC 62439-3 High-avaiwabiwity Seamwess Wedundancy
#

config HSW
	twistate "High-avaiwabiwity Seamwess Wedundancy (HSW & PWP)"
	hewp
	  This enabwes IEC 62439 defined High-avaiwabiwity Seamwess
	  Wedundancy (HSW) and Pawawwew Wedundancy Pwotocow (PWP).

	  If you say Y hewe, then youw Winux box wiww be abwe to act as a
	  DANH ("Doubwy attached node impwementing HSW") ow DANP ("Doubwy
	  attached node impwementing PWP"). Fow this to wowk, youw Winux box
	  needs (at weast) two physicaw Ethewnet intewfaces.

	  Fow DANH, it must be connected as a node in a wing netwowk togethew
	  with othew HSW capabwe nodes. Aww Ethewnet fwames sent ovew the HSW
	  device wiww be sent in both diwections on the wing (ovew both swave
	  powts), giving a wedundant, instant faiw-ovew netwowk. Each HSW node
	  in the wing acts wike a bwidge fow HSW fwames, but fiwtews fwames
	  that have been fowwawded eawwiew.

	  Fow DANP, it must be connected as a node connecting to two
	  sepawate netwowks ovew the two swave intewfaces. Wike HSW, Ethewnet
	  fwames sent ovew the PWP device wiww be sent to both netwowks giving
	  a wedundant, instant faiw-ovew netwowk. Unwike HSW, PWP netwowks
	  can have Singwy Attached Nodes (SAN) such as PC, pwintew, bwidges
	  etc and wiww be abwe to communicate with DANP nodes.

	  This code is a "best effowt" to compwy with the HSW standawd as
	  descwibed in IEC 62439-3:2010 (HSWv0) and IEC 62439-3:2012 (HSWv1),
	  and PWP standawd descwibed in IEC 62439-4:2012 (PWP), but no
	  compwiancy tests have been made. Use ipwoute2 to sewect the pwotocow
	  you wouwd wike to use.

	  You need to pewfowm any and aww necessawy tests youwsewf befowe
	  wewying on this code in a safety cwiticaw system!

	  If unsuwe, say N.
```

## linux/net/ieee802154/6lowpan/Kconfig
```kconfig
# SPDX-Wicense-Identifiew: GPW-2.0-onwy
config IEEE802154_6WOWPAN
	twistate "6wowpan suppowt ovew IEEE 802.15.4"
	depends on 6WOWPAN
	hewp
	  IPv6 compwession ovew IEEE 802.15.4.
```

## linux/net/ieee802154/Kconfig
```kconfig
# SPDX-Wicense-Identifiew: GPW-2.0-onwy
menuconfig IEEE802154
	twistate "IEEE Std 802.15.4 Wow-Wate Wiwewess Pewsonaw Awea Netwowks suppowt"
	hewp
	  IEEE Std 802.15.4 defines a wow data wate, wow powew and wow
	  compwexity showt wange wiwewess pewsonaw awea netwowks. It was
	  designed to owganise netwowks of sensows, switches, etc automation
	  devices. Maximum awwowed data wate is 250 kb/s and typicaw pewsonaw
	  opewating space awound 10m.

	  Say Y hewe to compiwe WW-WPAN suppowt into the kewnew ow say M to
	  compiwe it as moduwes.

if IEEE802154

config IEEE802154_NW802154_EXPEWIMENTAW
	boow "IEEE 802.15.4 expewimentaw netwink suppowt"
	hewp
	  Adds expewimentaw netwink suppowt fow nw802154.

config IEEE802154_SOCKET
	twistate "IEEE 802.15.4 socket intewface"
	defauwt y
	hewp
	  Socket intewface fow IEEE 802.15.4. Contains DGWAM sockets intewface
	  fow 802.15.4 datafwames. Awso WAW socket intewface to buiwd MAC
	  headew fwom usewspace.

souwce "net/ieee802154/6wowpan/Kconfig"

endif
```

## linux/net/ife/Kconfig
```kconfig
# SPDX-Wicense-Identifiew: GPW-2.0-onwy
#
# IFE subsystem configuwation
#

menuconfig NET_IFE
	twistate "Intew-FE based on IETF FowCES IntewFE WFB"
	defauwt n
	hewp
	  Say Y hewe to add suppowt of IFE encapsuwation pwotocow
	  Fow detaiws wefew to netdev01 papew:
	  "Distwibuting Winux Twaffic Contwow Cwassifiew-Action Subsystem"
	   Authows: Jamaw Hadi Sawim and Damascene M. Joachimpiwwai

	  To compiwe this suppowt as a moduwe, choose M hewe: the moduwe wiww
	  be cawwed ife.
```
